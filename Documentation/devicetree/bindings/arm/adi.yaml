## Documentation/devicetree/bindings/arm/adi.yaml
```yaml
# SPDX-License-Identifier: (GPL-2.0-only OR BSD-2-Clause)
%YAML 1.2
---
$id: http://devicetree.org/schemas/arm/adi.yaml#
$schema: http://devicetree.org/meta-schemas/core.yaml#

title: Analog Devices SC59x (SHARC+) / SC84x (SHARC-FX) platforms

maintainers:
  - Arturs Artamonovs <arturs.artamonovs@analog.com>
  - Qasim Ijaz <qasim.ijaz@analog.com>
  - Caleb Ethridge <calen.ethridge@analog.com>
  - Vasileios Bimpikas <vasileios.bimpikas@analog.com>

properties:
  $nodename:
    const: "/"
  compatible:
    oneOf:
      - description: SC598 boards
        items:
          - enum:
              - adi,sc598-htol
              - adi,sc598-som-ezkit
              - adi,sc598-som-ezlite
          - const: adi,sc59x-64
      - description: SC846 boards
        items:
          - enum:
              - adi,sc846-som-ezkit
          - const: adi,sc846
additionalProperties: true
```

## Documentation/devicetree/bindings/bus/adi,adsp-spu.yaml
```yaml
# SPDX-License-Identifier: (GPL-2.0-only OR BSD-2-Clause)
%YAML 1.2
---
$id: http://devicetree.org/schemas/bus/adi,adsp-spu.yaml#
$schema: http://devicetree.org/meta-schemas/core.yaml#

title: Analog Devices ADSP System Protection Unit

maintainers:
  - Ozan Durgut <ozan.durgut@analog.com>

description: |
  The System Protection Unit (SPU) is the peripheral firewall found on
  several Analog Devices ADSP/SHARC-FX processors (SC59x, SC846, SC594).
  It sits between the system crossbar and the peripheral MMR interface and
  can write-protect a peripheral's registers from selected bus masters.
  Register layout is identical across these chips; only the SEC interrupt
  ID and the number of write-protectable peripherals differ.

  The protection policy is programmed by secure firmware; this node only
  describes the hardware so that the OS can report the protection and
  security violations the SPU raises.

properties:
  compatible:
    enum:
      - adi,sc59x-spu
      - adi,sc846-spu
      - adi,sc594-spu

  reg:
    maxItems: 1

  interrupts:
    maxItems: 1
    description: SPU protection/security violation interrupt.

required:
  - compatible
  - reg
  - interrupts

additionalProperties: false

examples:
  - |
    #include <dt-bindings/interrupt-controller/arm-gic.h>
    #include <dt-bindings/interrupt-controller/irq.h>

    spu@3108b000 {
        compatible = "adi,sc59x-spu";
        reg = <0x3108b000 0x1000>;
        interrupts = <GIC_SPI 216 IRQ_TYPE_LEVEL_HIGH>;
    };
```

## Documentation/devicetree/bindings/bus/adi,sc59x-smpu.yaml
```yaml
# SPDX-License-Identifier: (GPL-2.0-only OR BSD-2-Clause)
%YAML 1.2
---
$id: http://devicetree.org/schemas/bus/adi,sc59x-smpu.yaml#
$schema: http://devicetree.org/meta-schemas/core.yaml#

title: Analog Devices SC59x System Memory Protection Unit

maintainers:
  - Ozan Durgut <ozan.durgut@analog.com>

description: |
  The System Memory Protection Unit (SMPU) is the memory firewall of the
  ADSP-SC59x processors. It restricts accesses to L2 SRAM, DDR and boot-ROM
  windows by bus-master transaction ID.

  Each SC59x SMPU is a collection of protection-unit instances, one per
  crossbar port, sharing a single violation interrupt. Per HRM Table 12-1
  the instances are:
    - SMPU0  (0x31007000): system MMR access
    - SMPU2  (0x31083000): L2-Core Port 0 (CL2_0), L2 SRAM banks 0-3
    - SMPU3  (0x31084000): L2 DMA Port 0 (DL2_0)
    - SMPU4  (0x31085000): L2-Core Port 1 (CL2_1), L2 SRAM banks 4-7
    - SMPU5  (0x31086000): L2 DMA Port 1 (DL2_1)
    - SMPU6  (0x31087000): L2-Core Port 2 (CL2_2), instruction port
    - SMPU9  (0x310A0000): DDR memory controller
    - SMPU11 (0x310A1000): SPI2/OSPI flash
    - SMPU12 (0x31012000): OTP memory

  The protection policy is programmed by secure firmware; this node only
  describes the hardware so that the OS can report the violations the SMPU
  raises.

properties:
  compatible:
    const: adi,sc59x-smpu

  reg:
    description: One entry per SMPU instance wired up on the board.
    minItems: 1
    maxItems: 9

  interrupts:
    maxItems: 1
    description: Shared SMPU protection-violation interrupt.

required:
  - compatible
  - reg
  - interrupts

additionalProperties: false

examples:
  - |
    #include <dt-bindings/interrupt-controller/arm-gic.h>
    #include <dt-bindings/interrupt-controller/irq.h>

    smpu@31083000 {
        compatible = "adi,sc59x-smpu";
        reg = <0x31083000 0x1000>,   /* SMPU2 */
              <0x31084000 0x1000>,   /* SMPU3 */
              <0x31085000 0x1000>,   /* SMPU4 */
              <0x31086000 0x1000>,   /* SMPU5 */
              <0x310A0000 0x1000>,   /* SMPU9 */
              <0x310A1000 0x1000>;   /* SMPU11 */
        interrupts = <GIC_SPI 217 IRQ_TYPE_LEVEL_HIGH>;
    };
```

## Documentation/devicetree/bindings/bus/adi,sc59x-spu.yaml
```yaml
# SPDX-License-Identifier: (GPL-2.0-only OR BSD-2-Clause)
%YAML 1.2
---
$id: http://devicetree.org/schemas/bus/adi,sc59x-spu.yaml#
$schema: http://devicetree.org/meta-schemas/core.yaml#

title: ADI SC59x System Protection Unit (SPU)

maintainers:
  - Ozan Durgut <ozan.durgut@analog.com>

description:
  The System Protection Unit (SPU) is the peripheral firewall of the
  ADSP-SC59x processors. It sits between the system crossbar and the
  peripheral MMR interface and can write-protect a peripheral's registers
  from selected bus masters. The protection policy is programmed by secure
  firmware; this node only describes the hardware so that the OS can report
  the protection and security violations the SPU raises.

properties:
  compatible:
    const: adi,sc59x-spu

  reg:
    maxItems: 1

  interrupts:
    maxItems: 1
    description: SPU protection/security violation interrupt.

required:
  - compatible
  - reg
  - interrupts

additionalProperties: false

examples:
  - |
    #include <dt-bindings/interrupt-controller/arm-gic.h>
    #include <dt-bindings/interrupt-controller/irq.h>

    spu@3108b000 {
        compatible = "adi,sc59x-spu";
        reg = <0x3108b000 0x1000>;
        interrupts = <GIC_SPI 216 IRQ_TYPE_LEVEL_HIGH>;
    };
```

## Documentation/devicetree/bindings/clock/adi,adsp-cdu.yaml
```yaml
# SPDX-License-Identifier: (GPL-2.0-only OR BSD-2-Clause)
%YAML 1.2
---
$id: http://devicetree.org/schemas/clock/adi,adsp-cdu.yaml#
$schema: http://devicetree.org/meta-schemas/core.yaml#

title: Analog Devices ADSP Clock Distribution Unit

maintainers:
  - Qasim Ijaz <Qasim.Ijaz@analog.com>

description: |
  The Clock Distribution Unit (CDU) routes core system clocks to
  processor cores, memory controllers, and peripheral interfaces
  across the ADSP SoCs. It consists of multiple clock multiplexers,
  each supporting up to four input clock sources, some of which may
  be unavailable on a particular output. Each CDU output can also
  be independently enabled or disabled.

  The CDU also contains the CLKINSEL mux, which selects the reference
  clock supplied to CGU1. On the ADSP-SC598 SoC, this mux also selects
  the reference clock supplied to the additional DDR PLL block.

properties:
  compatible:
    enum:
      - adi,adsp-sc573-cdu
      - adi,adsp-sc589-cdu
      - adi,adsp-sc594-cdu
      - adi,adsp-sc598-cdu

  reg:
    maxItems: 1

  clocks:
    minItems: 15
    maxItems: 20

  clock-names: true

  '#clock-cells':
    const: 1
    description:
      The clock specifier selects a CDU output clock defined in the
      corresponding SoC-specific CDU clock binding header.

allOf:
  - if:
      properties:
        compatible:
          contains:
            const: adi,adsp-sc573-cdu
    then:
      properties:
        clocks:
          items:
            - description: SYS_CLKIN0 reference clock
            - description: SYS_CLKIN1 reference clock
            - description: CGU0 CCLK0 output
            - description: CGU0 CCLK1 output
            - description: CGU0 SYSCLK output
            - description: CGU0 DCLK output
            - description: CGU0 OCLK output
            - description: CGU0 SCLK1 output
            - description: CGU1 CCLK0 output
            - description: CGU1 CCLK1 output
            - description: CGU1 DCLK output
            - description: CGU1 OCLK output
            - description: CGU1 SCLK1 output
            - description: Half rate CGU0 OCLK output
            - description: Half rate CGU1 CCLK1 output

        clock-names:
          items:
            - const: sys_clkin0
            - const: sys_clkin1
            - const: cclk0_0
            - const: cclk1_0
            - const: sysclk_0
            - const: dclk_0
            - const: oclk_0
            - const: sclk1_0
            - const: cclk0_1
            - const: cclk1_1
            - const: dclk_1
            - const: oclk_1
            - const: sclk1_1
            - const: oclk_0/2
            - const: cclk1_1/2

  - if:
      properties:
        compatible:
          contains:
            const: adi,adsp-sc589-cdu
    then:
      properties:
        clocks:
          items:
            - description: SYS_CLKIN0 reference clock
            - description: SYS_CLKIN1 reference clock
            - description: CGU0 CCLK0 output
            - description: CGU0 CCLK1 output
            - description: CGU0 SYSCLK output
            - description: CGU0 SCLK0 output
            - description: CGU0 SCLK1 output
            - description: CGU0 DCLK output
            - description: CGU0 OCLK output
            - description: CGU1 CCLK0 output
            - description: CGU1 CCLK1 output
            - description: CGU1 SCLK0 output
            - description: CGU1 SCLK1 output
            - description: CGU1 DCLK output
            - description: CGU1 OCLK output
            - description: Half rate CGU0 OCLK output
            - description: Half rate CGU1 CCLK1 output

        clock-names:
          items:
            - const: sys_clkin0
            - const: sys_clkin1
            - const: cclk0_0
            - const: cclk1_0
            - const: sysclk_0
            - const: sclk0_0
            - const: sclk1_0
            - const: dclk_0
            - const: oclk_0
            - const: cclk0_1
            - const: cclk1_1
            - const: sclk0_1
            - const: sclk1_1
            - const: dclk_1
            - const: oclk_1
            - const: oclk_0/2
            - const: cclk1_1/2

  - if:
      properties:
        compatible:
          contains:
            const: adi,adsp-sc594-cdu
    then:
      properties:
        clocks:
          items:
            - description: SYS_CLKIN0 reference clock
            - description: SYS_CLKIN1 reference clock
            - description: CGU0 CCLK0 output
            - description: CGU0 CCLK1 output
            - description: CGU0 SYSCLK output
            - description: CGU0 SCLK0 output
            - description: CGU0 SCLK1 output
            - description: CGU0 DCLK output
            - description: CGU0 OCLK output
            - description: CGU1 CCLK0 output
            - description: CGU1 SYSCLK output
            - description: CGU1 SCLK0 output
            - description: CGU1 SCLK1 output
            - description: CGU1 DCLK output
            - description: CGU1 OCLK output

        clock-names:
          items:
            - const: sys_clkin0
            - const: sys_clkin1
            - const: cclk0_0
            - const: cclk1_0
            - const: sysclk_0
            - const: sclk0_0
            - const: sclk1_0
            - const: dclk_0
            - const: oclk_0
            - const: cclk0_1
            - const: sysclk_1
            - const: sclk0_1
            - const: sclk1_1
            - const: dclk_1
            - const: oclk_1

  - if:
      properties:
        compatible:
          contains:
            const: adi,adsp-sc598-cdu
    then:
      properties:
        clocks:
          items:
            - description: SYS_CLKIN0 reference clock
            - description: SYS_CLKIN1 reference clock
            - description: CGU0 CCLK0 output
            - description: CGU0 CCLK1 output
            - description: CGU0 CCLK2 output
            - description: CGU0 SYSCLK output
            - description: CGU0 SCLK0 output
            - description: CGU0 SCLK1 output
            - description: CGU0 DCLK output
            - description: Half rate CGU0 DCLK output
            - description: CGU0 OCLK output
            - description: CGU1 CCLK0 output
            - description: CGU1 CCLK2 output
            - description: CGU1 SYSCLK output
            - description: CGU1 SCLK0 output
            - description: CGU1 SCLK1 output
            - description: Half rate CGU1 SCLK1 output
            - description: CGU1 DCLK output
            - description: Half rate CGU1 DCLK output
            - description: CGU1 OCLK output

        clock-names:
          items:
            - const: sys_clkin0
            - const: sys_clkin1
            - const: cclk0_0
            - const: cclk1_0
            - const: cclk2_0
            - const: sysclk_0
            - const: sclk0_0
            - const: sclk1_0
            - const: dclk_0
            - const: dclk_0/2
            - const: oclk_0
            - const: cclk0_1
            - const: cclk2_1
            - const: sysclk_1
            - const: sclk0_1
            - const: sclk1_1
            - const: sclk1_1/2
            - const: dclk_1
            - const: dclk_1/2
            - const: oclk_1

required:
  - compatible
  - reg
  - clocks
  - clock-names
  - '#clock-cells'

additionalProperties: false

examples:
  - |
    #include <dt-bindings/clock/adi-sc5xx-clock.h>

    clock-controller@3108f000 {
        compatible = "adi,adsp-sc594-cdu";
        reg = <0x3108f000 0x100>;
        #clock-cells = <1>;
        clocks = <&sys_clkin0>,
                 <&sys_clkin1>,
                 <&clk ADSP_SC594_CLK_CGU0_CCLK0>,
                 <&clk ADSP_SC594_CLK_CGU0_CCLK1>,
                 <&clk ADSP_SC594_CLK_CGU0_SYSCLK>,
                 <&clk ADSP_SC594_CLK_CGU0_SCLK0>,
                 <&clk ADSP_SC594_CLK_CGU0_SCLK1>,
                 <&clk ADSP_SC594_CLK_CGU0_DCLK>,
                 <&clk ADSP_SC594_CLK_CGU0_OCLK>,
                 <&clk ADSP_SC594_CLK_CGU1_CCLK0>,
                 <&clk ADSP_SC594_CLK_CGU1_SYSCLK>,
                 <&clk ADSP_SC594_CLK_CGU1_SCLK0>,
                 <&clk ADSP_SC594_CLK_CGU1_SCLK1>,
                 <&clk ADSP_SC594_CLK_CGU1_DCLK>,
                 <&clk ADSP_SC594_CLK_CGU1_OCLK>;
        clock-names = "sys_clkin0",
                      "sys_clkin1",
                      "cclk0_0",
                      "cclk1_0",
                      "sysclk_0",
                      "sclk0_0",
                      "sclk1_0",
                      "dclk_0",
                      "oclk_0",
                      "cclk0_1",
                      "sysclk_1",
                      "sclk0_1",
                      "sclk1_1",
                      "dclk_1",
                      "oclk_1";
    };
```
