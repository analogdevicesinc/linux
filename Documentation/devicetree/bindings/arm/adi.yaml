## Documentation/devicetree/bindings/hwmon/adi,ltc4283.yaml
```yaml
# SPDX-License-Identifier: (GPL-2.0 OR BSD-2-Clause)
%YAML 1.2
---
$id: http://devicetree.org/schemas/hwmon/adi,ltc4283.yaml#
$schema: http://devicetree.org/meta-schemas/core.yaml#

title: LTC4283 Negative Voltage Hot Swap Controller

maintainers:
  - Nuno Sá <nuno.sa@analog.com>

description: |
  The LTC4283 and LTC4284 are negative voltage hot swap controllers that drive
  external N-channel MOSFETs to allow a board to be safely inserted and removed
  from a live backplane.

  The LTC4284 features dual-gate drivers with four operating modes (single
  driver, parallel, high stress staged start, and low stress staged start)
  configured via the hardware MODE pin. The MODE pin must be connected to the
  appropriate voltage level (VEE, VIN, INTVCC, or left open) and cannot be
  controlled via software or GPIO.

  https://www.analog.com/media/en/technical-documentation/data-sheets/ltc4283.pdf
  https://www.analog.com/media/en/technical-documentation/data-sheets/ltc4284.pdf

properties:
  compatible:
    enum:
      - adi,ltc4283
      - adi,ltc4284

  reg:
    maxItems: 1

  adi,rsense-nano-ohms:
    description:
      Value of the sense resistor. For LTC4283, this is the only sense resistor.
      For LTC4284, this is optional and represents the sense resistor value for
      current measurements via the ADC+/ADC- pins (channel 0), which depends on
      the hardware connection (can be wired to SENSE1, SENSE2, or an average via
      resistive divider).

  adi,rsense1-nano-ohms:
    description:
      Value of the SENSE1 current sense resistor. Only applicable to LTC4284.
      This resistor is connected between SENSE1+ and SENSE1- pins and is used
      for channel 1 current measurements.

  adi,rsense2-nano-ohms:
    description:
      Value of the SENSE2 current sense resistor. Only applicable to LTC4284.
      This resistor is connected between SENSE2+ and SENSE2- pins and is used
      for channel 2 current measurements.

  adi,current-limit-sense-microvolt:
    description:
      The current limit sense voltage of the chip is adjustable between
      15mV and 30mV in 1mV steps. This effectively limits the current
      on the load.
    minimum: 15000
    maximum: 30000
    default: 15000

  adi,current-limit-foldback-factor:
    description:
      Specifies the foldback factor for the current limit. The current limit
      can be reduced (folded back) to one of four preset levels. The value
      represents the percentage of the current limit sense voltage to use
      during foldback. A value of 100 means no foldback.
    $ref: /schemas/types.yaml#/definitions/uint32
    enum: [10, 20, 50, 100]
    default: 100

  adi,cooling-delay-ms:
    description:
      Cooling time to apply after an overcurrent fault, FET bad or
      external fault.
    enum: [512, 1002, 2005, 4100, 8190, 16400, 32800, 65600]
    default: 512

  adi,fet-bad-timer-delay-ms:
    description:
      FET bad timer delay. After a FET bad status condition is detected,
      this timer is started. If the condition persists for the
      specified time, the FET is turned off and a fault is logged.
    enum: [256, 512, 1002, 2005]
    default: 256

  adi,power-good-reset-on-fet:
    description:
      If set, resets the power good status when the MOSFET is turned off.
      Otherwise, it resets when a low output voltage is detected.
    type: boolean

  adi,fet-turn-off-disable:
    description:
      If set, the MOSFET is not turned off when a FET fault is detected.
    type: boolean

  adi,tmr-pull-down-disable:
    description: Disables 2uA pull-down current on the TMR pin.
    type: boolean

  adi,dvdt-inrush-control-disable:
    description:
      Disables dV/dt inrush control during startup. In dV/dt mode, the inrush
      current is limited by controlling a constant output voltage ramp rate.
      When disabled, the inrush control mechanism is active current limiting.
    type: boolean

  adi,fault-log-enable:
    description:
      If set, enables logging fault registers and ADC data into EEPROM upon a
      fault.
    type: boolean

  adi,vpower-drns-enable:
    description:
      If set, enables the attenuated MOSFET drain voltage to be monitored. This
      effectively means that the MOSFET power is monitored. If not set, the
      attenuated input voltage (and hence input power) is monitored.
    type: boolean

  adi,external-fault-fet-off-enable:
    description: Turns MOSFET off following an external fault.
    type: boolean

  adi,undervoltage-retry-disable:
    description: Do not retry to turn on the MOSFET after an undervoltage fault.
    type: boolean

  adi,overvoltage-retry-disable:
    description: Do not retry to turn on the MOSFET after an overvoltage fault.
    type: boolean

  adi,external-fault-retry-enable:
    description: Retry to turn on the MOSFET after an external fault.
    type: boolean

  adi,overcurrent-retries:
    description: Configures auto-retry following an Overcurrent fault.
    $ref: /schemas/types.yaml#/definitions/string
    enum: [latch-off, "1", "7", unlimited]
    default: latch-off

  adi,fet-bad-retries:
    description:
      Configures auto-retry following a FET bad fault and a consequent MOSFET
      turn off.
    $ref: /schemas/types.yaml#/definitions/string
    enum: [latch-off, "1", "7", unlimited]
    default: latch-off

  adi,pgio1-func:
    description: Configures the function of the PGIO1 pin.
    $ref: /schemas/types.yaml#/definitions/string
    enum: [inverted_power_good, power_good, gpio]
    default: inverted_power_good

  adi,pgio2-func:
    description: Configures the function of the PGIO2 pin.
    $ref: /schemas/types.yaml#/definitions/string
    enum: [inverted_power_good, power_good, gpio, active_current_limiting]
    default: inverted_power_good

  adi,pgio3-func:
    description: Configures the function of the PGIO3 pin.
    $ref: /schemas/types.yaml#/definitions/string
    enum: [inverted_power_good_input, power_good_input, gpio]
    default: inverted_power_good_input

  adi,pgio4-func:
    description: Configures the function of the PGIO4 pin.
    $ref: /schemas/types.yaml#/definitions/string
    enum: [inverted_external_fault, external_fault, gpio]
    default: inverted_external_fault

  adi,gpio-on-adio1:
    description: If set, the ADIO1 pin is used as a GPIO.
    type: boolean

  adi,gpio-on-adio2:
    description: If set, the ADIO2 pin is used as a GPIO.
    type: boolean

  adi,gpio-on-adio3:
    description: If set, the ADIO3 pin is used as a GPIO.
    type: boolean

  adi,gpio-on-adio4:
    description: If set, the ADIO4 pin is used as a GPIO.
    type: boolean

  gpio-controller: true

  '#gpio-cells':
    const: 2

dependencies:
  adi,gpio-on-adio1:
    - gpio-controller
    - '#gpio-cells'
  adi,gpio-on-adio2:
    - gpio-controller
    - '#gpio-cells'
  adi,gpio-on-adio3:
    - gpio-controller
    - '#gpio-cells'
  adi,gpio-on-adio4:
    - gpio-controller
    - '#gpio-cells'
  adi,external-fault-retry-enable:
    - adi,pgio4-func
  adi,external-fault-fet-off-enable:
    - adi,pgio4-func

required:
  - compatible
  - reg

allOf:
  - if:
      properties:
        compatible:
          contains:
            const: adi,ltc4283
    then:
      required:
        - adi,rsense-nano-ohms

  - if:
      properties:
        compatible:
          contains:
            const: adi,ltc4284
    then:
      required:
        - adi,rsense1-nano-ohms
        - adi,rsense2-nano-ohms

  - if:
      properties:
        adi,pgio1-func:
          const: gpio
      required:
        - adi,pgio1-func
    then:
      required:
        - gpio-controller
        - '#gpio-cells'

  - if:
      properties:
        adi,pgio2-func:
          const: gpio
      required:
        - adi,pgio2-func
    then:
      required:
        - gpio-controller
        - '#gpio-cells'

  - if:
      properties:
        adi,pgio3-func:
          const: gpio
      required:
        - adi,pgio3-func
    then:
      required:
        - gpio-controller
        - '#gpio-cells'

  - if:
      properties:
        adi,pgio4-func:
          const: gpio
      required:
        - adi,pgio4-func
    then:
      properties:
        adi,external-fault-retry-enable: false
        adi,external-fault-fet-off-enable: false
      required:
        - gpio-controller
        - '#gpio-cells'

additionalProperties: false

examples:
  - |
    i2c {
        #address-cells = <1>;
        #size-cells = <0>;

        swap-controller@15 {
            compatible = "adi,ltc4283";
            reg = <0x15>;

            adi,rsense-nano-ohms = <500>;
            adi,current-limit-sense-microvolt = <25000>;
            adi,current-limit-foldback-factor = <10>;
            adi,cooling-delay-ms = <8190>;
            adi,fet-bad-timer-delay-ms = <512>;

            adi,external-fault-fet-off-enable;
            adi,pgio4-func = "external_fault";

            adi,gpio-on-adio1;
            adi,pgio1-func = "gpio";
            gpio-controller;
            #gpio-cells = <2>;
        };
    };
...
```

## Documentation/devicetree/bindings/hwmon/pwm-fan.yaml
```yaml
# SPDX-License-Identifier: (GPL-2.0-only OR BSD-2-Clause)
%YAML 1.2
---
$id: http://devicetree.org/schemas/hwmon/pwm-fan.yaml#
$schema: http://devicetree.org/meta-schemas/core.yaml#

title: Fan connected to PWM lines

maintainers:
  - Jean Delvare <jdelvare@suse.com>
  - Guenter Roeck <linux@roeck-us.net>

allOf:
  - $ref: fan-common.yaml#

properties:
  compatible:
    const: pwm-fan

  cooling-levels:
    description: PWM duty cycle values corresponding to thermal cooling states.
    items:
      maximum: 255

  interrupts:
    description:
      This contains an interrupt specifier for each fan tachometer output
      connected to an interrupt source. The output signal must generate a
      defined number of interrupts per fan revolution, which require that
      it must be self resetting edge interrupts.
    maxItems: 1

  fan-shutdown-percent:
    description:
      Fan RPM in percent set during shutdown. This is used to keep the fan
      running at fixed RPM after the kernel shut down, which is useful on
      hardware that does keep heating itself even after the kernel did shut
      down, for example from some sort of management core.
    minimum: 0
    maximum: 100

  fan-stop-to-start-percent:
    description:
      Minimum fan RPM in percent to start when stopped.
    minimum: 0
    maximum: 100

  fan-stop-to-start-us:
    description:
      Time to wait in microseconds after start when stopped.

  pulses-per-revolution:
    minimum: 1
    default: 2

required:
  - compatible
  - pwms

unevaluatedProperties: false

examples:
  - |
    pwm-fan {
      compatible = "pwm-fan";
      cooling-levels = <0 102 170 230>;
      pwms = <&pwm 0 10000 0>;
      #cooling-cells = <2>;
    };

    thermal-zones {
      cpu_thermal: cpu-thermal {
        thermal-sensors = <&tmu 0>;
        polling-delay-passive = <0>;
        polling-delay = <0>;

        trips {
          cpu_alert1: cpu-alert1 {
            temperature = <100000>; /* millicelsius */
            hysteresis = <2000>; /* millicelsius */
            type = "passive";
          };
        };

        cooling-maps {
          map0 {
            trip = <&cpu_alert1>;
            cooling-device = <&fan0 0 1>;
          };
        };
      };
    };

  - |
    #include <dt-bindings/interrupt-controller/irq.h>

    pwm-fan {
      compatible = "pwm-fan";
      pwms = <&pwm 0 40000 0>;
      fan-supply = <&reg_fan>;
      interrupt-parent = <&gpio5>;
      interrupts = <1 IRQ_TYPE_EDGE_FALLING>;
      pulses-per-revolution = <2>;
      label = "CPU fan";
    };
```

## Documentation/devicetree/bindings/hwmon/starfive,jhb100-pwm-fan.yaml
```yaml
# SPDX-License-Identifier: GPL-2.0-only OR BSD-2-Clause
%YAML 1.2
---
$id: http://devicetree.org/schemas/hwmon/starfive,jhb100-pwm-fan.yaml#
$schema: http://devicetree.org/meta-schemas/core.yaml#

title: StarFive JHB100 PWM Fan Controller

maintainers:
  - Changhuang Liang <changhuang.liang@starfivetech.com>

description:
  The StarFive JHB100 fan controller uses a hardware tachometer block with
  16 tachometer inputs to measure fan speed. Fan speed is controlled through
  8 PWM channels supplied by an external PWM controller, and one PWM channel
  can drive up to two fans. Each fan child node references the PWM channel
  driving the fan(s) and lists the tachometer inputs wired to them.

properties:
  compatible:
    const: starfive,jhb100-pwm-fan

  reg:
    maxItems: 1

  clocks:
    maxItems: 1

  resets:
    maxItems: 1

  interrupts:
    maxItems: 1

patternProperties:
  "^fan-[0-7]$":
    $ref: fan-common.yaml#
    unevaluatedProperties: false

    properties:
      pulses-per-revolution:
        minimum: 1
        default: 2

      tach-ch:
        description:
          The tachometer input(s) wired to the fan(s) driven by the PWM
          channel. One PWM channel can drive up to two fans.
        minItems: 1
        maxItems: 2
        items:
          maximum: 15

    required:
      - pwms
      - tach-ch

required:
  - compatible
  - reg
  - clocks
  - resets
  - interrupts

additionalProperties: false

examples:
  - |
    fan-controller@11be0000 {
        compatible = "starfive,jhb100-pwm-fan";
        reg = <0x11be0000 0x400>;
        interrupts = <128>;
        clocks = <&per2crg 33>;
        resets = <&per2crg 5>;

        fan-0 {
            pwms = <&pwm0 0 40000 0>;
            tach-ch = /bits/ 8 <0x0 0x8>;
            pulses-per-revolution = <2>;
        };

        fan-1 {
            pwms = <&pwm1 0 40000 0>;
            tach-ch = /bits/ 8 <0x1 0x9>;
        };
    };
...
```

## Documentation/devicetree/bindings/hwmon/tdk,fs1603.yaml
```yaml
# SPDX-License-Identifier: (GPL-2.0-only OR BSD-2-Clause)
%YAML 1.2
---
$id: http://devicetree.org/schemas/hwmon/tdk,fs1603.yaml#
$schema: http://devicetree.org/meta-schemas/core.yaml#

title: TDK FS160x and FS1006 uPOL DC-DC converters

maintainers:
  - Kevin Jia <kjia@nexthop.ai>

description:
  The TDK FS160x and FS1006 are uPOL DC-DC converters with an integrated
  inductor. They report telemetry over a proprietary I2C register map and
  have no ID register. The FS1604, FS1006 and FS1606-2500 encode telemetry
  in the same way as the FS1603, and fall back to it. The base FS1606 and the
  FS1606-0600 preset encode it differently and have no fallback.

properties:
  compatible:
    oneOf:
      - enum:
          - tdk,fs1603
          - tdk,fs1606
          - tdk,fs1606-0600
      - items:
          - enum:
              - tdk,fs1006-3300
              - tdk,fs1006-5000
              - tdk,fs1604
              - tdk,fs1606-2500
          - const: tdk,fs1603

  reg:
    maxItems: 1

required:
  - compatible
  - reg

additionalProperties: false

examples:
  - |
    i2c {
        #address-cells = <1>;
        #size-cells = <0>;

        regulator@40 {
            compatible = "tdk,fs1006-3300", "tdk,fs1603";
            reg = <0x40>;
        };
    };
```
