## Documentation/devicetree/bindings/iio/adc/adi,ad4040.yaml
```yaml
# SPDX-License-Identifier: (GPL-2.0-only OR BSD-2-Clause)
# Copyright 2026 Analog Devices Inc.
%YAML 1.2
---
$id: http://devicetree.org/schemas/iio/adc/adi,ad4040.yaml#
$schema: http://devicetree.org/meta-schemas/core.yaml#

title: Analog Devices AD4040 and similar high speed ADCs

maintainers:
  - Antoniu Miclaus <antoniu.miclaus@analog.com>

description: |
  The AD4040, AD4044, AD4046 and AD4048 are high speed analog-to-digital
  converters with 20, 14, 16 and 18-bit resolution respectively. The sample
  data is sent over LVDS lanes to an FPGA data capture core, which is used
  as an IIO backend. The SPI interface is used to configure the device.

$ref: /schemas/spi/spi-peripheral-props.yaml#

properties:
  compatible:
    enum:
      - adi,ad4040
      - adi,ad4044
      - adi,ad4046
      - adi,ad4048

  reg:
    maxItems: 1

  clocks:
    maxItems: 1

  clock-names:
    items:
      - const: cnv
        description: Conversion clock. Its rate is the sampling rate.

  io-backends:
    maxItems: 1
    description: The AXI AD404x data capture core.

  adi,num-lanes:
    description:
      Number of lanes on which the data is sent on the output.
    $ref: /schemas/types.yaml#/definitions/uint32
    enum: [1, 2]
    default: 1

required:
  - compatible
  - reg
  - clocks
  - clock-names
  - io-backends

unevaluatedProperties: false

examples:
  - |
    spi {
        #address-cells = <1>;
        #size-cells = <0>;

        adc@0 {
            compatible = "adi,ad4040";
            reg = <0>;
            spi-max-frequency = <10000000>;
            clocks = <&cnv_clk>;
            clock-names = "cnv";
            io-backends = <&iio_backend>;
            adi,num-lanes = <1>;
        };
    };
...
```

## Documentation/devicetree/bindings/iio/adc/adi,ad4134.yaml
```yaml
# SPDX-License-Identifier: (GPL-2.0-only OR BSD-2-Clause)
%YAML 1.2
---
$id: http://devicetree.org/schemas/iio/adc/adi,ad4134.yaml#
$schema: http://devicetree.org/meta-schemas/core.yaml#

title: Analog Devices AD4134 ADC

maintainers:
  - Marcelo Schmitt <marcelo.schmitt@analog.com>

description: |
  The AD4134 is a quad channel, low noise, simultaneous sampling, precision
  analog-to-digital converter (ADC).
  Specifications can be found at:
    https://www.analog.com/media/en/technical-documentation/data-sheets/ad4134.pdf

$ref: /schemas/spi/spi-peripheral-props.yaml#

properties:
  compatible:
    enum:
      - adi,ad4134

  reg:
    maxItems: 1

  spi-max-frequency:
    maximum: 50000000

  avdd5-supply:
    description: A 5V supply that powers the chip's analog circuitry.

  dvdd5-supply:
    description: A 5V supply that powers the chip's digital circuitry.

  iovdd-supply:
    description:
      A 1.8V supply that sets the logic levels for the digital interface pins.

  refin-supply:
    description:
      A 4.096V or 5V supply that serves as reference for ADC conversions.

  avdd1v8-supply:
    description: A 1.8V supply used by the analog circuitry.

  dvdd1v8-supply:
    description: A 1.8V supply used by the digital circuitry.

  clkvdd-supply:
    description: A 1.8V supply for the chip's clock management circuit.

  ldoin-supply:
    description:
      A 2.6V to 5.5V supply that generates 1.8V for AVDD1V8, DVDD1V8, and CLKVDD
      pins.

  clocks:
    maxItems: 1
    description:
      Required external clock source. Can specify either a crystal or CMOS clock
      source. If an external crystal is set, connect the CLKSEL pin to IOVDD.
      Otherwise, connect the CLKSEL pin to IOGND and the external CMOS clock
      signal to the XTAL2/CLKIN pin.

  clock-names:
    enum:
      - xtal
      - clkin
    default: clkin

  '#clock-cells':
    const: 0

  clock-output-names:
    maxItems: 1

  regulators:
    type: object
    description:
      list of regulators provided by this controller.

    properties:
      vcm-output:
        $ref: /schemas/regulator/regulator.yaml#
        type: object
        unevaluatedProperties: false

    additionalProperties: false

  reset-gpios:
    maxItems: 1

  powerdown-gpios:
    description:
      Active low GPIO connected to the /PDN pin. Forces the device into full
      power-down mode when brought low. Pull this input to IOVDD for normal
      operation.
    maxItems: 1

  odr-gpios:
    description:
      GPIO connected to ODR pin. Used to sample ADC data in minimum I/O mode.
    maxItems: 1

  adi,asrc-mode:
    $ref: /schemas/types.yaml#/definitions/string
    description:
      Asynchronous Sample Rate Converter (ASRC) operation mode control input.
      Describes whether the MODE pin is set to a high level (for master mode
      operation) or to a low level (for slave mode operation).
    enum: [ high, low ]
    default: low

  adi,dclkio:
    description:
      DCLK pin I/O direction control for when the device operates in Pin Control
      Slave Mode or in SPI Control Mode. Describes if DEC0/DCLKIO pin is at a
      high level (which configures DCLK as an output) or to set to a low level
      (configuring DCLK for input).
    enum: [ out, in ]
    default: in

  adi,dclkmode:
    description:
      DCLK mode control for when the device operates in Pin Control Slave Mode
      or in SPI Control Mode. Describes whether the DEC1/DCLKMODE pin is set to
      a high level (configuring the DCLK to operate in free running mode) or
      to a low level (to configure DCLK to operate in gated mode).
    enum: [ free-running, gated ]
    default: gated

  adi,spi-mode:
    $ref: /schemas/types.yaml#/definitions/string
    enum: [ no-cs, 4-wire, one-channel-chain, two-channel-chain ]
    default: no-cs
    description: |
      This property indicates the SPI wiring configuration.
      * no-cs: The datasheet calls this "minimum I/O mode". In this mode, the CS
        line is not used (tied to GND).
      * 4-wire: Specifies a conventional SPI wiring configuration.
      * one-channel-chain: In this mode, the DOUT0 line of one chip is connected
        to DOUT2 of the next chip upstream in the chain. Only the data interface
        of the upmost device in the stream is in direct connection with the
        digital host.
      * two-channel-chain: In this mode, the DOUT0 and DOUT1 lines of one chip
        are respectively connected to DOUT2 and DOUT3 of the next chip upstream
        in the chain. Only the data interface of the upmost device in the stream
        is in direct connection with the digital host.

  '#daisy-chained-devices': true

required:
  - compatible
  - reg
  - avdd5-supply
  - dvdd5-supply
  - iovdd-supply
  - refin-supply
  - clocks
  - clock-names

allOf:
  - oneOf:
      - required:
          - ldoin-supply
      - required:
          - avdd1v8-supply
          - dvdd1v8-supply
          - clkvdd-supply

  - oneOf:
      - required: ['adi,spi-mode', '#daisy-chained-devices']
        properties:
          adi,spi-mode:
            const: one-channel-chain
          spi-rx-bus-width:
            const: 1
      - required: ['adi,spi-mode', '#daisy-chained-devices']
        properties:
          adi,spi-mode:
            const: two-channel-chain
          spi-rx-bus-width:
            items:
              - const: 1
              - const: 1
      - properties:
          '#daisy-chained-devices': false
          adi,spi-mode:
            enum:
              - no-cs
              - 4-wire

unevaluatedProperties: false

examples:
  - |
    #include <dt-bindings/gpio/gpio.h>

    spi {
        #address-cells = <1>;
        #size-cells = <0>;

        adc@0 {
            compatible = "adi,ad4134";
            reg = <0>;

            spi-max-frequency = <1000000>;

            reset-gpios = <&gpio0 86 GPIO_ACTIVE_LOW>;
            odr-gpios = <&gpio0 87 GPIO_ACTIVE_HIGH>;
            powerdown-gpios = <&gpio0 88 GPIO_ACTIVE_LOW>;

            clocks = <&sys_clk>;
            clock-names = "clkin";

            avdd5-supply = <&avdd5>;
            dvdd5-supply = <&dvdd5>;
            iovdd-supply = <&iovdd>;
            refin-supply = <&refin>;
            avdd1v8-supply = <&avdd1v8>;
            dvdd1v8-supply = <&dvdd1v8>;
            clkvdd-supply = <&clkvdd>;

            regulators {
                vcm_reg: vcm-output {
                    regulator-name = "ad4134-vcm";
                };
            };

        };
    };
...
```

## Documentation/devicetree/bindings/iio/adc/adi,ad5940.yaml
```yaml
# SPDX-License-Identifier: (GPL-2.0-only OR BSD-2-Clause)
# Copyright 2019 Analog Devices Inc.
%YAML 1.2
---
$id: http://devicetree.org/schemas/iio/adc/adi,ad5940.yaml#
$schema: http://devicetree.org/meta-schemas/core.yaml#

title: Analog Devices AD5940/AD5941 High Precision, Impedance and Electrochemical Front End

maintainers:
  - Song Qiang <songqiang1304521@gmail.com>

description: |
  Analog Devices AD5940 and AD5941 high precision, impedance and
  electrochemical analog front ends with an SPI interface. The two parts only
  differ in package: the AD5941 has 3 AFE GPIOs and no AIN6 input.

  Datasheet:
    https://www.analog.com/media/en/technical-documentation/data-sheets/ad5940-5941.pdf

allOf:
  - $ref: /schemas/spi/spi-peripheral-props.yaml#
  - if:
      properties:
        compatible:
          contains:
            const: adi,ad5941
    then:
      properties:
        adi,interrupt-io:
          const: 0

properties:
  compatible:
    enum:
      - adi,ad5940
      - adi,ad5941

  reg:
    maxItems: 1

  spi-max-frequency:
    maximum: 12500000

  avdd-supply:
    description: Analog supply (AVDD), 2.8 V to 3.6 V.

  dvdd-supply:
    description:
      Digital supply (DVDD), 2.8 V to 3.6 V. It must be driven before IOVDD.

  iovdd-supply:
    description: Digital input/output supply (IOVDD), 1.8 V or 2.8 V to 3.6 V.

  interrupts:
    maxItems: 1

  reset-gpios:
    maxItems: 1
    description: Active low RESET pin.

  adi,interrupt-io:
    $ref: /schemas/types.yaml#/definitions/uint32
    description:
      Index of the AFE GPIO that outputs the interrupt controller 0 signal.
      Only GPIO0 is available on the AD5941.
    enum: [0, 3, 6]

  '#address-cells':
    const: 1

  '#size-cells':
    const: 0

patternProperties:
  "^channel@[0-9a-f]+$":
    type: object
    $ref: adc.yaml
    unevaluatedProperties: false

    properties:
      reg:
        description: Index of this channel, starting from 0.
        maxItems: 1

      diff-channels:
        description: |
          Positive and negative input of the ADC mux for this channel. The
          allowed values are defined in
          include/dt-bindings/iio/adc/adi,ad5940.h, with AD5940_ADC_INPUTP_*
          for the positive input and AD5940_ADC_INPUTN_* for the negative one.

      label:
        description: Name assigned to this channel.

    required:
      - reg
      - diff-channels

required:
  - compatible
  - reg
  - avdd-supply
  - dvdd-supply
  - iovdd-supply
  - interrupts
  - adi,interrupt-io
  - '#address-cells'
  - '#size-cells'

unevaluatedProperties: false

examples:
  - |
    #include <dt-bindings/iio/adc/adi,ad5940.h>
    #include <dt-bindings/interrupt-controller/irq.h>

    spi {
        #address-cells = <1>;
        #size-cells = <0>;

        adc@0 {
            compatible = "adi,ad5940";
            reg = <0>;
            spi-max-frequency = <12500000>;
            avdd-supply = <&vdd_3v3>;
            dvdd-supply = <&vdd_3v3>;
            iovdd-supply = <&vdd_3v3>;
            interrupt-parent = <&gpio>;
            interrupts = <24 IRQ_TYPE_EDGE_FALLING>;
            adi,interrupt-io = <0>;
            #address-cells = <1>;
            #size-cells = <0>;

            channel@0 {
                reg = <0>;
                diff-channels = <AD5940_ADC_INPUTP_VCE0
                                 AD5940_ADC_INPUTN_VBIAS0>;
                label = "Vce-Vbias";
            };

            channel@1 {
                reg = <1>;
                diff-channels = <AD5940_ADC_INPUTP_AIN0
                                 AD5940_ADC_INPUTN_VBIAS0>;
                label = "ain0-Vbias";
            };
        };
    };
...
```
