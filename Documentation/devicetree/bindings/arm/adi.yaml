## Documentation/devicetree/bindings/clock/adi,sc5xx-clocks.yaml
```yaml
# SPDX-License-Identifier: (GPL-2.0-only OR BSD-2-Clause)
%YAML 1.2
---
$id: http://devicetree.org/schemas/clock/adi,sc5xx-clocks.yaml#
$schema: http://devicetree.org/meta-schemas/core.yaml#

title: Analog Devices ADSP-SC5xx SoC Clock Tree

maintainers:
  - Qasim Ijaz <qasim.ijaz@analog.com>
  - Arturs Artamonovs <arturs.artamonovs@analog.com>
  - Vasileios Bimpikas <vasileios.bimpikas@analog.com>
  - Caleb Ethridge <caleb.ethridge@analog.com>

description: |
  The ADSP-SC5xx clock architecture consists of two main
  hardware blocks, the CGU (clock generation unit) and
  the CDU (clock distribution unit). The CGU includes
  the PLL which produces an output clock which can then
  be divided via clock dividers, the output clocks after
  this stage can then be routed to the CDU. The CDU consists
  of an array of multiplexors that route clocks to various
  parts of the system. The CDU multiplexors have gating
  functionality to allow them to be enabled or disabled.

  The root clocks in the clock trees are SYS_CLKIN0 and
  SYS_CLKIN1, both clocks operate at 25Mhz and are modelled
  as fixed-rate clocks in the device tree.

  Each clock is associated with an identifier and consumer
  nodes can use this identifier to specify which clocks they
  consume from either the CGU directly or the CDU. All clocks
  available for usage by clock consumer nodes are defined in
  'include/dt-bindings/clock/adi-sc5xx-clock.h'.

properties:
  compatible:
    enum:
      - adi,sc598-cgu0
      - adi,sc598-cgu1
      - adi,sc598-cgu2
      - adi,sc598-cdu
      - adi,sc589-cgu0
      - adi,sc589-cgu1
      - adi,sc589-cdu
      - adi,sc573-cgu0
      - adi,sc573-cgu1
      - adi,sc573-cdu
      - adi,sc594-cgu0
      - adi,sc594-cgu1
      - adi,sc594-cdu

  clocks:
    description:
      Specifies the CLKIN0 and CLKIN1 reference clock(s) from which the
      output frequencies are derived via CDU+CGU
    minItems: 2
    maxItems: 2

  clock-names:
    description:
      String reference names for CLKIN0 and CLKIN1
    minItems: 2
    maxItems: 2

  '#clock-cells':
    const: 1

  reg:
    minItems: 3
    maxItems: 4

required:
  - compatible
  - reg
  - clocks
  - '#clock-cells'
  - clock-names

additionalProperties: false

examples:
  - |
    clocks@3108d000 {
      compatible = "adi,sc57x-clocks";
      reg = <0x3108d000 0x1000>,
            <0x3108e000 0x1000>,
            <0x3108f000 0x1000>;
      #clock-cells = <1>;
      clocks = <&sys_clkin0>, <&sys_clkin1>;
      clock-names = "sys_clkin0", "sys_clkin1";
      status = "okay";
    };

  - |
    clocks@3108d000 {
      compatible = "adi,sc58x-clocks";
      reg = <0x3108d000 0x1000>,
            <0x3108e000 0x1000>,
            <0x3108f000 0x1000>;
      #clock-cells = <1>;
      clocks = <&sys_clkin0>, <&sys_clkin1>;
      clock-names = "sys_clkin0", "sys_clkin1";
      status = "okay";
    };

  - |
    clocks@3108d000 {
      compatible = "adi,sc594-clocks";
      reg = <0x3108d000 0x1000>,
            <0x3108e000 0x1000>,
            <0x3108f000 0x1000>;
      #clock-cells = <1>;
      clocks = <&sys_clkin0>, <&sys_clkin1>;
      clock-names = "sys_clkin0", "sys_clkin1";
      status = "okay";
    };

  - |
    clocks@3108d000 {
      compatible = "adi,sc598-clocks";
      reg = <0x3108d000 0x1000>,
            <0x3108e000 0x1000>,
            <0x3108f000 0x1000>,
            <0x310a9000 0x1000>;
      #clock-cells = <1>;
      clocks = <&sys_clkin0>, <&sys_clkin1>;
      clock-names = "sys_clkin0", "sys_clkin1";
      status = "okay";
    };
```

## Documentation/devicetree/bindings/clock/anlogic,dr1v90-cru.yaml
```yaml
# SPDX-License-Identifier: GPL-2.0-only OR BSD-2-Clause
%YAML 1.2
---
$id: http://devicetree.org/schemas/clock/anlogic,dr1v90-cru.yaml#
$schema: http://devicetree.org/meta-schemas/core.yaml#

title: Anlogic DR1V90 Clock and Reset Unit (CRU)

maintainers:
  - Junhui Liu <junhui.liu@pigmoral.tech>

properties:
  compatible:
    const: anlogic,dr1v90-cru

  reg:
    maxItems: 1

  clocks:
    items:
      - description: Main oscillator
      - description: External CAN clock
      - description: External WDT clock

  clock-names:
    items:
      - const: osc
      - const: can_ext
      - const: wdt_ext

  "#clock-cells":
    const: 1
    description:
      Refer <dt-bindings/clock/anlogic,dr1v90-cru.h> for valid indices.

  "#reset-cells":
    const: 1
    description:
      Refer <dt-bindings/reset/anlogic,dr1v90-cru.h> for valid indices.

required:
  - compatible
  - reg
  - clocks
  - clock-names
  - "#clock-cells"
  - "#reset-cells"

additionalProperties: false

examples:
  - |
    clock-controller@f8801000 {
        compatible = "anlogic,dr1v90-cru";
        reg = <0xf8801000 0x400>;
        clocks = <&osc>, <&can_ext>, <&wdt_ext>;
        clock-names = "osc", "can_ext", "wdt_ext";
        #clock-cells = <1>;
        #reset-cells = <1>;
    };
```

## Documentation/devicetree/bindings/clock/qcom,nord-dprxcc.yaml
```yaml
# SPDX-License-Identifier: (GPL-2.0-only OR BSD-2-Clause)
%YAML 1.2
---
$id: http://devicetree.org/schemas/clock/qcom,nord-dprxcc.yaml#
$schema: http://devicetree.org/meta-schemas/core.yaml#

title: Qualcomm DPRX Clock & Reset Controller on Nord

maintainers:
  - Taniya Das <taniya.das@oss.qualcomm.com>

description: |
  Qualcomm dprx clock control module provides the clocks, and resets
  domains on Nord.

  See also:
    include/dt-bindings/clock/qcom,nord-dprxcc.h

properties:
  compatible:
    enum:
      - qcom,nord-dprxcc0
      - qcom,nord-dprxcc1

  clocks:
    items:
      - description: XO clock source
      - description: DPRX CFG AHB clock from NWGCC
      - description: Sleep clock source

  power-domains:
    items:
      - description: MMCX power domain

  required-opps:
    description:
      MMCX performance point.
    maxItems: 1

required:
  - compatible
  - clocks
  - power-domains
  - required-opps

allOf:
  - $ref: qcom,gcc.yaml#

unevaluatedProperties: false

examples:
  - |
    #include <dt-bindings/clock/qcom,nord-nwgcc.h>
    #include <dt-bindings/clock/qcom,rpmh.h>
    #include <dt-bindings/power/qcom,rpmhpd.h>
    clock-controller@a940000 {
      compatible = "qcom,nord-dprxcc0";
      reg = <0x0a940000 0xc000>;
      clocks = <&rpmhcc RPMH_CXO_CLK>,
               <&nwgcc NW_GCC_DPRX0_CFG_AHB_CLK>,
               <&sleep_clk>;
      power-domains = <&rpmhpd RPMHPD_MMCX>;
      required-opps = <&rpmhpd_opp_low_svs>;
      #clock-cells = <1>;
      #reset-cells = <1>;
    };
...
```

## Documentation/devicetree/bindings/clock/ti/dra7-atl.txt
```
Device Tree Clock bindings for ATL (Audio Tracking Logic) of DRA7 SoC.

The ATL IP is used to generate clock to be used to synchronize baseband and
audio codec. A single ATL IP provides four ATL clock instances sharing the same
functional clock but can be configured to provide different clocks.
ATL can maintain a clock averages to some desired frequency based on the bws/aws
signals - can compensate the drift between the two ws signal.

In order to provide the support for ATL and its output clocks (which can be used
internally within the SoC or external components) two sets of bindings is needed:


Binding for the IP driver:
This binding is used to configure the IP driver which is going to handle the
configuration of the IP for the ATL clock instances.

Required properties:
- compatible : shall be "ti,dra7-atl"
- reg : base address for the ATL IP
- ti,provided-clocks : List of phandles to the clocks associated with the ATL
- clocks : link phandles to functional clock of ATL
- clock-names : Shall be set to "fck"
- ti,hwmods : Shall be set to "atl"

Optional properties:
Configuration of ATL instances:
- atl{0/1/2/3} {
	- bws : Baseband word select signal selection
	- aws : Audio word select signal selection
};

For valid word select signals, see the dt-bindings/clock/ti-dra7-atl.h include
file.

Examples:

/* binding for the IP */
atl: atl@4843c000 {
	compatible = "ti,dra7-atl";
	reg = <0x4843c000 0x3ff>;
	ti,hwmods = "atl";
	ti,provided-clocks = <&atl_clkin0_ck>, <&atl_clkin1_ck>,
				<&atl_clkin2_ck>, <&atl_clkin3_ck>;
	clocks = <&atl_gfclk_mux>;
	clock-names = "fck";
};

#include <dt-bindings/clock/ti-dra7-atl.h>

&atl {

	atl2 {
		bws = <DRA7_ATL_WS_MCASP2_FSX>;
		aws = <DRA7_ATL_WS_MCASP3_FSX>;
	};
};
```

## Documentation/devicetree/bindings/display/kieweg,gpu.yaml
```yaml
# SPDX-License-Identifier: (GPL-2.0-only OR BSD-2-Clause)
%YAML 1.2
---
$id: http://devicetree.org/schemas/display/kieweg,gpu.yaml#
$schema: http://devicetree.org/meta-schemas/core.yaml#

title: GlandaGPU 2D Hardware Accelerated Display Controller

maintainers:
  - Leander Kieweg <kieweg.leander@gmail.com>

description: |
  GlandaGPU is a custom FPGA soft-IP core providing a simple
  2D hardware-accelerated drawing engine with a VGA-compatible
  display output. The register window covers a combined VRAM + MMIO
  region, with MMIO registers at a fixed offset within it.

  For hardware designs and RTL sources, see:
  https://github.com/stiangglanda/GlandaGPU

properties:
  compatible:
    const: kieweg,gpu-1.0

  reg:
    maxItems: 1
    description:
      Combined VRAM + MMIO register window (VRAM at offset 0,
      MMIO registers at offset 0x00200000 within this range).

  interrupts:
    maxItems: 1

  clocks:
    maxItems: 1
    description: Bus and pixel clock provided to the FPGA IP.

required:
  - compatible
  - reg
  - interrupts
  - clocks

additionalProperties: false

examples:
  - |
    #include <dt-bindings/interrupt-controller/arm-gic.h>

    gpu@c0000000 {
        compatible = "kieweg,gpu-1.0";
        reg = <0xc0000000 0x1000000>;
        interrupt-parent = <&intc>;
        interrupts = <GIC_SPI 43 IRQ_TYPE_LEVEL_HIGH>;
        clocks = <&osc1>;
    };
```

## Documentation/devicetree/bindings/display/panel/hit,tx10d07vm0baa.yaml
```yaml
# SPDX-License-Identifier: (GPL-2.0-only OR BSD-2-Clause)
%YAML 1.2
---
$id: http://devicetree.org/schemas/display/panel/hit,tx10d07vm0baa.yaml#
$schema: http://devicetree.org/meta-schemas/core.yaml#

title: Hitachi/LG 4" WVGA TFT LCD panel

maintainers:
  - Svyatoslav Ryhel <clamor95@gmail.com>

allOf:
  - $ref: panel-common.yaml#

properties:
  compatible:
    items:
      - enum:
          - hit,tx10d07vm0baa
          - lg,lh400wv3-sd04

  avci-supply:
    description: Panel power supply

  iovcc-supply:
    description: I/O voltage supply

  reset-gpios: true

  backlight: true
  port: true

required:
  - compatible

additionalProperties: false

examples:
  - |
    #include <dt-bindings/gpio/gpio.h>

    panel {
        compatible = "lg,lh400wv3-sd04";

        reset-gpios = <&gpio 175 GPIO_ACTIVE_LOW>;

        avci-supply = <&vcc_2v8_lcd>;
        iovcc-supply = <&iovcc_1v8_lcd>;

        backlight = <&backlight>;

        port {
            endpoint {
                remote-endpoint = <&dbi_out>;
            };
        };
    };
...
```

## Documentation/devicetree/bindings/display/panel/novatek,nt36672a.yaml
```yaml
# SPDX-License-Identifier: GPL-2.0-only OR BSD-2-Clause
%YAML 1.2
---
$id: http://devicetree.org/schemas/display/panel/novatek,nt36672a.yaml#
$schema: http://devicetree.org/meta-schemas/core.yaml#

title: Novatek NT36672A based DSI display Panels

maintainers:
  - Sumit Semwal <sumit.semwal@linaro.org>

description: |
  The NT36672A IC from Novatek is a generic DSI Panel IC used to drive dsi
  panels.

allOf:
  - $ref: panel-common.yaml#

properties:
  compatible:
    items:
      - enum:
          - shenchao,fhdplus-video
          - tianma,fhd-video
          - tianma,tl060fvxs16-00
          - tianma,tl063fvmc43-02
          - tianma,tl063fvmca01-00
          - txdkj,txdi600yanpa-43v3
      - const: novatek,nt36672a
    description: This indicates the panel manufacturer of the panel that is
      in turn using the NT36672A panel driver. This compatible string
      determines how the NT36672A panel driver is configured for the indicated
      panel. The novatek,nt36672a compatible shall always be provided as a fallback.

  reg:
    maxItems: 1

  reset-gpios:
    maxItems: 1
    description: phandle of gpio for reset line - This should be 8mA, gpio
      can be configured using mux, pinctrl, pinctrl-names (active high)

  vddio-supply:
    description: phandle of the regulator that provides the supply voltage
      Power IC supply

  vddpos-supply:
    description: phandle of the positive boost supply regulator

  vddneg-supply:
    description: phandle of the negative boost supply regulator

required:
  - compatible
  - reg
  - vddio-supply
  - vddpos-supply
  - vddneg-supply
  - reset-gpios
  - port

unevaluatedProperties: false

examples:
  - |+
    #include <dt-bindings/gpio/gpio.h>

    dsi0 {
        #address-cells = <1>;
        #size-cells = <0>;

        panel@0 {
            compatible = "tianma,fhd-video", "novatek,nt36672a";
            reg = <0>;
            vddio-supply = <&vreg_l14a_1p88>;
            vddpos-supply = <&lab>;
            vddneg-supply = <&ibb>;

            backlight = <&pmi8998_wled>;
            reset-gpios = <&tlmm 6 GPIO_ACTIVE_HIGH>;

            port {
                tianma_nt36672a_in_0: endpoint {
                    remote-endpoint = <&dsi0_out>;
                };
            };
        };
    };

...
```

## Documentation/devicetree/bindings/display/panel/novatek,nt37705.yaml
```yaml
# SPDX-License-Identifier: GPL-2.0-only OR BSD-2-Clause
%YAML 1.2
---
$id: http://devicetree.org/schemas/display/panel/novatek,nt37705.yaml#
$schema: http://devicetree.org/meta-schemas/core.yaml#

title: Novatek NT37705-based DSI display panels

maintainers:
  - Luca Weiss <luca.weiss@fairphone.com>

description:
  The Novatek NT37705 is a generic DSI Panel IC used to control AMOLED panels.

allOf:
  - $ref: panel-common.yaml#

properties:
  compatible:
    const: boe,bj631jhm-t71-d900

  reg:
    maxItems: 1

  vddio-supply:
    description: I/O voltage rail

  dvdd-supply:
    description: Digital voltage rail

  vci-supply:
    description: Analog voltage rail

required:
  - compatible
  - reg
  - reset-gpios
  - vddio-supply
  - dvdd-supply
  - vci-supply
  - port

unevaluatedProperties: false

examples:
  - |
    #include <dt-bindings/gpio/gpio.h>

    dsi {
        #address-cells = <1>;
        #size-cells = <0>;

        panel@0 {
            compatible = "boe,bj631jhm-t71-d900";
            reg = <0>;

            reset-gpios = <&tlmm 12 GPIO_ACTIVE_LOW>;

            vci-supply = <&vreg_l19b>;
            vddio-supply = <&vreg_l9b>;
            dvdd-supply = <&vreg_oled_dvdd_1p2>;

            port {
                panel_in_0: endpoint {
                    remote-endpoint = <&dsi0_out>;
                };
            };
        };
    };

...
```
