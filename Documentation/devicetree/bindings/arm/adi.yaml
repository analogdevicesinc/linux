## Documentation/devicetree/bindings/display/panel/samsung,ams644vk04.yaml
```yaml
# SPDX-License-Identifier: GPL-2.0-only OR BSD-2-Clause
%YAML 1.2
---
$id: http://devicetree.org/schemas/display/panel/samsung,ams644vk04.yaml#
$schema: http://devicetree.org/meta-schemas/core.yaml#

title: Samsung AMS644VK04 1080x2400 MIPI-DSI Panel

maintainers:
  - Ishu Brar <patches@brar.si>

description:
  The Samsung AMS644VK04 is a 6.44 inch 1080x2400 MIPI-DSI command mode AMOLED
  panel with DSC, supporting 60 Hz and 90 Hz refresh rates. It is used in the
  OnePlus Nord.

allOf:
  - $ref: panel-common.yaml#

properties:
  compatible:
    const: samsung,ams644vk04

  reg:
    maxItems: 1

  vddio-supply:
    description: I/O voltage rail (1.8 V)

  vdd-supply:
    description: Panel logic voltage rail (3.0 V)

  vout-supply:
    description: Panel supply rail (1.28 V)

  reset-gpios: true
  port: true

required:
  - compatible
  - reg
  - vddio-supply
  - vdd-supply
  - vout-supply
  - reset-gpios
  - port

additionalProperties: false

examples:
  - |
    #include <dt-bindings/gpio/gpio.h>

    dsi {
        #address-cells = <1>;
        #size-cells = <0>;

        panel@0 {
            compatible = "samsung,ams644vk04";
            reg = <0>;

            reset-gpios = <&pm8150l_gpios 3 GPIO_ACTIVE_LOW>;

            vdd-supply = <&vreg_l18a_3p0>;
            vddio-supply = <&vreg_l13a_1p8>;
            vout-supply = <&vreg_l7a_1p28>;

            port {
                endpoint {
                    remote-endpoint = <&mdss_dsi0_out>;
                };
            };
        };
    };

...
```

## Documentation/devicetree/bindings/display/panel/truly,wqhd60-nt36850.yaml
```yaml
# SPDX-License-Identifier: GPL-2.0-only OR BSD-2-Clause
%YAML 1.2
---
$id: http://devicetree.org/schemas/display/panel/truly,wqhd60-nt36850.yaml#
$schema: http://devicetree.org/meta-schemas/core.yaml#

title: Truly WQHD panel based on the Novatek NT36850

maintainers:
  - Dmitry Baryshkov <dmitry.baryshkov@oss.qualcomm.com>

description:
  Truly 5.7" 1440x2560 60 Hz LCD panel driven by the Novatek NT36850
  controller. It is a command mode panel using two DSI links and it is found
  on the display cards for Qualcomm hardware development kits.

allOf:
  - $ref: panel-common-dual.yaml#

properties:
  compatible:
    const: truly,wqhd60-nt36850

  reg:
    maxItems: 1

  reset-gpios:
    maxItems: 1

  vddio-supply:
    description: I/O voltage supply

  avdd-supply:
    description: positive bias supply

  avee-supply:
    description: negative bias supply

  ports:
    required:
      - port@0
      - port@1

required:
  - compatible
  - reg
  - reset-gpios
  - vddio-supply
  - avdd-supply
  - avee-supply
  - ports

unevaluatedProperties: false

examples:
  - |
    #include <dt-bindings/gpio/gpio.h>

    dsi {
        #address-cells = <1>;
        #size-cells = <0>;

        panel@0 {
            compatible = "truly,wqhd60-nt36850";
            reg = <0>;

            reset-gpios = <&tlmm 6 GPIO_ACTIVE_LOW>;

            vddio-supply = <&vreg_l14a_1p8>;
            avdd-supply = <&lcdb_ldo>;
            avee-supply = <&lcdb_ncp>;

            backlight = <&wled>;

            ports {
                #address-cells = <1>;
                #size-cells = <0>;

                port@0 {
                    reg = <0>;

                    panel_in_0: endpoint {
                        remote-endpoint = <&dsi0_out>;
                    };
                };

                port@1 {
                    reg = <1>;

                    panel_in_1: endpoint {
                        remote-endpoint = <&dsi1_out>;
                    };
                };
            };
        };
    };

...
```

## Documentation/devicetree/bindings/display/ti/ti,am62l-dss.yaml
```yaml
# SPDX-License-Identifier: (GPL-2.0 OR BSD-2-Clause)
# Copyright 2026 Texas Instruments Incorporated
%YAML 1.2
---
$id: http://devicetree.org/schemas/display/ti/ti,am62l-dss.yaml#
$schema: http://devicetree.org/meta-schemas/core.yaml#

title: Texas Instruments AM62L Display Subsystem

maintainers:
  - Tomi Valkeinen <tomi.valkeinen@ti.com>

description: |
  The AM62L display subsystem is a cut-down version of the TI Keystone
  Display SubSystem. It has a single output port which supports DPI
  format and a single video "lite plane" which does not support scaling.
  The output port is routed to the SoC boundary via the DPI interface,
  and the same DPI signals are also routed internally to the DSI Tx
  controller present within the SoC. Due to clocking limitations only
  one of the interfaces (DSI or DPI) can be used at a time.

properties:
  compatible:
    const: ti,am62l-dss

  reg:
    description:
      Addresses to each DSS memory region described in the SoC's TRM.
    items:
      - description: common DSS register area
      - description: VIDL1 light video plane
      - description: OVR1 overlay manager for vp1
      - description: VP1 video port 1
      - description: common1 DSS register area

  reg-names:
    items:
      - const: common
      - const: vidl1
      - const: ovr1
      - const: vp1
      - const: common1

  clocks:
    items:
      - description: fck DSS functional clock
      - description: vp1 Video Port 1 pixel clock

  clock-names:
    items:
      - const: fck
      - const: vp1

  assigned-clocks:
    minItems: 1
    maxItems: 2

  assigned-clock-parents:
    minItems: 1
    maxItems: 2

  interrupts:
    maxItems: 1

  power-domains:
    maxItems: 1
    description: phandle to the associated power domain

  dma-coherent: true

  ports:
    $ref: /schemas/graph.yaml#/properties/ports

    properties:
      port@0:
        $ref: /schemas/graph.yaml#/properties/port
        description:
          The DSS DPI output port node from video port 1, which may be
          connected to the external DPI pins or to the internal DSI Tx
          controller.

    required:
      - port@0

  max-memory-bandwidth:
    $ref: /schemas/types.yaml#/definitions/uint32
    description:
      Input memory (from main memory to dispc) bandwidth limit in
      bytes per second

required:
  - compatible
  - reg
  - reg-names
  - clocks
  - clock-names
  - interrupts
  - ports

additionalProperties: false

examples:
  - |
    #include <dt-bindings/interrupt-controller/arm-gic.h>
    #include <dt-bindings/interrupt-controller/irq.h>

    bus {
        #address-cells = <2>;
        #size-cells = <2>;

        dss: dss@30200000 {
            compatible = "ti,am62l-dss";
            reg = <0x00 0x30200000 0x00 0x1000>, /* common */
                  <0x00 0x30202000 0x00 0x1000>, /* vidl1 */
                  <0x00 0x30207000 0x00 0x1000>, /* ovr1 */
                  <0x00 0x3020a000 0x00 0x1000>, /* vp1 */
                  <0x00 0x30201000 0x00 0x1000>; /* common1 */
            reg-names = "common", "vidl1", "ovr1", "vp1", "common1";
            power-domains = <&scmi_pds 39>;
            clocks = <&scmi_clk 162>,
                     <&scmi_clk 161>;
            clock-names = "fck", "vp1";
            interrupts = <GIC_SPI 60 IRQ_TYPE_LEVEL_HIGH>;

            ports {
                #address-cells = <1>;
                #size-cells = <0>;
                port@0 {
                    reg = <0>;
                    dpi0_out: endpoint {
                        remote-endpoint = <&dsi_in>;
                    };
                };
            };
        };
    };
```

## Documentation/devicetree/bindings/embedded-controller/asus,tf201-ec-pad.yaml
```yaml
# SPDX-License-Identifier: (GPL-2.0 OR BSD-2-Clause)
%YAML 1.2
---
$id: http://devicetree.org/schemas/embedded-controller/asus,tf201-ec-pad.yaml#
$schema: http://devicetree.org/meta-schemas/core.yaml#

title: ASUS Transformer's Embedded Controller

description:
  Several Nuvoton based Embedded Controllers attached to an I2C bus,
  running a custom ASUS firmware, specific to the ASUS Transformer
  device series.

maintainers:
  - Svyatoslav Ryhel <clamor95@gmail.com>

properties:
  compatible:
    description:
      The 'pad' suffix is used for the controller within the tablet, while
      the 'dock' suffix refers to the controller in the mobile dock keyboard.
    oneOf:
      - enum:
          - asus,sl101-ec-dock
          - asus,tf101-ec-dock
          - asus,tf201-ec-pad
          - asus,tf600t-ec-dock
          - asus,tf600t-ec-pad

      - items:
          - enum:
              - asus,tf101g-ec-dock
              - asus,tf201-ec-dock
              - asus,tf300t-ec-dock
              - asus,tf300tg-ec-dock
              - asus,tf300tl-ec-dock
              - asus,tf700t-ec-dock
          - const: asus,tf101-ec-dock

      - items:
          - enum:
              - asus,tf300t-ec-pad
              - asus,tf300tg-ec-pad
              - asus,tf300tl-ec-pad
              - asus,tf700t-ec-pad
          - const: asus,tf201-ec-pad

      - items:
          - enum:
              - asus,tf701t-ec-dock
          - const: asus,tf600t-ec-dock

      - items:
          - enum:
              - asus,p1801-t-ec-pad
              - asus,tf701t-ec-pad
          - const: asus,tf600t-ec-pad

  reg:
    description:
      The ASUS Transformer EC has a main I2C address and an associated
      DockRAM device, which provides power-related functions for the
      embedded controller. Both addresses are required for operation.
    minItems: 2

  reg-names:
    items:
      - const: ec
      - const: dockram

  interrupts:
    maxItems: 1

  request-gpios:
    maxItems: 1

required:
  - compatible
  - reg
  - reg-names

allOf:
  - $ref: /schemas/power/supply/power-supply.yaml
  - if:
      properties:
        compatible:
          not:
            contains:
              const: asus,tf600t-ec-dock
    then:
      required:
        - interrupts
        - request-gpios

unevaluatedProperties: false

examples:
  - |
    #include <dt-bindings/gpio/gpio.h>
    #include <dt-bindings/interrupt-controller/irq.h>

    i2c {
      #address-cells = <1>;
      #size-cells = <0>;

      embedded-controller@19 {
        compatible = "asus,tf201-ec-dock", "asus,tf101-ec-dock";
        reg = <0x19>, <0x1b>;
        reg-names = "ec", "dockram";

        interrupt-parent = <&gpio>;
        interrupts = <151 IRQ_TYPE_LEVEL_LOW>;

        request-gpios = <&gpio 134 GPIO_ACTIVE_LOW>;

        monitored-battery = <&dock_battery>;
      };
    };
...
```

## Documentation/devicetree/bindings/embedded-controller/asus,zenbook-a16-ux3607oa-ec.yaml
```yaml
# SPDX-License-Identifier: (GPL-2.0-only OR BSD-2-Clause)
%YAML 1.2
---
$id: http://devicetree.org/schemas/embedded-controller/asus,zenbook-a16-ux3607oa-ec.yaml#
$schema: http://devicetree.org/meta-schemas/core.yaml#

title: ASUS Zenbook A16 (UX3607OA)-class Embedded Controller

maintainers:
  - Konrad Dybcio <konradybcio@kernel.org>

description:
  The Qualcomm Snapdragon X2 series-based ASUS Zenbook A16 (and similar
  machines) come with a custom EC firmware, loosely based on the
  Qualcomm reference ("Hamoa CRD EC") implementation, with a lot of
  customization.

properties:
  compatible:
    enum:
      - asus,zenbook-a14-ux3407na-ec
      - asus,zenbook-a16-ux3607oa-ec

  reg:
    const: 0x76

  interrupts:
    maxItems: 1

  "#thermal-sensor-cells":
    const: 1

  wakeup-source: true

required:
  - compatible
  - reg
  - interrupts
  - '#thermal-sensor-cells'

additionalProperties: false

examples:
  - |
    #include <dt-bindings/interrupt-controller/irq.h>
    i2c {
        #address-cells = <1>;
        #size-cells = <0>;

        embedded-controller@76 {
            compatible = "asus,zenbook-a16-ux3607oa-ec";
            reg = <0x76>;

            interrupts-extended = <&tlmm 66 IRQ_TYPE_EDGE_FALLING>;

            pinctrl-0 = <&ec_int_n_default>;
            pinctrl-names = "default";

            #thermal-sensor-cells = <1>;

            wakeup-source;
        };
    };
...
```
