## Documentation/devicetree/bindings/arm/mali-coresight-source.txt
```
# SPDX-License-Identifier: GPL-2.0 WITH Linux-syscall-note
#
# (C) COPYRIGHT 2023 ARM Limited. All rights reserved.
#
# This program is free software and is provided to you under the terms of the
# GNU General Public License version 2 as published by the Free Software
# Foundation, and any use by you of this program is subject to the terms
# of such GNU license.
#
# This program is distributed in the hope that it will be useful,
# but WITHOUT ANY WARRANTY; without even the implied warranty of
# MERCHANTABILITY or FITNESS FOR A PARTICULAR PURPOSE. See the
# GNU General Public License for more details.
#
# You should have received a copy of the GNU General Public License
# along with this program; if not, you can access it online at
# http://www.gnu.org/licenses/gpl-2.0.html.
#
#
=====================================
ARM CoreSight Mali Source integration
=====================================

See Documentation/trace/coresight/coresight.rst for detailed information
about Coresight.

This documentation will cover Mali specific devicetree integration.

References to Sink ports are given as examples. Access to Sink is specific
to an implementation and would require dedicated kernel modules.

ARM Coresight Mali Source ITM
=============================

Required properties
-------------------

- compatible: Has to be "arm,coresight-mali-source-itm"
- gpu : phandle to a Mali GPU definition
- port:
  - endpoint:
    - remote-endpoint: phandle to a Coresight sink port

Example
-------

mali-source-itm {
  compatible = "arm,coresight-mali-source-itm";
  gpu = <&gpu>;
  port {
    mali_source_itm_out_port0: endpoint {
      remote-endpoint = <&mali_sink_in_port0>;
    };
  };
};

ARM Coresight Mali Source ETM
=============================

Required properties
-------------------

- compatible: Has to be "arm,coresight-mali-source-etm"
- gpu : phandle to a Mali GPU definition
- port:
  - endpoint:
    - remote-endpoint: phandle to a Coresight sink port

Example
-------

mali-source-etm {
  compatible = "arm,coresight-mali-source-etm";
  gpu = <&gpu>;
  port {
    mali_source_etm_out_port0: endpoint {
      remote-endpoint = <&mali_sink_in_port1>;
    };
  };
};

ARM Coresight Mali Source ELA
=============================

Required properties
-------------------

- compatible: Has to be "arm,coresight-mali-source-ela"
- gpu : phandle to a Mali GPU definition
- port:
  - endpoint:
    - remote-endpoint: phandle to a Coresight sink port

Example: Split JCN request/response channel
--------------------------------------------

This examples applies to implementations with a total of 5 signal groups,
where JCN request and response are assigned to independent or shared
channels depending on the GPU model.

mali-source-ela {
  compatible = "arm,coresight-mali-source-ela";
  gpu = <&gpu>;
  port {
    mali_source_ela_out_port0: endpoint {
      remote-endpoint = <&mali_sink_in_port2>;
    };
  };
};

SysFS Configuration
--------------------------------------------

The register values used by CoreSight for ELA can be configured using SysFS
interfaces. This implicitly includes configuring the ELA for independent or
shared JCN request and response channels.
```

## Documentation/devicetree/bindings/clock/adi,ad242x-clk.yaml
```yaml
# SPDX-License-Identifier: (GPL-2.0 OR BSD-2-Clause)
%YAML 1.2
---
$id: "http://devicetree.org/schemas/clock/adi,ad242x-clk.yaml#"
$schema: "http://devicetree.org/meta-schemas/core.yaml#"

title: Analog Devices AD242x clock provider

maintainers:
  - Daniel Mack <daniel@zonque.org>

description: |
  This module is part of the AD242x MFD device. For more details and an example
  refer to Documentation/devicetree/bindings/mfd/ad242x.yaml.

properties:
  compatible:
    enum:
      - adi,ad2428w-clk

  '#clock-cells':
    const: 1

  clock-output-names:
    minItems: 2
    maxItems: 2
    description: |
      Array of two strings to use as names for the generated output clocks

required:
  - compatible
  - '#clock-cells'
```

## Documentation/devicetree/bindings/clock/adi,adf4360.txt
```
* Analog Devices ADF4360 PLL

The ADF4360 devices are a family of PLLs with integrated VCO and integer-N frequency
synthesizer. Each of the parts in the family has a specific frequency range that
is supported by its respective internal VCO.

The device has a reference clock input and a clock output that has the generated
frequency.

An external loop filter is required on the PCB to control the loop of the
phase-frequency-detector of the PLL. The charge pump current and the
phase-frequency-detector frequency need to be configured according to the
requirements for which the external loop filter was designed.

The device offers a write-only SPI interface to configure it.

The devicetree bindings for this device follow the standard bindings for SPI
devices (../spi/spi.txt) and clock consumers and providers (clock-bindings.txt).

Required properties:

- compatible: must be one of
    * adi,adf4360-0
    * adi,adf4360-1
    * adi,adf4360-2
    * adi,adf4360-3
    * adi,adf4360-4
    * adi,adf4360-5
    * adi,adf4360-6
    * adi,adf4360-7
    * adi,adf4360-8
    * adi,adf4360-9
- reg: SPI chip select number for the device
- spi-max-frequency: Max SPI frequency to use (< 20000000)
- #clock-cells: Must should be 0.
- clock-output-names:
- clocks: Phandle and optional specifier to clock node that describes the
    reference input clock

- adi,loop-filter-pfd-frequency-hz: The frequency of the
    phase-frequency-detector that the external loop filter was designed for.
- adi,loop-filter-charger-pump-current: The charge pump current that the
    external loop filter was designed for.

Optional properties:
- adi,loop-filter-inverting: Indicates that the external loop filter is a
    inverting filter.

Required properties for ADF4360-7, ADF4360-8 and ADF4360-9:
  ADF4360-7 to ADF4360-9 have a VCO that is tuned to a specific frequency range
  using an external inductor placed on the PCB. These properties describe the
  range selected by the external inductor.

- adi,vco-minimum-frequency-hz: Minimum VCO frequency that can be supported by
    the tuning range set by the external inductor.
- adi,vco-maximum-frequency-hz: Maximum VCO frequency that can be supported by
    the tuning range set by the external inductor.

Example:

&spi {
	pll@0 {
		compatible = "adi,adf4360-7";
		reg = <0>;
		spi-max-frequency = <2000000>;

		#clock-cells = <0>;
		clock-output-names = "adf4360-7";

		clocks = <&ref_clock>;

		adi,loop-filter-charge-pump-current = <5>;
		adi,loop-filter-pfd-frequency-hz = <2500000>;
		adi,vco-minimum-frequency-hz = <700000000>;
		adi,vco-maximum-frequency-hz = <840000000>;
	};
};
```

## Documentation/devicetree/bindings/clock/altr,c5-fpll.yaml
```yaml
# SPDX-License-Identifier: (GPL-2.0-only OR BSD-2-Clause)
%YAML 1.2
---
$id: http://devicetree.org/schemas/clock/altr,c5-fpll.yaml#
$schema: http://devicetree.org/meta-schemas/core.yaml#

title: Altera Cyclone V Fractional PLL

maintainers:
  - Liviu Adace <liviu.adace@analog.com>

description: |
  Intel/Altera Cyclone V fPLL driver is recalculating the VCO
  settings each time a new channel's frequency is requested so
  the desired value can be actually obtained and is recalculating
  the dividers for the other channels to obtain the closest possible
  values to the previously set values.

properties:
  compatible:
    enum:
      - altr,c5-fpll

  "#clock-cells":
    const: 1

  "#address-cells":
    const: 1

  "#size-cells":
    const: 0

  reg:
    maxItems: 1

  clocks:
    description: |
      Clock specifier which is external input clock to the given fPLL.
    maxItems: 1

  assigned-clocks:
    maxItems: 9

  assigned-clock-rates:
    maxItems: 9

  clock-output-names:
    description: |
      Names of the output channels for each of the 9 channels.
    items:
      - const: c5_out0
      - const: c5_out1
      - const: c5_out2
      - const: c5_out3
      - const: c5_out4
      - const: c5_out5
      - const: c5_out6
      - const: c5_out7
      - const: c5_out8

  adi,fractional-carry-bit:
    description: |
      Fractional carry bit with a default value of
      24 that cannot be reconfigured during PLL reconfiguration.
    $ref: /schemas/types.yaml#/definitions/uint32
    enum: [8, 16, 24, 32]

patternProperties:
  "^channel@([0-8])$":
    description: |
      Represents an output channel of the fPLL.
    type: object

    properties:
      reg:
        maximum: 8

      adi,extended-name:
        description: |
          fPLL channel name
        $ref: /schemas/types.yaml#/definitions/string

    required:
      - reg
      - adi,extended-name

additionalProperties: false

required:
  - compatible
  - "#clock-cells"
  - "#address-cells"
  - "#size-cells"
  - reg
  - clocks
  - assigned-clocks
  - assigned-clock-rates
  - clock-output-names
  - adi,fractional-carry-bit

examples:
  - |
    pixel_clock: fpll@0x00100000 {
      #clock-cells = <0x1>;
      compatible = "altr,c5-fpll";
      reg = <0x00100000 0x00000100>;
      #address-cells = <1>;
      #size-cells = <0>;
      clocks = <&ref_clk>;
      assigned-clocks = <&pixel_clock 0>, <&pixel_clock 1>;
      assigned-clock-rates = <148500000>, <100000000>;
      clock-output-names = "c5_out0", "c5_out1", "c5_out2",
                           "c5_out3", "c5_out4", "c5_out5",
                           "c5_out6", "c5_out7", "c5_out8";
      adi,fractional-carry-bit = <32>;

      fpll_c0: channel@0 {
        reg = <0>;
        adi,extended-name = "PIXEL_CLOCK";
      };

      fpll_c1: channel@1 {
        reg = <1>;
        adi,extended-name = "DMA_CLOCK";
      };
    };

...
```

## Documentation/devicetree/bindings/clock/axi-clkgen.txt
```
Binding for the axi-clkgen clock generator

This binding uses the common clock binding[1].

[1] Documentation/devicetree/bindings/clock/clock-bindings.txt

Required properties:
- compatible : shall be "adi,axi-clkgen-1.00.a" or "adi,axi-clkgen-2.00.a".
- #clock-cells : from common clock binding; Should always be set to 0.
- reg : Address and length of the axi-clkgen register set.
- clocks : Phandle and clock specifier for the axi control clock and MMCM input
           clocks. The MMCM input clocks must either reference one clock if only the
	   first clock input is connected or two if both inputs are connected.
- clock-names: Should be "s_axi_aclk" for the axi control clock, and "clkin1"
	       and "clkin2" for the MMCM input clocks (only one clkin is
	       required).

Optional properties:
- clock-output-names : From common clock binding.

Example:
	clock@ff000000 {
		compatible = "adi,axi-clkgen";
		#clock-cells = <0>;
		reg = <0xff000000 0x1000>;
		clocks = <&clk 71>, <&osc 1>;
		clock-names = "s_axi_acl", "clkin1";
	};
```
