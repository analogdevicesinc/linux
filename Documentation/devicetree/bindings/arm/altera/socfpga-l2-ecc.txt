## Documentation/devicetree/bindings/arm/altera/socfpga-l2-ecc.txt
```
Altera SoCFPGA L2 cache Error Detection and Correction [EDAC]

Required Properties:
- compatible : Should be "altr,l2-edac" for Cyclone V, and should be
	"altr,a10-l2-edac" for Arria 10.
- reg : Address and size for ECC error interrupt clear registers.
- interrupts : Should be single bit error interrupt, then double bit error
	interrupt. Note the rising edge type for Cyclone V, and the level type
	for Arria 10.

Example:

	l2edac@xffd08140 {
		compatible = "altr,l2-edac";
		reg = <0xffd08140 0x4>;
		interrupts = <0 36 1>, <0 37 1>;
	};

	l2edac@ffd06000 {
		compatible = "altr,a10-l2-edac";
		reg = <0xffd06000 0x200>;
		interrupts = <0 2 4>, <0 0 4>;
	};
```

## Documentation/devicetree/bindings/arm/altera/socfpga-nand-ecc.txt
```
Altera SoCFPGA NAND Flash Controller FIFOs Error Detection and Correction [EDAC]

The Altera Arria 10 NAND flash controller has three local SRAM memory buffers:
the write FIFO buffer, the read FIFO buffer and the ECC buffer.
Each of these memories is protected by error checking and correction (ECC),
and by interrupts for single and double-bit errors.

NAND ECC Required Properties:
- compatible : Should be "altr,socfpga-a10-nand-buf-ecc" for the ECC buffer
	or "altr,socfpga-a10-nand-rd-ecc" for the read FIFO buffer
	or "altr,socfpga-a10-nand-wr-ecc" for the write FIFO buffer.
- reg : Address and size for ECC error interrupt status and clear registers.
- parent : phandle to parent NAND DT

Example:
	nandecc_buf@ff8c2000 {
		compatible = "altr,socfpga-a10-nand-buf-ecc";
		reg = <0xff8c2000 0x400>;
		parent = <&nand>;
	};

	nandecc_rd@ff8c2400 {
		compatible = "aaltr,socfpga-a10-nand-rd-ecc";
		reg = <0xff8c2400 0x400>;
		parent = <&nand>;
	};

	nandecc_wr@ff8c2800 {
		compatible = "altr,socfpga-a10-nand-wr-ecc";
		reg = <0xff8c2800 0x400>;
		parent = <&nand>;
	};
```

## Documentation/devicetree/bindings/arm/altera/socfpga-ocram-ecc.txt
```
Altera SoCFPGA On-Chip RAM Error Detection and Correction [EDAC]

OCRAM ECC Required Properties:
- compatible : Should be "altr,ocram-edac" for Cyclone V, and should be
	"altr,a10-ocram-edac" for Arria 10.
- reg : Address and size for ECC error interrupt clear registers.
- iram : phandle to On-Chip RAM definition.
- interrupts : Should be single bit error interrupt, then double bit error
	interrupt. Note the rising edge type for Cyclone V, and the level type
	for Arria 10.

Example:
	ocramedac@ffd08144 {
		compatible = "altr,ocram-edac";
		reg = <0xffd08144 0x4>;
		iram = <&ocram>;
		interrupts = <0 178 1>, <0 179 1>;
	};

	ocramedac@ff8c3000 {
		compatible = "altr,a10-ocram-edac";
		reg = <0xff8c3000 0x5000>;
		iram = <&ocram>;
		interrupts = <0 2 4>, <0 0 4>;
	};
```

## Documentation/devicetree/bindings/arm/altera/socfpga-reset.txt
```
Altera SOCFPGA Reset Manager

Required properties:
- compatible : "altr,rst-mgr", "syscon";
                Note that syscon is invoked for this device to support the FPGA
		bridge driver and possibly other devices in the future.  See
		also Documentation/devicetree/bindings/mfd/syscon.txt
- reg : Should contain 1 register ranges(address and length)

Example:
	 rstmgr@ffd05000 {
		compatible = "altr,rst-mgr", "syscon";
		reg = <0xffd05000 0x1000>;
	};
```

## Documentation/devicetree/bindings/arm/analog/adi,sc5xx.yaml
```yaml
# SPDX-License-Identifier: (GPL-2.0-only OR BSD-2-Clause)
%YAML 1.2
---
$id: http://devicetree.org/schemas/arm/analog/adi,sc5xx.yaml#
$schema: http://devicetree.org/meta-schemas/core.yaml#

title: Analog Devices SC59X 64-Bit ARM-based Processor Families

maintainers:
  - Arturs Artamonovs <arturs.artamonovs@analog.com>
  - Utsav Agarwal <Utsav.Agarwal@analog.com>

properties:
  $nodename:
    const: '/'
  compatible:
    description: SC59X 64-Bit Boards
    items:
      - enum:
          - adi,sc598-som-ezkit                # Analog Devices SC598 EZKit
      - const: adi,sc59x-64

additionalProperties: true
```

## Documentation/devicetree/bindings/arm/arm,coresight-mali-source.yaml
```yaml
# SPDX-License-Identifier: GPL-2.0 WITH Linux-syscall-note
#
# (C) COPYRIGHT 2022-2024 ARM Limited. All rights reserved.
#
# This program is free software and is provided to you under the terms of the
# GNU General Public License version 2 as published by the Free Software
# Foundation, and any use by you of this program is subject to the terms
# of such GNU license.
#
# This program is distributed in the hope that it will be useful,
# but WITHOUT ANY WARRANTY; without even the implied warranty of
# MERCHANTABILITY or FITNESS FOR A PARTICULAR PURPOSE. See the
# GNU General Public License for more details.
#
# You should have received a copy of the GNU General Public License
# along with this program; if not, you can access it online at
# http://www.gnu.org/licenses/gpl-2.0.html.
#
#
%YAML 1.2
---
$id: http://devicetree.org/schemas/arm/arm,coresight-mali-source.yaml#
$schema: http://devicetree.org/meta-schemas/core.yaml#

title: ARM CoreSight Mali Source integration

maintainers:
  - ARM Ltd.

description: |
  See Documentation/trace/coresight/coresight.rst for detailed information
  about Coresight.

  This documentation will cover Mali specific devicetree integration.

  References to Sink ports are given as examples. Access to Sink is specific
  to an implementation and would require dedicated kernel modules.

  Arm Mali GPU are supporting 3 different sources: ITM, ETM, ELA

  ELA source configuration via SysFS entries:

    The register values used by CoreSight for ELA can be configured using SysFS
    interfaces. This implicitly includes configuring the ELA for independent or
    shared JCN request and response channels.

properties:
  compatible:
    enum:
      - arm,coresight-mali-source-itm
      - arm,coresight-mali-source-etm
      - arm,coresight-mali-source-ela

  gpu:
    minItems: 1
    maxItems: 1
    description:
      Phandle to a Mali GPU definition

  port:
    description:
      Output connection to CoreSight Sink Trace bus.

      Legacy binding between Coresight Sources and CoreSight Sink.
      For Linux kernel < v4.20.
    $ref: /schemas/graph.yaml#/properties/port

  out-ports:
    description:
      Binding between Coresight Sources and CoreSight Sink.
      For Linux kernel >= v4.20.
    $ref: /schemas/graph.yaml#/properties/ports

    properties:
      port:
        description: Output connection to CoreSight Sink Trace bus.
        $ref: /schemas/graph.yaml#/properties/port

required:
  - compatible
  - gpu
  - port
  - out-ports

additionalProperties: false

examples:

# A Sink node without legacy CoreSight connections
  - |
    mali-source-itm {
        compatible = "arm,coresight-mali-source-itm";
        gpu = <&gpu>;

        out-ports {
            port {
                mali_source_itm_out_port0: endpoint {
                    remote-endpoint = <&mali_sink_in_port0>;
                };
            };
        };
    };

    mali-source-ela {
        compatible = "arm,coresight-mali-source-ela";
        gpu = <&gpu>;

        out-ports {
            port {
                mali_source_ela_out_port0: endpoint {
                    remote-endpoint = <&mali_sink_in_port1>;
                };
            };
        };
    };

    mali-source-etm {
        compatible = "arm,coresight-mali-source-etm";
        gpu = <&gpu>;

        out-ports {
            port {
                mali_source_etm_out_port0: endpoint {
                    remote-endpoint = <&mali_sink_in_port2>;
                };
            };
        };
    };

# A Sink node with legacy CoreSight connections
  - |
    mali-source-itm {
        compatible = "arm,coresight-mali-source-itm";
        gpu = <&gpu>;

        port {
            mali_source_itm_out_port0: endpoint {
                remote-endpoint = <&mali_sink_in_port0>;
            };
        };
    };

    mali-source-etm {
        compatible = "arm,coresight-mali-source-etm";
        gpu = <&gpu>;

        port {
            mali_source_etm_out_port0: endpoint {
                remote-endpoint = <&mali_sink_in_port1>;
            };
        };
    };

    mali-source-ela {
        compatible = "arm,coresight-mali-source-ela";
        gpu = <&gpu>;

        port {
            mali_source_ela_out_port0: endpoint {
                remote-endpoint = <&mali_sink_in_port2>;
            };
        };
    };
```

## Documentation/devicetree/bindings/arm/freescale/fsl,ele_mu.yaml
```yaml
# SPDX-License-Identifier: (GPL-2.0 OR BSD-2-Clause)
%YAML 1.2
---
$id: http://devicetree.org/schemas/arm/freescale/fsl,ele_mu.yaml#
$schema: http://devicetree.org/meta-schemas/core.yaml#

title: NXP i.MX8ULP EdgeLock Enclave MU driver

maintainers:
  - Pankaj Gupta <pankaj.gupta@nxp.com>

description: |
  Create char devices in /dev as channels of the form /dev/ele_muXchY with X
  the id of the driver and Y for each users. It allows to send and receive
  messages to the EdgeLock Enclave.

properties:
  compatible:
    enum:
      - fsl,imx-ele-mu

  mboxes:
    description:
      List of <&phandle type channel> - 4 channels for TX, 4 channels for RX,
      1 channel for TXDB (see mailbox/fsl,mu.txt)
    maxItems: 9

  mbox-names:
    items:
      - const: tx
      - const: rx

  fsl,ele_mu_did:
    description:
      Identify the owner of mu(msg unit) with id mentioned at ele_mu_id
    allOf:
      - $ref: /schemas/types.yaml#/definitions/uint32
      - enum: [0,1,2,3,4,5,6,7]

  fsl,ele_mu_id:
    description:
      Identify the driver instance, used to create the channels, default to 1
    allOf:
      - $ref: /schemas/types.yaml#/definitions/uint32
      - enum: [0,1,2,3]

  fsl,ele_max_users:
    description:
      Number of channels to create, default to 4
    allOf:
      - $ref: /schemas/types.yaml#/definitions/uint32
      - enum: [0,1,2,3,4,5,6,7,8,9]

  fsl,cmd_tag:
    description:
      Tag in message header for commands on this MU, default to 0x17
    allOf:
      - $ref: /schemas/types.yaml#/definitions/uint8
      - enum: [0x17,0x18,0x19,0x1a,0x1b,0x1c,0x1d,0x1e]

  fsl,rsp_tag:
    description:
      Tag in message header for responses on this MU, default to 0xe1
    allOf:
      - $ref: /schemas/types.yaml#/definitions/uint8
      - enum: [0xe1,0xe2,0xe3,0xe4,0xe5,0xe6,0xe7,0xe8]

required:
  - compatible
  - mboxes
  - mbox-names

examples:
  - |
    ele_mu: ele_mu {
      compatible = "fsl,imx-ele-mu";
      mbox-names = "tx", "rx";
      mboxes = <&s4muap 2 0
          &s4muap 3 0>;

      fsl,ele_mu_id = <1>;
      fsl,ele_max_users = <4>;
      fsl,cmd_tag = /bits/ 8 <0x17>;
      fsl,rsp_tag = /bits/ 8 <0xe1>;
    };
```

## Documentation/devicetree/bindings/arm/freescale/fsl,imx-sc-secvio.yaml
```yaml
# SPDX-License-Identifier: (GPL-2.0 OR BSD-2-Clause)
%YAML 1.2
---
$id: http://devicetree.org/schemas/arm/freescale/fsl,imx-sc-secvio.yaml#
$schema: http://devicetree.org/meta-schemas/core.yaml#

title: NXP i.MX Security Violation driver

maintainers:
  - Franck LENORMAND <franck.lenormand@nxp.com>

description: |
  Receive security violation from the SNVS via the SCU firmware. Allow to
  register notifier for additional processing

properties:
  compatible:
    enum:
      - fsl,imx-sc-secvio

required:
  - compatible
```

## Documentation/devicetree/bindings/arm/freescale/fsl,s400-api.yaml
```yaml
# SPDX-License-Identifier: (GPL-2.0-only OR BSD-2-Clause)
%YAML 1.2
---
$id: http://devicetree.org/schemas/arm/freescale/fsl,s400-api.yaml#
$schema: http://devicetree.org/meta-schemas/core.yaml#

title: NXP S400 Baseline API module

maintainers:
  - Alice Guo <alice.guo@nxp.com>

description: |
  In the Sentinel application, the security subsystem uses S4 MU-AP to
  communicate and coordinate with the SoC host processor. The s400-api firmware
  driver provides the services to transmit data to and receive data from the
  S4 MU-AP.

properties:
  compatible:
    items:
      - const: fsl,imx8ulp-s400

  mboxes:
    description: |
      Use the mailbox provided by S4 MU-AP device to communicate with the S400.
      It should contain 2 mailboxes, one for transmitting messages and another
      for receiving.
    maxItems: 1

  mbox-names:
    items:
      - const: tx
      - const: rx

required:
  - compatible
  - mboxes
  - mbox-names

additionalProperties: false

examples:
  - |
    s400-api {
        compatible = "fsl,imx8ulp-s400";
        mboxes = <&s4muap 0 0 &s4muap 1 0>;
        mbox-names = "tx", "rx";
    };
```

## Documentation/devicetree/bindings/arm/freescale/fsl,seco_mu.yaml
```yaml
# SPDX-License-Identifier: (GPL-2.0 OR BSD-2-Clause)
%YAML 1.2
---
$id: http://devicetree.org/schemas/arm/freescale/fsl,seco_mu.yaml#
$schema: http://devicetree.org/meta-schemas/core.yaml#

title: NXP i.MX8 SECO MU driver

maintainers:
  - Aisheng Dong <aisheng.dong@nxp.com>

description: |
  Create char devices in /dev as channels of the form /dev/seco_muXchY with X
  the id of the driver and Y for each users. It allows to send and receive
  messages to the SECO.

properties:
  compatible:
    enum:
      - fsl,imx-seco-mu

  mboxes:
    description:
      List of <&phandle type channel> - 4 channels for TX, 4 channels for RX,
      1 channel for TXDB (see mailbox/fsl,mu.txt)
    maxItems: 9

  mbox-names:
    items:
      - const: txdb
      - const: rxdb

  fsl,seco_mu_id:
    description:
      Identify the driver instance, used to create the channels, default to 1
    allOf:
      - $ref: /schemas/types.yaml#/definitions/uint32
      - enum: [0,1,2,3]

  fsl,seco_max_users:
    description:
      Number of channels to create, default to 4
    allOf:
      - $ref: /schemas/types.yaml#/definitions/uint32
      - enum: [0,1,2,3,4,5,6,7,8,9]

  fsl,cmd_tag:
    description:
      Tag in message header for commands on this MU, default to 0x17
    allOf:
      - $ref: /schemas/types.yaml#/definitions/uint8
      - enum: [0x17,0x18,0x19,0x1a,0x1b,0x1c,0x1d,0x1e]

  fsl,rsp_tag:
    description:
      Tag in message header for responses on this MU, default to 0xe1
    allOf:
      - $ref: /schemas/types.yaml#/definitions/uint8
      - enum: [0xe1,0xe2,0xe3,0xe4,0xe5,0xe6,0xe7,0xe8]

required:
  - compatible
  - mboxes
  - mbox-names

examples:
  - |
    seco_mu: seco_mu {
      compatible = "fsl,imx-seco-mu";
      mbox-names = "txdb", "rxdb";
      mboxes = <&mu 2 0
          &mu 3 0>;

      fsl,seco_mu_id = <1>;
      fsl,seco_max_users = <4>;
      fsl,cmd_tag = /bits/ 8 <0x17>;
      fsl,rsp_tag = /bits/ 8 <0xe1>;
    };
```

## Documentation/devicetree/bindings/arm/freescale/mxc_ion.txt
```
ION Memory Manager (ION)

ION is a memory manager that allows for sharing of buffers between different
processes and between user space and kernel space. ION manages different
memory spaces by separating the memory spaces into "heaps".

Required properties for Ion

- compatible: "fsl,mxc-ion"


All child nodes of a fsl,mxc-ion node are interpreted as Ion heap
configurations.

Required properties for Ion heaps

- fsl,heap-id: The ID of the ION heap.

Example:
  imx_ion {
    compatible = "fsl,mxc-ion";
    fsl,heap-id = <0>;
  };
```
