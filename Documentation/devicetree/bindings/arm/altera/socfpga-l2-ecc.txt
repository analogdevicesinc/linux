## Documentation/devicetree/bindings/clock/imx7ulp-clock.txt
```
* Clock bindings for Freescale i.MX7ULP

i.MX7ULP Clock functions are under joint control of the System
Clock Generation (SCG) modules, Peripheral Clock Control (PCC)
modules, and Core Mode Controller (CMC)1 blocks

The clocking scheme provides clear separation between M4 domain
and A7 domain. Except for a few clock sources shared between two
domains, such as the System Oscillator clock, the Slow IRC (SIRC),
and and the Fast IRC clock (FIRCLK), clock sources and clock
management are separated and contained within each domain.

M4 clock management consists of SCG0, PCC0, PCC1, and CMC0 modules.
A7 clock management consists of SCG1, PCC2, PCC3, and CMC1 modules.

Note: this binding doc is only for A7 clock domain.

Required properties:

- compatible:	Should be "fsl,imx7ulp-scg0" or "fsl,imx7ulp-scg1".
- reg : 	Should contain registers location and length.
- #clock-cells:	Should be <1>.
- clocks:	Should contain the fixed input clocks.
- clock-name:   Should contain the following clock names:"cm4_rosc",
		"cm4_sosc", "cm4_sirc", "cm4_firc" for scg0.
Or
		Should contain the following clock names:"rsoc", "sosc",
		"sirc", "firc", "upll", "mpll" for scg1.

The clock consumer should specify the desired clock by having the clock
ID in its "clocks" phandle cell.
See include/dt-bindings/clock/imx7ulp-clock.h
for the full list of i.MX7ULP clock IDs.

Examples:

#include <dt-bindings/clock/imx7ulp-clock.h>

clks: scg1@403e0000 {
	compatible = "fsl,imx7ulp-clock";
	reg = <0x403e0000 0x10000>;
	clocks = <&rsoc>, <&sosc>, <&sirc>,
		 <&firc>, <&upll>, <&mpll>;
	clock-names = "rsoc", "sosc", "sirc",
		      "firc", "upll", "mpll";
	#clock-cells = <1>;
};

usdhc1: usdhc@40380000 {
	compatible = "fsl,imx7ulp-usdhc";
	reg = <0x40380000 0x10000>;
	interrupts = <GIC_SPI 43 IRQ_TYPE_LEVEL_HIGH>;
	clocks = <&clks IMX7ULP_CLK_NIC1_BUS_DIV>,
		 <&clks IMX7ULP_CLK_NIC1_DIV>,
		 <&clks IMX7ULP_CLK_USDHC1>;
	clock-names ="ipg", "ahb", "per";
	bus-width = <4>;
	status = "disabled";
};
```

## Documentation/devicetree/bindings/clock/imx8qxp-lpcg.txt
```
* NXP i.MX8QXP LPCG (Low-Power Clock Gating) Clock bindings

The Low-Power Clock Gate (LPCG) modules contain a local programming
model to control the clock gates for the peripherals. An LPCG module
is used to locally gate the clocks for the associated peripheral.

Note:
This level of clock gating is provided after the clocks are generated
by the SCU resources and clock controls. Thus even if the clock is
enabled by these control bits, it might still not be running based
on the base resource.

Required properties:
- compatible:		Should be one of:
			  "fsl,imx8qxp-lpcg"
			  "fsl,imx8qm-lpcg" followed by "fsl,imx8qxp-lpcg".
- reg:			Address and length of the register set.
- #clock-cells:		Should be 1. One LPCG supports multiple clocks.
- clocks:		Input parent clocks phandle array for each clock.
- bit-offset:		An integer array indicating the bit offset for each clock.
- hw-autogate:		Boolean array indicating whether supports HW autogate for
			each clock.
- clock-output-names:	Shall be the corresponding names of the outputs.
			NOTE this property must be specified in the same order
			as the clock bit-offset and hw-autogate property.
- power-domains:	Should contain the power domain used by this clock.

The clock consumer should specify the desired clock by having the clock
ID in its "clocks" phandle cell.

Examples:

#include <dt-bindings/clock/imx8qxp-clock.h>

sdhc0_lpcg: clock-controller@5b200000 {
	compatible = "fsl,imx8qxp-lpcg";
	reg = <0x5b200000 0x10000>;
	#clock-cells = <1>;
	clocks = <&sdhc0_clk IMX_SC_PM_CLK_PER>,
		 <&conn_ipg_clk>, <&conn_axi_clk>;
	bit-offset = <0 16 20>;
	clock-output-names = "sdhc0_lpcg_per_clk",
			     "sdhc0_lpcg_ipg_clk",
			     "sdhc0_lpcg_ahb_clk";
	power-domains = <&pd IMX_SC_R_SDHC_0>;
};

usdhc1: mmc@5b010000 {
	compatible = "fsl,imx8qxp-usdhc", "fsl,imx7d-usdhc";
	interrupt-parent = <&gic>;
	interrupts = <GIC_SPI 232 IRQ_TYPE_LEVEL_HIGH>;
	reg = <0x5b010000 0x10000>;
	clocks = <&sdhc0_lpcg 1>,
		 <&sdhc0_lpcg 0>,
		 <&sdhc0_lpcg 2>;
	clock-names = "ipg", "per", "ahb";
};
```

## Documentation/devicetree/bindings/clock/imx8ulp-clock.yaml
```yaml
# SPDX-License-Identifier: (GPL-2.0-only OR BSD-2-Clause)
%YAML 1.2
---
$id: http://devicetree.org/schemas/clock/imx8ulp-clock.yaml#
$schema: http://devicetree.org/meta-schemas/core.yaml#

title: NXP i.MX8ULP Clock Control Module Binding

maintainers:
  - Jacky Bai <ping.bai@nxp.com>

description: |
  On i.MX8ULP, The clock sources generation, distribution and management is
  under the control of several CGCs & PCCs modules. The CGC modules generate
  and distribute clocks on the device. PCC modules control clock selection,
  optional division and clock gating mode for peripherals

properties:
  compatible:
    enum:
      - fsl,imx8ulp-cgc1
      - fsl,imx8ulp-cgc2
      - fsl,imx8ulp-pcc3
      - fsl,imx8ulp-pcc4
      - fsl,imx8ulp-pcc5

  reg:
    maxItems: 1

  clocks:
    description:
      specify the external clocks used by the CGC module, the clocks
      are rosc, sosc, frosc, lposc
    maxItems: 4

  clock-names:
    description:
      specify the external clocks names used by the CGC module. the valid
      clock names should rosc, sosc, frosc, lposc.
    maxItems: 4

  '#clock-cells':
    const: 1
    description:
      The clock consumer should specify the desired clock by having the clock
      ID in its "clocks" phandle cell. See include/dt-bindings/clock/imx8ulp-clock.h
      for the full list of i.MX8ULP clock IDs.

  '#reset-cells':
    const: 1
    description:
      The reset consumer should specify the desired clock by having the reset
      ID in its "resets" phandle cell. See include/dt-bindings/reset/imx8ulp-pcc-reset.h
      for the full list of i.MX8ULP reset IDs. Only PCC3, PCC4 and PCC5 should specify
      this property.

required:
  - compatible
  - reg
  - '#clock-cells'

if:
  properties:
     compatible:
       contains:
         enum:
           - fsl,imx8ulp-pcc3
           - fsl,imx8ulp-pcc4
           - fsl,imx8ulp-pcc5
then:
  required:
    - '#reset-cells'

additionalProperties: false

examples:
  # Clock Control Module node:
  - |
    clock-controller@292c0000 {
        compatible = "fsl,imx8ulp-cgc1";
        reg = <0x292c0000 0x10000>;
        clocks = <&rosc>, <&sosc>, <&frosc>, <&lposc>;
        clock-names = "rosc", "sosc", "frosc", "lposc";
        #clock-cells = <1>;
    };

  - |
    clock-controller@292d0000 {
        compatible = "fsl,imx8ulp-pcc3";
        reg = <0x292d0000 0x10000>;
        #clock-cells = <1>;
        #reset-cells = <1>;
    };
```

## Documentation/devicetree/bindings/clock/intel,agilex5.yaml
```yaml
# SPDX-License-Identifier: (GPL-2.0-only OR BSD-2-Clause)
%YAML 1.2
---
$id: http://devicetree.org/schemas/clock/intel,agilex5.yaml#
$schema: http://devicetree.org/meta-schemas/core.yaml#

title: Intel SoCFPGA Agilex5 platform clock controller binding

maintainers:
  - Teh Wen Ping <wen.ping.teh@intel.com>

description:
  The Intel Agilex5 Clock controller is an integrated clock controller, which
  generates and supplies to all modules.

properties:
  compatible:
    const: intel,agilex5-clkmgr

  '#clock-cells':
    const: 1

  reg:
    maxItems: 1

required:
  - compatible
  - reg
  - '#clock-cells'

additionalProperties: false

examples:
  # Clock controller node:
  - |
    clkmgr: clock-controller@10d10000 {
      compatible = "intel,agilex5-clkmgr";
      reg = <0x10d10000 0x1000>;
      #clock-cells = <1>;
    };
...
```

## Documentation/devicetree/bindings/clock/s32v234-mc_cgm.txt
```
* NXP S32V234 Clock Generation Modules (MC_CGMs)

The SoC supports four Clock Generation Modules, which provide registers for
system and peripherals clock source selection and division. See chapters 22
("Clocking"), 23 ("Clock Generation Module (MC_CGM)") and 69 ("Mode Entry
Module (MC_ME)") in the reference manual[1].

This binding uses the common clock binding:
    Documentation/devicetree/bindings/clock/clock-bindings.txt

Required properties:
- compatible:
	Should be:
	- "fsl,s32v234-mc_cgm0" for MC_CGM_0
	- "fsl,s32v234-mc_cgm1" for MC_CGM_1
	- "fsl,s32v234-mc_cgm2" for MC_CGM_2
	- "fsl,s32v234-mc_cgm3" for MC_CGM_3
- reg:
	Location and length of the register set
- #clock-cells (only for MC_CGM_0):
	Should be <1>. See dt-bindings/clock/s32v234-clock.h for the clock
	specifiers allowed in the clocks property of consumers.

Example:
clks: mc_cgm0@4003c000 {
	compatible = "fsl,s32v234-mc_cgm0";
	reg = <0x0 0x4003C000 0x0 0x1000>;
	#clock-cells = <1>;
};

[1] https://www.nxp.com/webapp/Download?colCode=S32V234RM
```

## Documentation/devicetree/bindings/clock/s32v234-mc_me.txt
```
* NXP S32V234 Mode Entry Module (MC_ME)

See chapters 22 ("Clocking") and 69 ("Mode Entry Module (MC_ME)") in the
reference manual[1].

Required properties:
- compatible: Should be "fsl,s32v234-mc_me"
- reg: Location and length of the register set

Example:
mc_me: mc_me@4004a000 {
	compatible = "fsl,s32v234-mc_me";
	reg = <0x0 0x4004A000 0x0 0x1000>;
};

[1] https://www.nxp.com/webapp/Download?colCode=S32V234RM
```

## Documentation/devicetree/bindings/clock/silabs,si5391.yaml
```yaml
# SPDX-License-Identifier: (GPL-2.0-only OR BSD-2-Clause)
%YAML 1.2
---
$id: http://devicetree.org/schemas/clock/skyworks,si5391.yaml#
$schema: http://devicetree.org/meta-schemas/core.yaml#

title: Silicon Labs Si5391 Clock Generator

maintainers:
  - Linux Kernel Developer <linux-clk@vger.kernel.org>

description: |
  The Si5391 is a programmable I2C clock generator with up to 10 output
  clocks. The chip contains a PLL that generates a high-frequency VCO
  clock which is then divided down to produce the output clocks.

  The device can accept input from up to 4 sources: three differential
  input clocks (IN0, IN1, IN2) or a crystal oscillator (XTAL).

  Each output can be individually configured for format (LVDS, LVPECL,
  HCSL, LVCMOS), amplitude, and frequency through an R-divider.

  The driver supports runtime configuration of output frequencies and
  can be used in "as-is" mode where it reads the current configuration
  from a pre-programmed device.

properties:
  compatible:
    const: skyworks,si5391

  reg:
    maxItems: 1
    description: I2C device address, typically 0x74

  "#clock-cells":
    const: 1
    description: |
      The clock cell value specifies the output index (0-9).

  clocks:
    minItems: 1
    maxItems: 4
    description: |
      List of parent clock phandles, corresponding to the input clocks.
      Use a fixed-clock for the XTAL input.

  clock-names:
    minItems: 1
    maxItems: 4
    items:
      enum: ["xtal", "in0", "in1", "in2"]
    description: |
      Names of the input clocks. At least one input must be provided.

  vdd-supply:
    description: Regulator for core VDD supply

  vdda-supply:
    description: Regulator for analog VDDA supply

  vdds-supply:
    description: Regulator for VDDS supply

  vddoN-supply:
    description: |
      Regulator for output N VDDO supply (where N is 0-9).
      The driver selects the output VDD_SEL setting based on this voltage.
    pattern: "^vddo[0-9]$"

  skyworks,pll-m-num:
    $ref: /schemas/types.yaml#/definitions/uint32
    description: |
      Numerator for PLL feedback divider. Must be set such that the
      PLL VCO frequency is in the range 13.5-14.256 GHz.

  skyworks,pll-m-den:
    $ref: /schemas/types.yaml#/definitions/uint32
    description: |
      Denominator for PLL feedback divider. Together with pll-m-num,
      determines the PLL multiplication factor.

  skyworks,xaxb-ext-clk:
    type: boolean
    description: |
      When present, indicates that XA/XB pins are used in external
      reference clock mode rather than crystal oscillator mode.

  skyworks,iovdd-33:
    type: boolean
    description: |
      When present, indicates that I2C interface uses 3.3V logic
      levels rather than 1.8V.

  skyworks,reprogram:
    type: boolean
    description: |
      When present, the driver will always perform a soft reset and
      full initialization of the device. Use with caution as this
      will temporarily stop all output clocks.

  interrupts:
    maxItems: 1
    description: Interrupt line connected to INTRb pin

  "#address-cells":
    const: 1

  "#size-cells":
    const: 0

patternProperties:
  "^out@[0-9]$":
    type: object
    description: |
      Optional child node for configuring individual outputs.
      If not specified, the output configuration is left unchanged.

    properties:
      reg:
        minimum: 0
        maximum: 9
        description: Output index

      skyworks,format:
        $ref: /schemas/types.yaml#/definitions/uint32
        enum: [1, 2, 4]
        description: |
          Output format:
          1 = Differential (LVDS/LVPECL)
          2 = Low-power (HCSL)
          4 = LVCMOS

      skyworks,common-mode:
        $ref: /schemas/types.yaml#/definitions/uint32
        minimum: 0
        maximum: 15
        description: |
          Output common mode voltage setting.
          See Si5391 reference manual for specific values.

      skyworks,amplitude:
        $ref: /schemas/types.yaml#/definitions/uint32
        minimum: 0
        maximum: 15
        description: |
          Output amplitude setting.
          See Si5391 reference manual for specific values.

      skyworks,disable-high:
        type: boolean
        description: |
          When present, output is driven HIGH when disabled.
          Otherwise, output is driven LOW when disabled.

      always-on:
        type: boolean
        description: |
          When present, this output is always enabled and cannot
          be disabled at runtime.

    required:
      - reg

    additionalProperties: false

required:
  - compatible
  - reg
  - "#clock-cells"
  - clocks
  - clock-names

additionalProperties: false

examples:
  - |
    #include <dt-bindings/clock/si5391.h>

    /* 48MHz reference crystal */
    ref48: ref48M {
        compatible = "fixed-clock";
        #clock-cells = <0>;
        clock-frequency = <48000000>;
    };

    i2c {
        #address-cells = <1>;
        #size-cells = <0>;

        si5391: clock-generator@77 {
            compatible = "silabs,si5391";
            reg = <0x77>;
            #clock-cells = <1>;
            #address-cells = <1>;
            #size-cells = <0>;

            clocks = <&ref48>;
            clock-names = "xtal";

            skyworks,pll-m-num = <14000>;  /* PLL at 14.0 GHz */
            skyworks,pll-m-den = <48>;
            skyworks,iovdd-33;              /* 3.3V I2C interface */

            /* Configure OUT8 for 200MHz LVDS */
            out@8 {
                reg = <8>;
                skyworks,format = <1>;      /* LVDS */
                skyworks,common-mode = <3>;
                skyworks,amplitude = <3>;
                always-on;
            };

            /* Configure OUT9 for 100MHz LVDS */
            out@9 {
                reg = <9>;
                skyworks,format = <1>;      /* LVDS */
                skyworks,common-mode = <3>;
                skyworks,amplitude = <3>;
                always-on;
            };
        };
    };

    /* Example of a consumer device using OUT8 */
    some-device {
        clocks = <&si5391 8>;
        clock-names = "refclk";
        assigned-clocks = <&si5391 8>;
        assigned-clock-rates = <200000000>;
    };
...
```
