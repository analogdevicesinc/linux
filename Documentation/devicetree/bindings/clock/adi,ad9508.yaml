## Documentation/devicetree/bindings/nvmem/adi,adsp-otp.yaml
```yaml
# SPDX-License-Identifier: (GPL-2.0-only OR BSD-2-Clause)
%YAML 1.2
---
$id: http://devicetree.org/schemas/nvmem/adi,adsp-otp.yaml#
$schema: http://devicetree.org/meta-schemas/core.yaml#

title: Analog Devices ADSP processor OTP memory

maintainers:
  - Sam Winchenbach <sam.winchenbach@analog.com>

description: |
  Analog Devices ADSP processors contain one-time programmable (OTP)
  memory that holds keys, boot configuration and general purpose customer
  data. This binding currently covers the ADSP-SC58x family.

  On the ADSP-SC58x the OTP is controlled by the OTP controller (OTPC).
  Reading, programming and locking the OTP are done through functions of
  the on-chip boot ROM, which implement the redundancy and error
  correction scheme of the OTP array; the OTP array itself is therefore
  not described here.

  The SHARC+ cores can reach the OTP too, and simultaneous OTP accesses by
  several cores can hang a core (silicon anomaly 20000084). The Reset
  Control Unit (RCU) tells whether the SHARC+ cores are held in reset or
  idle, so that the OTP is only programmed while they are.

allOf:
  - $ref: nvmem.yaml#

properties:
  compatible:
    oneOf:
      - const: adi,adsp-sc589-otp
      - items:
          - enum:
              - adi,adsp-sc582-otp
              - adi,adsp-sc583-otp
              - adi,adsp-sc584-otp
              - adi,adsp-sc587-otp
          - const: adi,adsp-sc589-otp

  reg:
    items:
      - description: OTP controller (OTPC) registers

  adi,rcu:
    $ref: /schemas/types.yaml#/definitions/phandle
    description:
      The Reset Control Unit (a syscon), whose core reset and message
      registers report whether the SHARC+ cores are held in reset or
      idle.

required:
  - compatible
  - reg
  - adi,rcu

unevaluatedProperties: false

examples:
  - |
    otp@31011000 {
        compatible = "adi,adsp-sc589-otp";
        reg = <0x31011000 0x100>;
        adi,rcu = <&rcu>;
        read-only;
    };
...
```

## Documentation/devicetree/bindings/power/supply/adi,max17340.yaml
```yaml
# SPDX-License-Identifier: (GPL-2.0-only OR BSD-2-Clause)
%YAML 1.2
---
$id: http://devicetree.org/schemas/power/supply/adi,max17340.yaml#
$schema: http://devicetree.org/meta-schemas/core.yaml#

title: Analog Devices MAX17340 Fuel Gauge and Battery Charger

maintainers:
  - Joan Na <joan.na@analog.com>

description: |
  The MAX17340 is an integrated single-cell battery management IC that combines
  a ModelGauge m5 fuel gauge with a charger and protection circuits. Features:

  - ModelGauge m5 EZ algorithm for accurate SOC estimation
  - Integrated linear charger with JEITA compliance
  - 8 temperature zones for charging
  - 5-step charging support
  - Battery protection (OVP, UVP, OCP, temperature)
  - 4 configurable GPIO pins

  The device uses three I2C addresses:
  - 0x36: FG_RAM (runtime fuel gauge data and control)
  - 0x0B: FG_NVM (non-volatile configuration, accessed internally by driver)
  - 0x37: FUNC (GPIO and mailbox functions, accessed internally by driver)

allOf:
  - $ref: power-supply.yaml#

properties:
  compatible:
    const: adi,max17340

  reg:
    maxItems: 1

  interrupts:
    maxItems: 1
    description: Alert/interrupt pin (active-low)

  adi,rsense-microohm:
    $ref: /schemas/types.yaml#/definitions/uint32
    minimum: 1000
    maximum: 100000
    default: 10000
    description:
      Current sense resistor value in microohms.

  gpio-controller: true

  "#gpio-cells":
    const: 2
    description:
      The first cell is the GPIO number (0-3) and the second cell specifies
      GPIO flags as defined in dt-bindings/gpio/gpio.h.

  gpio-line-names:
    minItems: 1
    maxItems: 4
    description:
      Names for the four GPIO lines. Default pin functions are TH1 (thermistor),
      TH2 (secondary thermistor), PB (pushbutton wakeup), ALRTB (alert output).

  power-supplies: true

required:
  - compatible
  - reg

unevaluatedProperties: false

examples:
  - |
    #include <dt-bindings/interrupt-controller/irq.h>
    #include <dt-bindings/gpio/gpio.h>

    i2c {
        #address-cells = <1>;
        #size-cells = <0>;

        pmic@36 {
            compatible = "adi,max17340";
            reg = <0x36>;
            interrupt-parent = <&gpio>;
            interrupts = <7 IRQ_TYPE_LEVEL_LOW>;
            adi,rsense-microohm = <10000>;

            gpio-controller;
            #gpio-cells = <2>;
            gpio-line-names = "TH1", "TH2", "PB", "ALRTB";
        };
    };

  - |
    i2c {
        #address-cells = <1>;
        #size-cells = <0>;

        pmic@36 {
            compatible = "adi,max17340";
            reg = <0x36>;
            adi,rsense-microohm = <5000>;
            monitored-battery = <&battery>;

            gpio-controller;
            #gpio-cells = <2>;
        };
    };

    battery: battery {
        compatible = "simple-battery";
        device-chemistry = "lithium-ion";
        voltage-max-design-microvolt = <4200000>;
        voltage-min-design-microvolt = <3000000>;
        charge-full-design-microamp-hours = <3000000>;
    };
```

## Documentation/devicetree/bindings/sound/adi,adsp-dai.yaml
```yaml
# SPDX-License-Identifier: (GPL-2.0-only OR BSD-2-Clause)
%YAML 1.2
---
$id: http://devicetree.org/schemas/sound/adi,adsp-dai.yaml#
$schema: http://devicetree.org/meta-schemas/core.yaml#

title: Analog Devices ADSP DAI (Digital Audio Interface)

maintainers:
  - Alvin Šipraga <alvin.sipraga@analog.com>

description:
  Analog Devices ADSP SoCs feature a Digital Audio Interface (DAI) hardware
  block consisting of several audio-related logical functions. These include a
  Signal Routing Unit (SRU) for muxing of internal and external audio-related
  signals; an asynchronous sample rate converter (ASRC); an S/PDIF transceiver;
  and a Precision Clock Generator (PCG) for serial audio clocks.

  Although logically discrete, the aforementioned functions are all part of the
  same DAI hardware, with their register addresses partially interleaved. Since
  they share the same resources, this binding describes them in totality under
  the headline DAI hardware description.

  The DAI instance (DAI0 or DAI1) is identified by its register address.

properties:
  compatible:
    oneOf:
      - enum:
          - adi,adsp-sc573-dai
          - adi,adsp-sc589-dai
          - adi,adsp-sc598-dai
          - adi,adsp-sc846-dai
      - items:
          - const: adi,adsp-sc594-dai
          - const: adi,adsp-sc598-dai

  reg:
    maxItems: 1

  clocks:
    maxItems: 1

  clock-names:
    items:
      - const: sclk

  adi,pads-syscon:
    $ref: /schemas/types.yaml#/definitions/phandle
    description:
      phandle to the PADS syscon register block used to enable physical DAI pin
      input buffers.

required:
  - compatible
  - reg
  - clocks
  - clock-names

allOf:
  - if:
      properties:
        compatible:
          contains:
            enum:
              - adi,adsp-sc589-dai
              - adi,adsp-sc598-dai
              - adi,adsp-sc846-dai
    then:
      required:
        - adi,pads-syscon

additionalProperties: false

examples:
  - |
    audio-controller@310ca000 {
        compatible = "adi,adsp-sc598-dai";
        reg = <0x310ca000 0x400>;
        clocks = <&clk 42>;
        clock-names = "sclk";
        adi,pads-syscon = <&pads_syscon>;
    };
```

## drivers/clk/adi/Kconfig
```kconfig
# SPDX-License-Identifier: GPL-2.0-only
config COMMON_CLK_AD9508
	tristate
	select REGMAP

config COMMON_CLK_AD9508_SPI
	tristate "Analog Devices AD9508 clock fanout buffer (SPI)"
	depends on SPI
	select COMMON_CLK_AD9508
	help
	  Say yes here to build support for the Analog Devices AD9508 1.65 GHz
	  clock fanout buffer with output dividers and phase offset adjust,
	  controlled over SPI.

	  To compile this driver as a module, choose M here: the module will
	  be called clk-ad9508-spi.

config COMMON_CLK_AD9508_I2C
	tristate "Analog Devices AD9508 clock fanout buffer (I2C)"
	depends on I2C
	select COMMON_CLK_AD9508
	help
	  Say yes here to build support for the Analog Devices AD9508 1.65 GHz
	  clock fanout buffer with output dividers and phase offset adjust,
	  controlled over I2C.

	  To compile this driver as a module, choose M here: the module will
	  be called clk-ad9508-i2c.
```

## drivers/clk/ambarella/Kconfig
```kconfig
# SPDX-License-Identifier: GPL-2.0-only

config CLK_AMBARELLA_CV75
	bool "Ambarella CV75 RCT clock controller"
	depends on ARCH_AMBARELLA || COMPILE_TEST
	default ARCH_AMBARELLA
	help
	  Say Y here to enable the Ambarella CV75 RCT clock controller.
```

## drivers/pinctrl/adi/Kconfig
```kconfig
# SPDX-License-Identifier: (GPL-2.0-only OR BSD-2-Clause)-only

config PINCTRL_ADI_ADSP
	tristate "Analog Devices ADSP pinctrl and GPIO driver"
	depends on OF
	select PINMUX
	select PINCONF
	select GENERIC_PINCONF
	select GENERIC_PINCTRL_GROUPS
	select GENERIC_PINMUX_FUNCTIONS
	select GPIOLIB
	select GPIOLIB_IRQCHIP
	select IRQ_DOMAIN_HIERARCHY
	select MFD_SYSCON
	imply ADI_ADSP_PINT
	help
	  This pinctrl driver provides an interface that allows configuring the
	  PORT pins on Analog Devices ADSP SoCs. The pins can be muxed to
	  another peripheral, or function as GPIO.

	  The driver can also be built as a module. If so, the module will be
	  called pinctrl-adsp.

config PINCTRL_ADI_ADSP_SRU
	bool "ADSP-SC5XX SRU control driver"
	depends on ADI_ADSP_DAI
	default ADI_ADSP_DAI
	select GENERIC_PINCONF
	select PINMUX
	help
	  Say Y here to enable the ADSP-SC5XX SRU control driver. This is
	  required for SRU muxing functionality on the SoC.
```

## drivers/soc/adi/Kconfig
```kconfig
# SPDX-License-Identifier: GPL-2.0-only

config ADI_MACH_SC5XX
	bool "ADI SC5XX machine support" if COMPILE_TEST
	default ARCH_SC84X || ARCH_SC59X_64 || ARCH_SC59X || ARCH_SC58X || ARCH_SC57X
	select MAILBOX
	help
	  This enables machine-level support for Analog Devices SC5XX SoCs,
	  including the Reset Control Unit, System Event Controller, and
	  Inter-Core Communications drivers.

config ADI_ADSP_DAI
	tristate "Analog Devices ADSP DAI driver"
	default ADI_MACH_SC5XX
	depends on ADI_MACH_SC5XX
	depends on OF
	select AUXILIARY_BUS
	select REGMAP_MMIO
	help
	  This enables the driver for the Digital Audio Interface (DAI) found on
	  Analog Devices ADSP SoCs.

	  The driver can also be built as a module. If so, the module will be
	  called adsp-dai.
```
