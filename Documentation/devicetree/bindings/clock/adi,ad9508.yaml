## Documentation/devicetree/bindings/iio/adc/xlnx,xadc.yaml
```yaml
# SPDX-License-Identifier: (GPL-2.0-only OR BSD-2-Clause)
%YAML 1.2
---
$id: http://devicetree.org/schemas/iio/adc/xlnx,xadc.yaml#
$schema: http://devicetree.org/meta-schemas/core.yaml#

title: Xilinx XADC and UltraScale System Monitor

maintainers:
  - Sai Krishna Potthuri <sai.krishna.potthuri@amd.com>
  - Dileep Kumar Nagavarapu <dileepkumar.nagavarapu@amd.com>

description: |
  The Xilinx XADC is an ADC found in the Series 7 FPGAs. It has a DRP
  (Dynamic Reconfiguration Port) interface for communication. Two different
  frontends for the DRP interface are supported:

    - ZYNQ hardblock: available only on the ZYNQ family as a hardblock in
      the SoC portion of the ZYNQ device.
    - AXI softblock: available on all Series 7 platforms as a softblock
      with an AXI interface (PG019).

  The Xilinx System Monitor is an ADC found in UltraScale and UltraScale+
  FPGAs. It is accessed through the Xilinx System Management Wizard IP core
  via an AXI interface in the FPGA fabric.

  The xlnx,channels subnode name contains a comma as part of the legacy
  device tree binding that has been in use for over a decade. This name is
  retained for backwards compatibility with existing device trees.

properties:
  compatible:
    enum:
      - xlnx,zynq-xadc-1.00.a
      - xlnx,axi-xadc-1.00.a
      - xlnx,system-management-wiz-1.3

  reg:
    maxItems: 1

  interrupts:
    maxItems: 1

  clocks:
    maxItems: 1

  xlnx,external-mux:
    $ref: /schemas/types.yaml#/definitions/string
    description:
      Selects the external multiplexer mode.
    enum:
      - none
      - single
      - dual
    default: none

  xlnx,external-mux-channel:
    $ref: /schemas/types.yaml#/definitions/uint32
    description: |
      Configures which pair of pins is used to sample data in external
      multiplexer mode. Required when xlnx,external-mux is "single" or
      "dual".

      Valid values for single external multiplexer mode:
        0: VP/VN
        1: VAUXP[0]/VAUXN[0]
        2: VAUXP[1]/VAUXN[1]
        ...
        16: VAUXP[15]/VAUXN[15]

      Valid values for dual external multiplexer mode:
        1: VAUXP[0]/VAUXN[0] - VAUXP[8]/VAUXN[8]
        2: VAUXP[1]/VAUXN[1] - VAUXP[9]/VAUXN[9]
        ...
        8: VAUXP[7]/VAUXN[7] - VAUXP[15]/VAUXN[15]
    minimum: 0
    maximum: 16

  xlnx,channels:
    type: object
    description:
      List of external channels connected to the ADC. If this node is
      absent, no external channels are assumed to be connected.

    properties:
      '#address-cells':
        const: 1

      '#size-cells':
        const: 0

    patternProperties:
      "^channel@([0-9a-f]|10)$":
        type: object
        description:
          Represents an external channel connected to the ADC.

        properties:
          reg:
            description: |
              Pair of pins the channel is connected to.
                0: VP/VN
                1: VAUXP[0]/VAUXN[0]
                2: VAUXP[1]/VAUXN[1]
                ...
                16: VAUXP[15]/VAUXN[15]
            minimum: 0
            maximum: 16

          xlnx,bipolar:
            $ref: /schemas/types.yaml#/definitions/flag
            description:
              If set, the channel is used in bipolar mode.

        required:
          - reg

        additionalProperties: false

    required:
      - '#address-cells'
      - '#size-cells'

    additionalProperties: false

allOf:
  - if:
      properties:
        xlnx,external-mux:
          enum:
            - single
            - dual
      required:
        - xlnx,external-mux
    then:
      required:
        - xlnx,external-mux-channel

required:
  - compatible
  - reg
  - interrupts
  - clocks

additionalProperties: false

examples:
  - |
    xadc@43200000 {
        compatible = "xlnx,axi-xadc-1.00.a";
        reg = <0x43200000 0x1000>;
        interrupts = <0 53 4>;
        interrupt-parent = <&gic>;
        clocks = <&fpga1_clk>;

        xlnx,channels {
            #address-cells = <1>;
            #size-cells = <0>;
            channel@0 {
                reg = <0>;
                xlnx,bipolar;
            };
        };
    };
```

## Documentation/devicetree/bindings/iio/cdc/ti,fdc1004.yaml
```yaml
# SPDX-License-Identifier: (GPL-2.0-only OR BSD-2-Clause)
%YAML 1.2
---
$id: http://devicetree.org/schemas/iio/cdc/ti,fdc1004.yaml#
$schema: http://devicetree.org/meta-schemas/core.yaml#

title: Texas Instruments FDC1004 capacitive sensor

maintainers:
  - Victor Chernyakin <chernyakin.victor.j@outlook.com>

description: |
  The FDC1004 is a high-resolution 4-channel capacitance to digital converter
  that works over I2C.

  https://www.ti.com/product/FDC1004

properties:
  compatible:
    const: ti,fdc1004

  reg:
    maxItems: 1

  vdd-supply: true

required:
  - compatible
  - reg
  - vdd-supply

additionalProperties: false

examples:
  - |
    i2c {
        #address-cells = <1>;
        #size-cells = <0>;

        cdc@50 {
            compatible = "ti,fdc1004";
            reg = <0x50>;
            vdd-supply = <&vdd_3v3>;
        };
    };
...
```

## Documentation/devicetree/bindings/iio/frequency/adi,admv1355.yaml
```yaml
# SPDX-License-Identifier: (GPL-2.0-only OR BSD-2-Clause)
# Copyright 2026 Analog Devices Inc.
%YAML 1.2
---
$id: http://devicetree.org/schemas/iio/frequency/adi,admv1355.yaml#
$schema: http://devicetree.org/meta-schemas/core.yaml#

title: Analog Devices ADMV1355 Microwave Upconverter

maintainers:
  - George Mois <george.mois@analog.com>
  - Rodrigo Alencar <rodrigo.alencar@analog.com>

description: |
  The ADMV1355 is a highly integrated microwave upconverter optimized for
  wideband radio designs operating in the 17.7 GHz to 55 GHz RF range.

  The integrated local oscillator (LO) signal chain accepts LO input
  signals in the 8.85 GHz to 27.5 GHz range with an internal 2x frequency
  multiplier, programmable harmonic-reject filter, and I/Q phase-adjust
  circuitry.

  Three frequency translation mixer modes are supported: baseband I/Q
  differential input (DC to 12 GHz), complex IF input (1 GHz to 12 GHz),
  and IF hybrid input (8 GHz to 12 GHz).

  Datasheet:
    https://www.analog.com/en/products/admv1355.html

properties:
  compatible:
    const: adi,admv1355

  reg:
    maxItems: 1

  spi-max-frequency:
    maximum: 50000000

  spi-device-addr:
    maxItems: 1
    items:
      enum: [0, 1, 2, 3]
    default: 0
    description:
      Chip address selected by the CHIP_ADD0 and CHIP_ADD1 balls, allowing up
      to four devices to share a single SPI chip select. A ball left floating
      reads as 1 due to its internal pull-up.

  clocks:
    description:
      LO input clock. The clock rate must represent the actual frequency at
      the LO input pin. If the clock source is divided before reaching the
      device, the divider should be modeled with a fixed-factor-clock node.
    maxItems: 1

  clock-names:
    items:
      - const: lo-input

  dvdd-supply:
    description: Digital supply (1.8 V).

  vdd-bg-supply:
    description: Bandgap reference supply (1.8 V).

  vdd-lo-supply:
    description: LO signal chain supply (1.8 V).

  vdd-mix-supply:
    description: Mixer supply (1.8 V).

  vdd-vga-supply:
    description: VGA supply (1.8 V).

  vdd-drv-supply:
    description: RF driver amplifier supply (3 V).

  adi,baseband-vicm-microvolt:
    description:
      Common-mode voltage of the baseband I/Q inputs (BB_IP, BB_IN, BB_QP and
      BB_QN), as set by the source driving them. At 0.5 V or less, the mixer
      gate bias must be set manually for the given voltage. When absent, the
      mixer gate bias is set automatically.
    minimum: 0
    maximum: 1550000

  reset-gpios:
    description: GPIO connected to the active-low RST pin.
    maxItems: 1

  enable-gpios:
    description:
      GPIO connected to the active-high CEN (chip enable) pin. CEN must be
      held low until all supply voltages are stable and RST is deasserted.
    maxItems: 1

required:
  - compatible
  - reg
  - clocks
  - clock-names
  - dvdd-supply
  - vdd-bg-supply
  - vdd-lo-supply
  - vdd-mix-supply
  - vdd-vga-supply
  - vdd-drv-supply

allOf:
  - $ref: /schemas/spi/spi-peripheral-props.yaml#

unevaluatedProperties: false

examples:
  - |
    #include <dt-bindings/gpio/gpio.h>

    spi {
        #address-cells = <1>;
        #size-cells = <0>;

        mixer@0 {
            compatible = "adi,admv1355";
            reg = <0>;
            spi-max-frequency = <1000000>;
            spi-device-addr = <0>;
            clocks = <&lo_input_clk>;
            clock-names = "lo-input";
            dvdd-supply = <&vdd_1v8>;
            vdd-bg-supply = <&vdd_1v8>;
            vdd-lo-supply = <&vdd_1v8>;
            vdd-mix-supply = <&vdd_1v8>;
            vdd-vga-supply = <&vdd_1v8>;
            vdd-drv-supply = <&vdd_3v0>;
            reset-gpios = <&gpio0 88 GPIO_ACTIVE_LOW>;
            enable-gpios = <&gpio0 89 GPIO_ACTIVE_HIGH>;
            adi,baseband-vicm-microvolt = <250000>;
        };
    };
...
```

## Documentation/devicetree/bindings/iio/imu/adi,adis16607.yaml
```yaml
# SPDX-License-Identifier: (GPL-2.0-only OR BSD-2-Clause)
%YAML 1.2
---
$id: http://devicetree.org/schemas/iio/imu/adi,adis16607.yaml#
$schema: http://devicetree.org/meta-schemas/core.yaml#

title: Analog Devices ADIS16607 IMU

maintainers:
  - Radu Sabau <radu.sabau@analog.com>

description: |
  Analog Devices ADIS16607 Precision MEMS Inertial Measurement Unit (IMU)
  with a triaxial gyroscope, triaxial accelerometer, and temperature sensor.
  Uses SPI Half-Duplex communication protocol.

  The device has five GPIO pins (GPIO0-GPIO4 in the datasheet), each
  independently selectable for a single fixed function. This binding
  exposes GPIO0's reset function as reset-gpios; GPIO2's sync function
  is modeled via the clocks property, and GPIO4's DEV_NOK interrupt via
  the interrupts property. GPIO3 (data-ready) is required internally
  regardless of board wiring and isn't exposed. GPIO1 (wake) gates
  whether the bootloader auto-loads its NVM contents after reset; it
  defaults to enabled with a weak pull-up, which already gives normal
  operation with no configuration needed, so it isn't exposed either.

properties:
  compatible:
    enum:
      - adi,adis16607-2
      - adi,adis16607-3

  reg:
    maxItems: 1

  spi-cpha: true

  spi-cpol: true

  spi-max-frequency:
    maximum: 10000000

  vdd-supply: true

  interrupts:
    maxItems: 1

  clocks:
    description:
      Optional external clock for sync mode. If not provided, the internal
      8 kHz clock is used.
    maxItems: 1

  reset-gpios:
    description:
      Optional GPIO for hardware reset, active low. Routes to the
      device's GPIO0 pin, which can be independently set to the reset
      function or left idle via an on-chip register.
    maxItems: 1

required:
  - compatible
  - reg
  - interrupts
  - spi-cpha
  - spi-cpol
  - vdd-supply

allOf:
  - $ref: /schemas/spi/spi-peripheral-props.yaml#

unevaluatedProperties: false

examples:
  - |
    #include <dt-bindings/interrupt-controller/irq.h>
    #include <dt-bindings/gpio/gpio.h>
    spi {
        #address-cells = <1>;
        #size-cells = <0>;

        imu@0 {
            compatible = "adi,adis16607-2";
            reg = <0>;
            spi-cpha;
            spi-cpol;
            spi-max-frequency = <10000000>;
            vdd-supply = <&vdd>;
            interrupts = <4 IRQ_TYPE_LEVEL_HIGH>;
            interrupt-parent = <&gpio>;
            clocks = <&sync_clk>;
            reset-gpios = <&gpio 10 GPIO_ACTIVE_LOW>;
        };
    };
```

## Documentation/devicetree/bindings/mfd/hisilicon,hi6220-reboot-mode.yaml
```yaml
# SPDX-License-Identifier: GPL-2.0-only OR BSD-2-Clause
%YAML 1.2
---
$id: http://devicetree.org/schemas/mfd/hisilicon,hi6220-reboot-mode.yaml#
$schema: http://devicetree.org/meta-schemas/core.yaml#

title: HiSilicon reboot mode system controller

maintainers:
  - Wei Xu <xuwei5@hisilicon.com>

properties:
  compatible:
    items:
      - enum:
          - hisilicon,hi3660-reboot-mode
          - hisilicon,hi6220-reboot-mode
      - const: syscon
      - const: simple-mfd

  reg:
    maxItems: 1

  reboot-mode:
    $ref: /schemas/power/reset/syscon-reboot-mode.yaml#

required:
  - compatible
  - reg

allOf:
  - $ref: syscon-common.yaml#

unevaluatedProperties: false
```

## Documentation/devicetree/bindings/net/adi,axis-net.yaml
```yaml
# SPDX-License-Identifier: (GPL-2.0-only OR BSD-2-Clause)
%YAML 1.2
---
$id: http://devicetree.org/schemas/net/adi,axis-net.yaml#
$schema: http://devicetree.org/meta-schemas/core.yaml#

title: Analog Devices AXI-Stream point-to-point link

maintainers:
  - Analog Devices Inc.

description: |
  A point-to-point network link carried over a pair of AXI-Stream DMA
  channels, used to connect two processors joined by FPGA fabric.

  Each side of the link needs two ADI AXI-DMAC instances configured in stream
  mode: one MEM_TO_DEV to drive the outbound stream, and one DEV_TO_MEM to
  receive the inbound stream. The two sides' DMACs are paired back to back in
  the fabric, ideally through an AXI4-Stream FIFO for elasticity and any
  required clock-domain crossing.

  The receiving DMAC must be configured to terminate its transfer on TLAST, so
  that a posted maximum-size descriptor closes at the end of each frame rather
  than coalescing consecutive frames. The transmitting DMAC must accept
  unaligned source addresses.

  adi,axis-net-eth exposes the link as an Ethernet interface. adi,axis-net-pipe
  exposes it as an L3 point-to-point interface carrying raw IPv4 and IPv6
  packets. Both sides of a link must use the same compatible.

properties:
  compatible:
    enum:
      - adi,axis-net-eth
      - adi,axis-net-pipe

  dmas:
    items:
      - description: outbound channel, must be MEM_TO_DEV
      - description: inbound channel, must be DEV_TO_MEM

  dma-names:
    items:
      - const: tx
      - const: rx

required:
  - compatible
  - dmas
  - dma-names

allOf:
  - if:
      properties:
        compatible:
          const: adi,axis-net-eth
    then:
      $ref: ethernet-controller.yaml#

unevaluatedProperties: false

examples:
  - |
    ethernet {
        compatible = "adi,axis-net-eth";
        dmas = <&net_tx_dma 0>, <&net_rx_dma 0>;
        dma-names = "tx", "rx";
        local-mac-address = [00 0a 35 00 00 01];
    };

  - |
    pipe {
        compatible = "adi,axis-net-pipe";
        dmas = <&pipe_tx_dma 0>, <&pipe_rx_dma 0>;
        dma-names = "tx", "rx";
    };
```
