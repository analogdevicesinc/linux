## Documentation/devicetree/bindings/clock/adi,ad9508.yaml
```yaml
# SPDX-License-Identifier: (GPL-2.0-only OR BSD-2-Clause)
# Copyright 2026 Analog Devices Inc.
%YAML 1.2
---
$id: http://devicetree.org/schemas/clock/adi,ad9508.yaml#
$schema: http://devicetree.org/meta-schemas/core.yaml#

title: Analog Devices AD9508 Clock Fanout Buffer

maintainers:
  - Rodrigo Alencar <rodrigo.alencar@analog.com>

description:
  The AD9508 is a 1.65 GHz clock fanout buffer with four outputs. Each
  output has a 10-bit integer divider (1 to 1024), a coarse phase offset in
  steps of half an input clock period and an LVDS, HSTL or 1.8 V CMOS driver.

  The device is controlled over SPI or I2C, as selected by the PROG_SEL pin.
  In I2C mode the 7-bit address is 0x6c to 0x6f, set by the S4 and S5 pins.

  Divider and phase offset changes take effect on the rising edge of the
  active low SYNC signal, either the SYNC pin or a software SYNC bit. While
  SYNC is asserted, every output that is not masked from synchronization is
  held low.

  https://www.analog.com/media/en/technical-documentation/data-sheets/AD9508.pdf

properties:
  compatible:
    const: adi,ad9508

  reg:
    maxItems: 1
    description: SPI chip select or I2C address.

  clocks:
    items:
      - description: CLK input.

  '#clock-cells':
    const: 1

  clock-output-names:
    minItems: 1
    maxItems: 4

  vdd-supply:
    description: 2.5 V or 3.3 V power supply (VDD pins).

  reset-gpios:
    description: GPIO connected to the active low RESET pin.
    maxItems: 1

  sync-gpios:
    description:
      GPIO connected to the active low SYNC pin. When absent, the software
      SYNC bit is used to synchronize the outputs.
    maxItems: 1

  '#address-cells':
    const: 1

  '#size-cells':
    const: 0

patternProperties:
  "^clock-output@[0-3]$":
    type: object
    description: Configuration of one output channel.
    additionalProperties: false

    properties:
      reg:
        description: Output channel index.
        maximum: 3

      adi,output-mode:
        description:
          Output driver mode. LVDS modes are expressed as multiples of the
          nominal 3.5 mA output current. In CMOS mode the OUTx and
          complementary OUTx pins are two single-ended 1.8 V CMOS outputs,
          configured with adi,cmos-p-mode and adi,cmos-n-mode.
        $ref: /schemas/types.yaml#/definitions/string
        enum:
          - lvds-0.5x
          - lvds-0.75x
          - lvds
          - lvds-1.25x
          - hstl
          - hstl-boost
          - cmos
        default: lvds

      adi,output-polarity:
        description:
          State of the LVDS or HSTL differential driver, either the output
          clock, the inverted output clock or a static logic level.
        $ref: /schemas/types.yaml#/definitions/string
        enum: [normal, inverted, force-high, force-low]
        default: normal

      adi,cmos-p-mode:
        description:
          State of the OUTx pin CMOS driver, either off, the output clock,
          the inverted output clock or a static logic level.
        $ref: /schemas/types.yaml#/definitions/string
        enum: [disabled, normal, inverted, force-high, force-low]
        default: normal

      adi,cmos-n-mode:
        description:
          State of the complementary OUTx pin CMOS driver, with the same
          values as adi,cmos-p-mode. The default makes the two pins
          complementary, like a differential output.
        $ref: /schemas/types.yaml#/definitions/string
        enum: [disabled, normal, inverted, force-high, force-low]
        default: inverted

      adi,sync-ignore:
        description:
          Exclude this output from the synchronization of the other outputs,
          so that it keeps toggling when the others are synchronized. The
          phase offset of an excluded output cannot be adjusted.
        type: boolean

      adi,output-delay-ps:
        description:
          Delay of this output relative to the other synchronized outputs,
          for instance to compensate for board trace length mismatches. The
          delay is applied by the phase offset, in steps of half an input
          clock period, up to 2047 steps. It is kept when the output divider
          is changed.

    required:
      - reg

    allOf:
      - if:
          required:
            - adi,output-mode
          properties:
            adi,output-mode:
              const: cmos
        then:
          properties:
            adi,output-polarity: false
        else:
          properties:
            adi,cmos-p-mode: false
            adi,cmos-n-mode: false
      - if:
          required:
            - adi,sync-ignore
        then:
          properties:
            adi,output-delay-ps: false

required:
  - compatible
  - reg
  - clocks
  - '#clock-cells'
  - vdd-supply

allOf:
  - $ref: /schemas/spi/spi-peripheral-props.yaml#

unevaluatedProperties: false

examples:
  - |
    #include <dt-bindings/gpio/gpio.h>

    spi {
        #address-cells = <1>;
        #size-cells = <0>;

        clock-controller@0 {
            compatible = "adi,ad9508";
            reg = <0>;
            spi-max-frequency = <10000000>;
            clocks = <&ref_clk>;
            #clock-cells = <1>;
            clock-output-names = "ad9508-out0", "ad9508-out1",
                                 "ad9508-out2", "ad9508-out3";
            vdd-supply = <&vdd_3v3>;
            reset-gpios = <&gpio 10 GPIO_ACTIVE_LOW>;
            sync-gpios = <&gpio 11 GPIO_ACTIVE_LOW>;
            #address-cells = <1>;
            #size-cells = <0>;

            clock-output@0 {
                reg = <0>;
                adi,output-mode = "hstl";
                adi,output-polarity = "inverted";
                adi,output-delay-ps = <500>;
            };

            clock-output@3 {
                reg = <3>;
                adi,output-mode = "cmos";
                adi,cmos-n-mode = "disabled";
                adi,sync-ignore;
            };
        };
    };

  - |
    i2c {
        #address-cells = <1>;
        #size-cells = <0>;

        clock-controller@6c {
            compatible = "adi,ad9508";
            reg = <0x6c>;
            clocks = <&ref_clk>;
            #clock-cells = <1>;
            vdd-supply = <&vdd_3v3>;
        };
    };
...
```

## Documentation/devicetree/bindings/clock/amlogic,s7-peripherals-clkc.yaml
```yaml
# SPDX-License-Identifier: (GPL-2.0-only OR BSD-2-Clause)
# Copyright (c) 2026 BayLibre, SAS.
%YAML 1.2
---
$id: http://devicetree.org/schemas/clock/amlogic,s7-peripherals-clkc.yaml#
$schema: http://devicetree.org/meta-schemas/core.yaml#

title: Amlogic S7 Series Peripherals Clock Controller

maintainers:
  - Neil Armstrong <neil.armstrong@linaro.org>
  - Jerome Brunet <jbrunet@baylibre.com>
  - Carlo Caione <ccaione@baylibre.com>

description:
  The peripherals clock controller provides the system (bus) clock, the bus
  clock gates and the clocks of the peripherals. Its inputs are the board
  oscillator, the fixed PLL dividers and the GP0, HIFI0 and HIFI1 PLLs of the
  PLL block, the GP1 PLL and the CPU AXI clock provided by the firmware, the
  HDMI PLL and its pixel clock, and a few optional sources from outside the
  clock controllers (pads, audio codec).

properties:
  compatible:
    const: amlogic,s7-peripherals-clkc

  reg:
    maxItems: 1

  '#clock-cells':
    const: 1

  clocks:
    minItems: 14
    items:
      - description: input fixed pll div2
      - description: input fixed pll div2p5
      - description: input fixed pll div3
      - description: input fixed pll div4
      - description: input fixed pll div5
      - description: input fixed pll div7
      - description: input hifi0 pll
      - description: input gp0 pll
      - description: input hifi1 pll
      - description: input gp1 pll
      - description: input hdmi pll
      - description: input hdmi pll pixel clk
      - description: input oscillator (usually at 24MHz)
      - description: input axi clk from the cpu
      - description: input external 32kHz reference (optional)
      - description: input external rmii reference (optional)
      - description: input audio codec dac clk (optional)

  clock-names:
    minItems: 14
    items:
      - const: fclk_div2
      - const: fclk_div2p5
      - const: fclk_div3
      - const: fclk_div4
      - const: fclk_div5
      - const: fclk_div7
      - const: hifi0_pll
      - const: gp0_pll
      - const: hifi1_pll
      - const: gp1_pll
      - const: hdmi_pll
      - const: vid_pix
      - const: xtal
      - const: axi_frcpu
      - const: ext_32k
      - const: ext_rmii
      - const: acodec_dac

required:
  - compatible
  - reg
  - '#clock-cells'
  - clocks
  - clock-names

additionalProperties: false

examples:
  - |
    #include <dt-bindings/clock/amlogic,s7-pll-clkc.h>

    soc {
        #address-cells = <2>;
        #size-cells = <2>;

        clock-controller@fe000000 {
            compatible = "amlogic,s7-peripherals-clkc";
            reg = <0x0 0xfe000000 0x0 0x49c>;
            #clock-cells = <1>;
            clocks = <&clkc_pll CLKID_FCLK_DIV2>,
                     <&clkc_pll CLKID_FCLK_DIV2P5>,
                     <&clkc_pll CLKID_FCLK_DIV3>,
                     <&clkc_pll CLKID_FCLK_DIV4>,
                     <&clkc_pll CLKID_FCLK_DIV5>,
                     <&clkc_pll CLKID_FCLK_DIV7>,
                     <&clkc_pll CLKID_HIFI0_PLL>,
                     <&clkc_pll CLKID_GP0_PLL>,
                     <&clkc_pll CLKID_HIFI1_PLL>,
                     <&scmi_clk 11>,
                     <&clkc_pll CLKID_HDMI_PLL>,
                     <&clkc_pll CLKID_HDMI_PLL_PIX>,
                     <&xtal>,
                     <&scmi_clk 12>;
            clock-names = "fclk_div2",
                          "fclk_div2p5",
                          "fclk_div3",
                          "fclk_div4",
                          "fclk_div5",
                          "fclk_div7",
                          "hifi0_pll",
                          "gp0_pll",
                          "hifi1_pll",
                          "gp1_pll",
                          "hdmi_pll",
                          "vid_pix",
                          "xtal",
                          "axi_frcpu";
        };
    };
```

## Documentation/devicetree/bindings/clock/amlogic,s7-pll-clkc.yaml
```yaml
# SPDX-License-Identifier: (GPL-2.0-only OR BSD-2-Clause)
# Copyright (c) 2026 BayLibre, SAS.
%YAML 1.2
---
$id: http://devicetree.org/schemas/clock/amlogic,s7-pll-clkc.yaml#
$schema: http://devicetree.org/meta-schemas/core.yaml#

title: Amlogic S7 Series PLL Clock Controller

maintainers:
  - Neil Armstrong <neil.armstrong@linaro.org>
  - Jerome Brunet <jbrunet@baylibre.com>
  - Carlo Caione <ccaione@baylibre.com>

properties:
  compatible:
    const: amlogic,s7-pll-clkc

  reg:
    maxItems: 1

  '#clock-cells':
    const: 1

  clocks:
    items:
      - description: input fixed pll
      - description: input gp0 pll
      - description: input hifi0 pll
      - description: input hifi1 pll
      - description: input hdmi pll

  clock-names:
    items:
      - const: fix
      - const: gp0
      - const: hifi0
      - const: hifi1
      - const: hdmi

required:
  - compatible
  - reg
  - '#clock-cells'
  - clocks
  - clock-names

additionalProperties: false

examples:
  - |
    soc {
        #address-cells = <2>;
        #size-cells = <2>;

        clock-controller@fe008000 {
            compatible = "amlogic,s7-pll-clkc";
            reg = <0x0 0xfe008000 0x0 0x1e8>;
            #clock-cells = <1>;
            clocks = <&scmi_clk 2>,
                     <&scmi_clk 2>,
                     <&scmi_clk 2>,
                     <&scmi_clk 2>,
                     <&scmi_clk 3>;
            clock-names = "fix",
                          "gp0",
                          "hifi0",
                          "hifi1",
                          "hdmi";
        };
    };
```

## Documentation/devicetree/bindings/iio/adc/ti,tla2528.yaml
```yaml
# SPDX-License-Identifier: (GPL-2.0 OR BSD-2-Clause)
%YAML 1.2
---
$id: http://devicetree.org/schemas/iio/adc/ti,tla2528.yaml#
$schema: http://devicetree.org/meta-schemas/core.yaml#

title: Texas Instruments TLA2528 8-channel 12-bit I2C ADC

maintainers:
  - Maxime Chevallier <maxime.chevallier@bootlin.com>

description:
  Each of the 8 input pins can be configured as an analog input, a digital
  input or a digital output.

properties:
  compatible:
    const: ti,tla2528

  reg:
    maxItems: 1

  avdd-supply:
    description: Analog supply, also used as the ADC reference voltage.

  dvdd-supply: true

  gpio-controller: true

  "#gpio-cells":
    const: 2

  "#io-channel-cells":
    const: 1

  "#address-cells":
    const: 1

  "#size-cells":
    const: 0

patternProperties:
  "^channel@[0-7]$":
    type: object
    $ref: adc.yaml
    description: Represents an analog input.

    properties:
      reg:
        description: AIN pin number
        minimum: 0
        maximum: 7

    required:
      - reg

    unevaluatedProperties: false

required:
  - compatible
  - reg
  - avdd-supply
  - dvdd-supply

additionalProperties: false

examples:
  - |
    i2c {
        #address-cells = <1>;
        #size-cells = <0>;

        adc@17 {
            compatible = "ti,tla2528";
            reg = <0x17>;
            avdd-supply = <&reg_adc_supply>;
            dvdd-supply = <&reg_adc_supply>;
            #io-channel-cells = <1>;
            #address-cells = <1>;
            #size-cells = <0>;

            channel@0 {
                reg = <0>;
            };

            channel@3 {
                reg = <3>;
            };
        };
    };
...
```
