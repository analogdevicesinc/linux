## Documentation/devicetree/bindings/display/panel/jdi,tx26d202vm0bwa.txt
```
Japan Display Inc. 10.1" WUXGA (1920x1200) TFT LCD panel

The panel has dual LVDS channels.

Required properties:
- compatible: should be "jdi,tx26d202vm0bwa"

This binding is compatible with the simple-panel binding, which is specified
in simple-panel.txt in this directory.
```

## Documentation/devicetree/bindings/display/panel/raydium,rm67191.txt
```
Raydium RM67171 OLED LCD panel with MIPI-DSI protocol

Required properties:
- compatible: 		"raydium,rm67191"
- reg:			virtual channel for MIPI-DSI protocol
			must be <0>
- dsi-lanes:		number of DSI lanes to be used
			must be <3> or <4>
- port: 		input port node with endpoint definition as
			defined in Documentation/devicetree/bindings/graph.txt;
			the input port should be connected to a MIPI-DSI device
			driver

Optional properties:
- reset-gpio:		a GPIO spec for the RST_B GPIO pin
- display-timings:	timings for the connected panel according to [1]
- pinctrl-0		phandle to the pin settings for the reset pin
- panel-width-mm:	physical panel width [mm]
- panel-height-mm:	physical panel height [mm]

[1]: Documentation/devicetree/bindings/display/display-timing.txt

Example:

	panel@0 {
		compatible = "raydium,rm67191";
		reg = <0>;
		pinctrl-0 = <&pinctrl_mipi_dsi_0_1_en>;
		reset-gpio = <&gpio1 7 GPIO_ACTIVE_HIGH>;
		dsi-lanes = <4>;
		panel-width-mm = <68>;
		panel-height-mm = <121>;
		display-timings {
			timing {
				clock-frequency = <132000000>;
				hactive = <1080>;
				vactive = <1920>;
				hback-porch = <11>;
				hfront-porch = <4>;
				vback-porch = <48>;
				vfront-porch = <20>;
				hsync-len = <5>;
				vsync-len = <12>;
				hsync-active = <0>;
				vsync-active = <0>;
				de-active = <0>;
				pixelclk-active = <0>;
			};
		};
		port {
			panel1_in: endpoint {
				remote-endpoint = <&mipi1_out>;
			};
		};
	};
```

## Documentation/devicetree/bindings/display/panel/raydium,rm692c9.yaml
```yaml
# SPDX-License-Identifier: GPL-2.0
%YAML 1.2
---
$id: http://devicetree.org/schemas/display/panel/raydium,rm692c9.yaml#
$schema: http://devicetree.org/meta-schemas/core.yaml#

title: Raydium RM692c9 OLED LCD panel with MIPI-DSI protocol

maintainers:
  - Praveen Adi <praveen.adi@nxp.com>
  - Liu Ying <victor.liu@nxp.com>

allOf:
  - $ref: panel-common.yaml#

properties:
  compatible:
    const: raydium,rm692c9

  reg: true
  port: true
  reset-gpios: true
  width-mm: true
  height-mm: true

  dsi-lanes:
    description: Number of DSI lanes to be used must be <2> or <3> or <4>
    $ref: /schemas/types.yaml#/definitions/uint32
    enum: [2, 3, 4]

  v3p3-supply:
    description: phandle to 3.3V regulator that powers the VDD_3V3 pin

  v1p8-supply:
    description: phandle to 1.8V regulator that powers the VDD_1V8 pin

required:
  - compatible
  - reg
  - dsi-lanes
  - port

additionalProperties: false

examples:
  - |
    #include <dt-bindings/gpio/gpio.h>

    dsi {
        #address-cells = <1>;
        #size-cells = <0>;

        panel@0 {
            compatible = "raydium,rm692c9";
            reg = <0>;
            reset-gpios = <&gpio1 7 GPIO_ACTIVE_LOW>;
            dsi-lanes = <4>;

            port {
                panel_in: endpoint {
                    remote-endpoint = <&mipi_out>;
                };
            };
        };
    };

...
```

## Documentation/devicetree/bindings/display/panel/rocktech,himax8394f.yaml
```yaml
# SPDX-License-Identifier: GPL-2.0
%YAML 1.2
---
$id: http://devicetree.org/schemas/display/panel/rocktech,himax8394f.yaml#
$schema: http://devicetree.org/meta-schemas/core.yaml#

title: Rocktech Himax8394f 720x1280 TFT LCD panel

maintainers:
  - Liu Ying <victor.liu@nxp.com>

description:
  Rocktech Himax8394f is a 720x1280 TFT LCD panel
  connected using a MIPI-DSI video interface.

allOf:
  - $ref: panel-common.yaml#

properties:
  compatible:
    const: rocktech,himax8394f

  reg:
    maxItems: 1
    description: DSI virtual channel

  himax,dsi-lanes:
    description: Number of DSI lanes to be used must be <1> or <2> or <3> or <4>
    enum: [1, 2, 3, 4]

  enable-gpios: true
  port: true

  vcc-supply:
    description: A typical 2.8V supply(minimum 2.5V, maximum 3.6V).

  iovcc-supply:
    description: A typical 1.8V supply(minimum 1.65V, maximum 3.6V).

  reset-gpios:
    maxItems: 1

additionalProperties: false

required:
  - compatible
  - reg
  - himax,dsi-lanes
  - vcc-supply
  - iovcc-supply

examples:
  - |
    dsi {
      #address-cells = <1>;
      #size-cells = <0>;
      panel@0 {
        compatible = "rocktech,himax8394f";
        reg = <0>;
        himax,dsi-lanes = <2>;
        enable-gpios = <&pca6416_1 9 GPIO_ACTIVE_HIGH>;
        reset-gpios = <&gpiof 8 GPIO_ACTIVE_LOW>;
        vcc-supply = <&reg_5v>;
        iovcc-supply = <&reg_5v>;
      };
    };
...
```

## Documentation/devicetree/bindings/display/panel/tianma,tm050rdh03.yaml
```yaml
# SPDX-License-Identifier: (GPL-2.0-only OR BSD-2-Clause)
%YAML 1.2
---
$id: http://devicetree.org/schemas/display/panel/tianma,tm050rdh03.yaml#
$schema: http://devicetree.org/meta-schemas/core.yaml#

title: Tianma TM050RDH03 5.0" WVGA TFT LCD panel

maintainers:
  - Liu Ying <victor.liu@nxp.com>

description: |
  This panel can be put into standby mode by setting the input STBYB signal to
  zero.

allOf:
  - $ref: panel-common.yaml#

properties:
  compatible:
    const: tianma,tm050rdh03

  standby-gpios:
    maxItems: 1
    description: |
      Standby mode.
      STBYB="1": Normal operation mode.
      STBYB="0": Standby mode. Timing controller and source driver will be
                 turned off. All outputs are High-Z.

  backlight: true
  power-supply: true
  port: true

required:
  - compatible
  - port

additionalProperties: false

examples:
  - |
    #include <dt-bindings/gpio/gpio.h>

    panel {
        compatible = "tianma,tm050rdh03";
        standby-gpios = <&gpio2 27 GPIO_ACTIVE_LOW>;    /* STBYB */
        backlight = <&backlight>;
        power-supply = <&reg_vrpi_3v3>;

        port {
            panel_in: endpoint {
                remote-endpoint = <&display_out>;
            };
        };
    };

...
```

## Documentation/devicetree/bindings/display/panel/wks,101wx001.yaml
```yaml
# SPDX-License-Identifier: GPL-2.0
%YAML 1.2
---
$id: http://devicetree.org/schemas/display/panel/wks,101wx001.yaml#
$schema: http://devicetree.org/meta-schemas/core.yaml#

title: WKS 101WX001 10.1" WXGA TFT LCD panel

description:
  The WKS 101WX001 is a 10.1" WXGA (1280 x 800) TFT LCD panel with a 24-bit RGB
  parallel data interface.

maintainers:
  - Robert Chiras <robert.chiras@nxp.com>

allOf:
  - $ref: panel-common.yaml#

properties:
  compatible:
    const: wks,101wx001

  label: false
  port: true

  vcc-supply:
    description: 5v analog power regulator

  blctr-gpios:
    description: GPIO used for BL_CNTR pin, controlling the panel backlight
                 (this is not a pwm backlight, it's only a GPIO controlled
                 backlight)
    maxItems: 1

  pinctrl-assert-gpios:
    description: Default states for various gpios used as selectors for on-board
                 muxes

required:
  - compatible
  - port

additionalProperties: false

examples:
  - |
    #include <dt-bindings/gpio/gpio.h>
    panel {
      compatible = "wks,101wx001";
      blctr-gpios = <&gpioa 5 GPIO_ACTIVE_HIGH>;
      pinctrl-assert-gpios = <&gpiob 3 GPIO_ACTIVE_LOW>,
                             <&gpiob 4 GPIO_ACTIVE_LOW>,
                             <&gpiob 6 GPIO_ACTIVE_LOW>,
                             <&gpiob 7 GPIO_ACTIVE_LOW>,
                             <&gpiob 8 GPIO_ACTIVE_LOW>;

      port {
        panel_in: endpoint {
          remote-endpoint = <&lcdif_out>;
        };
      };
    };
```

## Documentation/devicetree/bindings/dma/adi-dma.txt
```
* Analog Devices Direct Memory Access (DMA) Controller for ADRV906X-series processors

This document will only describe differences to the generic DMA Controller and
DMA request bindings as described in dma/dma.txt

* DMA controller

Required properties:
- compatible : Should be "adi,mdma-controller" or "adi,dma-controller".
- reg : Should contain DMA registers location and length
- #dma-cells : Has to be 1. Does not support anything else.
- interrupts : subnode, containing:
    adi,id:
    adi,src-offset: Offset from base address
    adi,skip-interrupts: Set to 0 usually.  Setting to 1 will skip handling interrupts,
                         so the SHARC cores may handle them instead.
    interrupts: list of interrupts, from processor's GIC interrupt list
    interrupt-names: list of interrupt names
Optional properties:
- dde-descriptor-mode : this is optionally specified for a dma channel. A dma channel with this
                        property runs in descriptor list mode. otherwise the dma channel 
                        runs in register based mode.
- dde-sync-bit-disable: disable the DDE sync bit for a dma channel. A sync bit is used to synchronize
                        work unit transitions.
                
Example (DMA):

    sport0_dma_cluster: dma@0x31022000 {
            compatible = "adi,dma-controller";
            reg = <0x31022000 0x1000>;
            status = "okay";
            #dma-cells = <1>;

            sport0a: channel@0 {
                    adi,id = <0>;
                    adi,src-offset = <0>;
                    adi,skip-interrupts = <0>;
                    interrupts = <GIC_SPI 81 IRQ_TYPE_LEVEL_HIGH>,
                            <GIC_SPI 297 IRQ_TYPE_LEVEL_HIGH>;
                    interrupt-names = "complete", "error";
            };

            sport0b: channel@1 {
                    adi,id = <1>;
                    adi,src-offset = <0x80>;
                    adi,skip-interrupts = <0>;
                    interrupts = <GIC_SPI 83 IRQ_TYPE_LEVEL_HIGH>,
                            <GIC_SPI 298 IRQ_TYPE_LEVEL_HIGH>;
                    interrupt-names = "complete", "error";
            };
    };

Example (MDMA):

    mdma: dma@0x3109a000 {
            compatible = "adi,mdma-controller";
            reg = <0x3109a000 0x1000>;
            status = "okay";

            sdma2: channel@40 {
                    adi,id = <40>;
                    // The destination interrupts are used for primary complete detection
                    interrupts = <GIC_SPI 207 IRQ_TYPE_LEVEL_HIGH>,
                            <GIC_SPI 286 IRQ_TYPE_LEVEL_HIGH>,
                            <GIC_SPI 206 IRQ_TYPE_LEVEL_HIGH>,
                            <GIC_SPI 285 IRQ_TYPE_LEVEL_HIGH>;
                    interrupt-names = "complete", "error", "complete2", "error2";
                    adi,src-offset = <0>;
                    adi,dest-offset = <0x80>;
            };
    };

* DMA client

Clients have to specify the DMA requests with phandles in a list.

Required properties:
- dmas: List of one or more DMA request specifiers. One DMA request specifier
    consists of a phandle to the DMA controller followed by the integer
    specifying the request line.
- dma-names: List of string identifiers for the DMA requests. For the correct
    names, have a look at the specific client driver.

Example:

    i2s0: i2s0@0 {
            ...
            dmas = <&sport0_dma_cluster 0>, <&sport0_dma_cluster 1>;
            dma-names = "tx", "rx";
            ...
    };

From a driver level, additional configuration of things like bus width can set via:

    dma_config.direction = DMA_DEV_TO_MEM;
    dma_config.src_addr_width = DMA_SLAVE_BUSWIDTH_4_BYTES;
    dma_config.dst_addr_width = DMA_SLAVE_BUSWIDTH_4_BYTES;
    dma_config.src_maxburst = 1;
    dma_config.dst_maxburst = 1;

    dmaengine_slave_config(crc->dma_ch, &dma_config);

Or cyclic mode can be enabled via something like:
    (a cyclic descriptor will reuse itself, triggering callbacks as expected, * and will not free itself when it finishes)

    desc = dmaengine_prep_dma_cyclic(uart->rx_dma_channel, uart->rx_dma_phy,
        UART_XMIT_SIZE, DMA_RX_XCOUNT, DMA_DEV_TO_MEM, DMA_PREP_INTERRUPT);
    desc->callback = adi_uart4_serial_dma_rx;
    desc->callback_param = uart;

MDMA controllers can be found automatically through the kernel's standard DMA memcpy API:

    struct dma_chan *chan = dma_find_channel(DMA_MEMCPY);
```

## Documentation/devicetree/bindings/dma/fsl-edma-v3.txt
```
* Freescale enhanced Direct Memory Access(eDMA-v3) Controller

  The eDMA-v3 controller is inherited from FSL eDMA, and firstly is intergrated
  on Freescale i.MX8QM SOC chip. The eDMA channels have multiplex capability by
  programmble memory-mapped registers. Specific DMA request source has fixed channel.

* eDMA Controller
Required properties:
- compatible :
	- "fsl,imx8qm-edma" for eDMA used similar to that on i.MX8QM SoC
	- "fsl,imx8qm-adma" for audio eDMA used on i.MX8QM
- reg : Specifies base physical address(s) and size of the eDMA channel registers.
	Each eDMA channel has separated register's address and size.
- interrupts : A list of interrupt-specifiers, each channel has one interrupt.
- interrupt-names : Should contain:
	"edma-chan12-tx" - the channel12 transmission interrupt
- #dma-cells : Must be <3>.
	The 1st cell specifies the channel ID.
	The 2nd cell specifies the channel priority.
	The 3rd cell specifies the channel type like for transmit or receive:
		0: transmit, 1: receive.
	See the SoC's reference manual for all the supported request sources.
- dma-channels : Number of channels supported by the controller

Examples:
edma0: dma-controller@40018000 {
	compatible = "fsl,imx8qm-edma";
	reg = <0x0 0x5a2c0000 0x0 0x10000>, /* channel12 UART0 rx */
	      <0x0 0x5a2d0000 0x0 0x10000>, /* channel13 UART0 tx */
	      <0x0 0x5a2e0000 0x0 0x10000>, /* channel14 UART1 rx */
	      <0x0 0x5a2f0000 0x0 0x10000>; /* channel15 UART1 tx */
	#dma-cells = <3>;
	dma-channels = <4>;
	interrupts = <GIC_SPI 434 IRQ_TYPE_LEVEL_HIGH>,
		     <GIC_SPI 435 IRQ_TYPE_LEVEL_HIGH>,
		     <GIC_SPI 436 IRQ_TYPE_LEVEL_HIGH>,
		     <GIC_SPI 437 IRQ_TYPE_LEVEL_HIGH>;
	interrupt-names = "edma-chan12-tx", "edma-chan13-tx",
			  "edma-chan14-tx", "edma-chan15-tx";
	status = "okay";
};

* DMA clients
DMA client drivers that uses the DMA function must use the format described
in the dma.txt file, using a three-cell specifier for each channel: the 1st
specifies the channel number, the 2nd specifies the priority, and the 3rd
specifies the channel type is for transmit or receive: 0: transmit, 1: receive.

Examples:
lpuart1: serial@5a070000 {
	compatible = "fsl,imx8qm-lpuart";
	reg = <0x0 0x5a070000 0x0 0x1000>;
	interrupts = <GIC_SPI 226 IRQ_TYPE_LEVEL_HIGH>;
	interrupt-parent = <&gic>;
	clocks = <&clk IMX8QM_UART1_CLK>;
	clock-names = "ipg";
	assigned-clock-names = <&clk IMX8QM_UART1_CLK>;
	assigned-clock-rates = <80000000>;
	power-domains = <&pd_dma_lpuart1>;
	dma-names = "tx","rx";
	dmas = <&edma0 15 0 0>,
		<&edma0 14 0 1>;
	status = "disabled";
};
```

## Documentation/devicetree/bindings/edac/adi,adrv906x-ddrc.yaml
```yaml
# SPDX-License-Identifier: GPL-2.0-only OR BSD-2-Clause
%YAML 1.2
---
$id: http://devicetree.org/schemas/edac/adi,adrv906x-ddrc.yaml#
$schema: http://devicetree.org/meta-schemas/core.yaml#

title: ADI ADRV906X EDAC

maintainers:
  - Xin Xu <xin.xu@analog.com>

description: Binding for ADRV906X EDAC Interface Using SMC Calls

properties:
  compatible:
    items:
      - const: adi,adrv906x-ddrc

  reg:
    items:
      - description: ddr_ctl base register address and range

  interrupts:
    items:
      - description: CE interrupt
      - description: UE interrupt

required:
  - compatible
  - reg
  - interrupts

additionalProperties: false

examples:
  - |
    mc: memory-controller@202b0000 {
        compatible = "adi,adrv906x-ddrc";
        reg = <0x202b0000 0x30000>;
        interrupt-parent = <&gic>;
        interrupts = <0 143 0x4>, <0 145 0x4>;
    };
```
