## Documentation/devicetree/bindings/crypto/adi,pkte.yaml
```yaml
# SPDX-License-Identifier: (GPL-2.0-only OR BSD-2-Clause)
%YAML 1.2
---
$id: http://devicetree.org/schemas/crypto/adi,hmac-crc.yaml#
$schema: http://devicetree.org/meta-schemas/core.yaml#

title: Analog Devices Packet Engine for SC5XX Processor Family

maintainers:
  - Nathan Barrett-Morrison <nathan.morrison@timesys.com>
  - Greg Malysa <greg.malysa@timesys.com>

description: |
  Packet Engine driver for SC5XX-processor family.

  Adds in hashing support for:
  sha256, sha224, sha1, md5
  hmac(sha256), hmac(sha224), hmac(sha1), hmac(md5)

  Adds in skcipher support for:
  cbc(aes), cbc(des), cbc(des3_ede), ecb(des3_ede), ecb(des), and ecb(aes)

  Note on HMAC operations:

  The PKTE peripheral has a limitation that it cannot split HMAC operations
  into multiple crypto packets.

  Instead of using the PKTE to calculate the HMAC directly, let's use the
  PKTE's hash engine and manually combined together the two operations in
  RFC2104 to produce the HMAC result:

  HASH(Key XOR opad, HASH(Key XOR ipad, text))

  So, this means the two HASH algorithms above are being calculated via
  the PKTE, but everything else is being performed in software:

  1) Calculate [Key XOR ipad] in software
  2) Send [Key XOR ipad] to the PKTE and start hashing
  3) Continue hashing for the entirety of [text] and set the final/hash
     completion flag
  4) Store the hash result from 3
  5) Calculate [Key XOR opad] in software
  6) Append 4 to 5 and send the data to the PKTE for hashing again
  7) Store the final result from 6.  This is your HMAC result.

properties:
  compatible:
    enum:
      - adi,pkte

  reg:
    maxItems: 1

  interrupts:
    maxItems: 1
    description: "GIC interrupt numbers"

  mode:
    maxItems: 1
    description: "Select between autonomous ring, target command, or direct host modes"

required:
  - compatible
  - reg
  - interrupts
  - mode

additionalProperties: false

examples:
  - |
    pkte1: pkte@310CD000 {
      compatible = "adi,pkte";
      reg = <0x310CD000 0x400>;
      interrupts = <GIC_SPI 161 IRQ_TYPE_LEVEL_HIGH>;
      mode = "arm";        /* autonomous ring mode */
      /* mode = "tcm"; */  /* target command mode  */
      /* mode = "dhm"; */  /* direct host mode     */
      status = "okay";
    };
```

## Documentation/devicetree/bindings/display/bridge/it6263.txt
```
ITE IT6263 LVDS to HDMI bridge bindings

Required properties:
	- compatible: "ite,it6263"
	- reg: i2c address of the bridge
	- video input: this subnode can contain a video input port node
	  to connect the bridge to a LVDS output interface (See this
	  documentation [1]).

Optional properties:
	- split-mode: boolean. if this exists, split mode is enabled,
	  otherwise, single mode is enabled.
	- reset-gpios: OF device-tree gpio specification for SYSRSTN pin.

[1]: Documentation/devicetree/bindings/media/video-interfaces.txt

Example:
	lvds-to-hdmi-bridge@4c {
		compatible = "ite,it6263";
		reg = <0x4c>;

		port {
			it6263_0_in: endpoint {
				remote-endpoint = <&lvds0_out>;
			};
		};
	};
```

## Documentation/devicetree/bindings/display/bridge/maxim,max96752-lvds-bridge.yaml
```yaml
# SPDX-License-Identifier: (GPL-2.0-only OR BSD-2-Clause)
%YAML 1.2
---
$id: http://devicetree.org/schemas/display/bridge/maxim,max96752-lvds-bridge.yaml#
$schema: http://devicetree.org/meta-schemas/core.yaml#

title: Maxim MAX96752 deserializer LVDS subdevice

maintainers:
  - Laurentiu Palcu <laurentiu.palcu@oss.nxp.com>

description: |
  The MAX96752/MAX96754 convert a single video stream received on a single- or dual-link GMSL2 input
  to an LVDS(OLDI) output for driving display panels. Video data is mapped to OLDI output ports
  A, B, or both. The output can drive with OLDI or VESA formats.

properties:
  compatible:
    enum:
      - maxim,max96752-lvds

  '#address-cells':
    const: 1

  '#size-cells':
    const: 0

  maxim,dual-channel:
    description: Indicates whether to activate dual-channel LVDS output or not.
    type: boolean

  port:
    $ref: /schemas/graph.yaml#/$defs/port-base
    unevaluatedProperties: false
    description: LVDS output port

    properties:
      endpoint@0:
        $ref: /schemas/graph.yaml#/properties/endpoint
        description: Input video stream.

      endpoint@1:
        $ref: /schemas/graph.yaml#/properties/endpoint
        description: Output video stream.

required:
  - compatible
  - '#address-cells'
  - '#size-cells'
  - port

additionalProperties: false
```

## Documentation/devicetree/bindings/display/bridge/maxim,max96789-dsi-bridge.yaml
```yaml
# SPDX-License-Identifier: (GPL-2.0-only OR BSD-2-Clause)
%YAML 1.2
---
$id: http://devicetree.org/schemas/display/bridge/maxim,max96789-dsi-bridge.yaml#
$schema: http://devicetree.org/meta-schemas/core.yaml#

title: Maxim MAX96789 serializer MIPI-DSI subdevice

maintainers:
  - Laurentiu Palcu <laurentiu.palcu@oss.nxp.com>

description: |
  The MAX96789/MAX96791 family of serializers convert dual MIPI DSI, four-lane input port data to
  dual Maxim Integrated’s GMSL 1 or 2 high-speed serial link protocol.

properties:
  compatible:
    enum:
      - maxim,max96789-dsi

  reg:
    description: The DSI input port number.
    maxItems: 1

  '#address-cells':
    const: 1

  '#size-cells':
    const: 0

  port:
    $ref: /schemas/graph.yaml#/$defs/port-base
    unevaluatedProperties: false
    description: DSI input port

    properties:
      endpoint@0:
        $ref: /schemas/graph.yaml#/$defs/endpoint-base
        unevaluatedProperties: false
        description: DSI controller

        properties:
          data-lanes:
            description: array of physical DSI data lane indexes.
            minItems: 1
            items:
              - const: 1
              - const: 2
              - const: 3
              - const: 4

      endpoint@1:
        $ref: /schemas/graph.yaml#/properties/endpoint

required:
  - compatible
  - reg
  - '#address-cells'
  - '#size-cells'
  - port

additionalProperties: false
```

## Documentation/devicetree/bindings/display/bridge/nwl_dsi.txt
```
Northwest Logic MIPI-DSI bridge bindings

The MIPI-DSI host controller drives the video signals from
display controller to video peripherals using DSI protocol.
This is an un-managed DSI bridge. In order to use this bridge, an encoder
or bridge must be implemented to manage the platform specific initializations.

Required properties:
- compatible: 		"nwl,mipi-dsi"
- reg: 			the register range of the MIPI-DSI controller
- interrupts: 		the interrupt number for this module
- clock, clock-names: 	phandles to the MIPI-DSI clocks
	"phy_ref" - PHY_REF clock
	"tx_esc"  - TX_ESC clock (used in escape mode)
	"rx_esc"  - RX_ESC clock (used in escape mode)
- assigned-clocks:	phandles to clocks that requires initial configuration
- assigned-clock-rates:	rates of the clocks that requires initial configuration
	The following clocks needs to have an initial configuration:
	"tx_esc" and "rx_esc"
- port: 		input and output port nodes with endpoint definitions as
			defined in Documentation/devicetree/bindings/graph.txt;
			the input port should be connected to an encoder or a
			bridge that manages this MIPI-DSI host and the output
			port should be connected to a panel or a bridge input
			port
- phys: 		phandle to the phy module representing the DPHY
			inside MIPI-DSI IP block
- phy-names: 		should be "dphy"


Optional properties:
- power-domains 	phandle to the power domain
- interrupt-parent 	phandle to the interrupt parent, if there is one;
			usually, on i.MX8qm and i.MX8qxp there is an irq
			steer handling the MIPI DSI interrupts
- assigned-clock-parents phandles to parent clocks that needs to be assigned as
			parents to clocks defined in assigned-clocks

* The clock assignments must follow the rules defined in:
Documentation/devicetree/bindings/clock/clock-bindings.txt

Example:
	mipi_dsi_bridge1: mipi_dsi_bridge@56228000 {
		#address-cells = <1>;
		#size-cells = <0>;
		compatible = "nwl,mipi-dsi";
		reg = <0x0 0x56228000 0x0 0x300>;
		interrupts = <16 IRQ_TYPE_LEVEL_HIGH>;
		interrupt-parent = <&irqsteer_dsi0>;
		clocks =
			<&clk IMX8QM_CLK_DUMMY>,
			<&clk IMX8QM_MIPI0_DSI_TX_ESC_CLK>,
			<&clk IMX8QM_MIPI0_DSI_RX_ESC_CLK>;
		clock-names = "phy_ref", "tx_esc", "rx_esc";
		assigned-clocks = <&clk IMX8QM_MIPI0_DSI_TX_ESC_DIV>,
				  <&clk IMX8QM_MIPI0_DSI_RX_ESC_DIV>;
		assigned-clock-rates = <18000000>, <72000000>;
		power-domains = <&pd_mipi0>;
		phys = <&mipi_dsi_phy1>;
		phy-names = "dphy";

		port@0 {
			mipi_dsi_bridge1_in: endpoint {
				remote-endpoint = <&mipi_dsi1_out>;
			};
		};

		port@1 {
			mipi_dsi0_out: endpoint {
				remote-endpoint = <&adv7535_0_in>;
			};
		};
	};

Another example, for a platform with a complex clock tree, like 8QXP:
	mipi_dsi_bridge1: mipi_dsi_bridge@56228000 {
		#address-cells = <1>;
		#size-cells = <0>;
		compatible = "nwl,mipi-dsi";
		reg = <0x0 0x56228000 0x0 0x300>;
		interrupts = <16 IRQ_TYPE_LEVEL_HIGH>;
		interrupt-parent = <&irqsteer_mipi_lvds0>;
		clocks =
			<&clk IMX8QXP_CLK_DUMMY>,
			<&clk IMX8QXP_MIPI0_DSI_TX_ESC_CLK>,
			<&clk IMX8QXP_MIPI0_DSI_RX_ESC_CLK>;
		clock-names = "phy_ref", "tx_esc", "rx_esc";
		assigned-clocks =
			<&clk IMX8QXP_MIPI0_DSI_TX_ESC_SEL>,
			<&clk IMX8QXP_MIPI0_DSI_RX_ESC_SEL>,
			<&clk IMX8QXP_MIPI0_DSI_TX_ESC_CLK>,
			<&clk IMX8QXP_MIPI0_DSI_RX_ESC_CLK>;
		assigned-clock-rates = <0>, <0>, <18000000>, <72000000>;
		assigned-clock-parents =
			<&clk IMX8QXP_MIPI0_DSI_PLL_DIV2_CLK>,
			<&clk IMX8QXP_MIPI0_DSI_PLL_DIV2_CLK>;
		power-domains = <&pd_mipi_dsi0>;
		phys = <&mipi_dsi_phy1>;
		phy-names = "dphy";

		port@0 {
			mipi_dsi_bridge1_in: endpoint {
				remote-endpoint = <&mipi_dsi1_out>;
			};
		};

		port@1 {
			mipi_dsi0_out: endpoint {
				remote-endpoint = <&adv7535_0_in>;
			};
		};
	};

* Here, we set the clock parents for the *_SEL clocks (which are the sources of
the *_CLK clocks) and also the clock rate of the *_CLK clocks.
```

## Documentation/devicetree/bindings/display/bridge/nxp,imx95-mipi-dsi.yaml
```yaml
# SPDX-License-Identifier: (GPL-2.0-only OR BSD-2-Clause)
%YAML 1.2
---
$id: http://devicetree.org/schemas/display/bridge/nxp,imx95-mipi-dsi.yaml#
$schema: http://devicetree.org/meta-schemas/core.yaml#

title: NXP i.MX95 specific extensions to Synopsys Designware MIPI DSI

maintainers:
  - Liu Ying <victor.liu@nxp.com>

description: |
  There is a Synopsys Designware MIPI DSI Host Controller and a Synopsys
  Designware MIPI DPHY embedded in NXP i.MX95 SoC.  Some configurations
  and extensions to them are controlled by i.MX95 CSRs.

allOf:
  - $ref: snps,dw-mipi-dsi.yaml#

properties:
  compatible:
    const: nxp,imx95-mipi-dsi

  interrupts:
    maxItems: 1

  clocks:
    items:
      - description: cfg clock
      - description: pll bypass clock
      - description: PHY reference clock
      - description: apb clock
      - description: pixel clock

  clock-names:
    items:
      - const: cfg
      - const: bypass
      - const: ref
      - const: pclk
      - const: pix

  mux-controls:
    maxItems: 1
    description:
      mux controller node to use for operating the input mux

  power-domains:
    maxItems: 1

  nxp,disp-master-csr:
    $ref: /schemas/types.yaml#/definitions/phandle
    description:
      i.MX95 display master CSR, as a syscon, controls misc configurations
      for the MIPI DSI controller including some MIPI DPHY configurations
      and clock configurations.

  nxp,disp-stream-csr:
    $ref: /schemas/types.yaml#/definitions/phandle
    description:
      i.MX95 display stream CSR, as a syscon, controls misc configurations
      for the MIPI DSI controller including some MIPI DSI host configurations
      and MIPI DSI parity error configurations.

  nxp,mipi-combo-phy-csr:
    $ref: /schemas/types.yaml#/definitions/phandle
    description:
      i.MX95 display stream CSR, as a syscon, controls some MIPI DPHY
      configurations.

required:
  - compatible
  - interrupts
  - mux-controls
  - power-domains
  - nxp,disp-master-csr
  - nxp,disp-stream-csr
  - nxp,mipi-combo-phy-csr

unevaluatedProperties: false

examples:
  - |
    #include <dt-bindings/clock/fsl,imx95-clock.h>
    #include <dt-bindings/gpio/gpio.h>
    #include <dt-bindings/power/fsl,imx95-power.h>
    dsi@4acf0000 {
      compatible = "nxp,imx95-mipi-dsi";
      reg = <0x4acf0000 0x10000>;
      interrupt-parent = <&displaymix_irqsteer>;
      interrupts = <48>;
      clocks = <&scmi_clk IMX95_CLK_MIPIPHYCFG>,
               <&scmi_clk IMX95_CLK_MIPIPHYPLLBYPASS>,
               <&scmi_clk IMX95_CLK_MIPIPHYPLLREF>,
               <&scmi_clk IMX95_CLK_CAMAPB>,
               <&scmi_clk IMX95_CLK_DISP1PIX>;
      clock-names = "cfg", "bypass", "ref", "pclk", "pix";
      mux-controls = <&mux 0>;
      power-domains = <&scmi_devpd IMX95_PD_CAMERA>;
      nxp,disp-master-csr = <&display_master_csr>;
      nxp,disp-stream-csr = <&display_stream_csr>;
      nxp,mipi-combo-phy-csr = <&mipi_combo_phy_csr>;
      #address-cells = <1>;
      #size-cells = <0>;

      panel@0 {
        compatible = "raydium,rm67191";
        reg = <0>;
        reset-gpios = <&adp5585gpio 6 GPIO_ACTIVE_LOW>;
        dsi-lanes = <4>;
        video-mode = <2>;

        port {
          panel_in: endpoint {
            remote-endpoint = <&dsi_out>;
          };
        };
      };

      ports {
        #address-cells = <1>;
        #size-cells = <0>;

        port@0 {
          #address-cells = <1>;
          #size-cells = <0>;
          reg = <0>;

          mipi_dsi_to_display_pixel_link0: endpoint@0 {
            reg = <0>;
            remote-endpoint = <&display_pixel_link0_to_mipi_dsi>;
          };
        };

        port@1 {
          reg = <1>;

          dsi_out: endpoint {
            remote-endpoint = <&panel_in>;
          };
        };
      };
    };
```
