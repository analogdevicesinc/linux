## Documentation/devicetree/bindings/display/imx/nxp,imx95-dpu.yaml
```yaml
# SPDX-License-Identifier: (GPL-2.0-only OR BSD-2-Clause)
%YAML 1.2
---
$id: http://devicetree.org/schemas/display/imx/nxp,imx95-dpu.yaml#
$schema: http://devicetree.org/meta-schemas/core.yaml#

title: NXP i.MX95 Display Processing Unit

maintainers:
  - Liu Ying <victor.liu@nxp.com>

description: |
  The NXP i.MX95 Display Processing Unit(DPU), a.k.a SEERIS, is comprised of
  two main components that include a blit engine for 2D graphics accelerations
  and a display controller for display output processing, as well as a command
  sequencer.

properties:
  compatible:
    const: nxp,imx95-dpu

  reg:
    maxItems: 1

  interrupts:
    items:
      - description: |
          store9 shadow load interrupt(blit engine)
      - description: |
          store9 frame complete interrupt(blit engine)
      - description: |
          store9 sequence complete interrupt(blit engine)
      - description: |
          extdst0 shadow load interrupt
          (display controller, content stream 0)
      - description: |
          extdst0 frame complete interrupt
          (display controller, content stream 0)
      - description: |
          extdst0 sequence complete interrupt
          (display controller, content stream 0)
      - description: |
          extdst4 shadow load interrupt
          (display controller, safety stream 0)
      - description: |
          extdst4 frame complete interrupt
          (display controller, safety stream 0)
      - description: |
          extdst4 sequence complete interrupt
          (display controller, safety stream 0)
      - description: |
          extdst1 shadow load interrupt
          (display controller, content stream 1)
      - description: |
          extdst1 frame complete interrupt
          (display controller, content stream 1)
      - description: |
          extdst1 sequence complete interrupt
          (display controller, content stream 1)
      - description: |
          extdst5 shadow load interrupt
          (display controller, safety stream 1)
      - description: |
          extdst5 frame complete interrupt
          (display controller, safety stream 1)
      - description: |
          extdst5 sequence complete interrupt
          (display controller, safety stream 1)
      - description: |
          domainblend0 shadow load interrupt
          (display controller, display stream 0)
      - description: |
          domainblend0 frame complete interrupt
          (display controller, display stream 0)
      - description: |
          domainblend0 sequence complete interrupt
          (display controller, display stream 0)
      - description: |
          disengcfg0 shadow load interrupt
          (display controller, display stream 0)
      - description: |
          disengcfg0 frame complete interrupt
          (display controller, display stream 0)
      - description: |
          disengcfg0 sequence complete interrupt
          (display controller, display stream 0)
      - description: |
          framegen0 programmable interrupt0
          (display controller, display stream 0)
      - description: |
          framegen0 programmable interrupt1
          (display controller, display stream 0)
      - description: |
          framegen0 programmable interrupt2
          (display controller, display stream 0)
      - description: |
          framegen0 programmable interrupt3
          (display controller, display stream 0)
      - description: |
          signature0 shadow load interrupt
          (display controller, display stream 0)
      - description: |
          signature0 measurement valid interrupt
          (display controller, display stream 0)
      - description: |
          signature0 window error condition interrupt
          (display controller, display stream 0)
      - description: |
          signature0 cluster error condition interrupt
          (display controller, display stream 0)
      - description: |
          signature0 cluster match condition interrupt
          (display controller, display stream 0)
      - description: |
          signature2 shadow load interrupt
          (display controller, display stream 0)
      - description: |
          signature2 measurement valid interrupt
          (display controller, display stream 0)
      - description: |
          signature2 window error condition interrupt
          (display controller, display stream 0)
      - description: |
          signature2 cluster error condition interrupt
          (display controller, display stream 0)
      - description: |
          signature2 cluster match condition interrupt
          (display controller, display stream 0)
      - description: |
          idhash0 shadow load interrupt
          (display controller, display stream 0)
      - description: |
          idhash0 valid interrupt
          (display controller, display stream 0)
      - description: |
          idhash0 window error condition interrupt
          (display controller, display stream 0)
      - description: |
          domainblend1 shadow load interrupt
          (display controller, display stream 1)
      - description: |
          domainblend1 frame complete interrupt
          (display controller, display stream 1)
      - description: |
          domainblend1 sequence complete interrupt
          (display controller, display stream 1)
      - description: |
          disengcfg1 shadow load interrupt
          (display controller, display stream 1)
      - description: |
          disengcfg1 frame complete interrupt
          (display controller, display stream 1)
      - description: |
          disengcfg1 sequence complete interrupt
          (display controller, display stream 1)
      - description: |
          framegen1 programmable interrupt0
          (display controller, display stream 1)
      - description: |
          framegen1 programmable interrupt1
          (display controller, display stream 1)
      - description: |
          framegen1 programmable interrupt2
          (display controller, display stream 1)
      - description: |
          framegen1 programmable interrupt3
          (display controller, display stream 1)
      - description: |
          signature1 shadow load interrupt
          (display controller, display stream 1)
      - description: |
          signature1 measurement valid interrupt
          (display controller, display stream 1)
      - description: |
          signature1 window error condition interrupt
          (display controller, display stream 1)
      - description: |
          signature1 cluster error condition interrupt
          (display controller, display stream 1)
      - description: |
          signature1 cluster match condition interrupt
          (display controller, display stream 1)
      - description: |
          command sequencer error condition interrupt(command sequencer)
      - description: |
          common control software interrupt0(common control)
      - description: |
          common control software interrupt1(common control)
      - description: |
          common control software interrupt2(common control)
      - description: |
          common control software interrupt3(common control)
      - description: |
          framegen0 primsync_on interrupt
          (display controller, display stream0)
      - description: |
          framegen0 primsync_off interrupt
          (display controller, display stream0)
      - description: |
          framegen0 overflow0_on interrupt
          (display controller, display stream0)
      - description: |
          framegen0 overflow0_off interrupt
          (display controller, display stream0)
      - description: |
          framegen0 underrun0_on interrupt
          (display controller, display stream0)
      - description: |
          framegen0 underrun0_off interrupt
          (display controller, display stream0)
      - description: |
          framegen0 threshold0_rise interrupt
          (display controller, display stream0)
      - description: |
          framegen0 threshold0_Fall interrupt
          (display controller, display stream0)
      - description: |
          framegen0 overflow1_on interrupt
          (display controller, display stream0)
      - description: |
          framegen0 overflow1_off interrupt
          (display controller, display stream0)
      - description: |
          framegen0 underrun1_on interrupt
          (display controller, display stream0)
      - description: |
          framegen0 underrun1_off interrupt
          (display controller, display stream0)
      - description: |
          framegen0 threshold1_rise interrupt
          (display controller, display stream0)
      - description: |
          framegen0 threshold1_Fall interrupt
          (display controller, display stream0)
      - description: |
          framegen1 primsync_on interrupt
          (display controller, display stream1)
      - description: |
          framegen1 primsync_off interrupt
          (display controller, display stream1)
      - description: |
          framegen1 overflow0_on interrupt
          (display controller, display stream1)
      - description: |
          framegen1 overflow0_off interrupt
          (display controller, display stream1)
      - description: |
          framegen1 underrun0_on interrupt
          (display controller, display stream1)
      - description: |
          framegen1 underrun0_off interrupt
          (display controller, display stream1)
      - description: |
          framegen1 threshold0_rise interrupt
          (display controller, display stream1)
      - description: |
          framegen1 threshold0_Fall interrupt
          (display controller, display stream1)
      - description: |
          framegen1 overflow1_on interrupt
          (display controller, display stream1)
      - description: |
          framegen1 overflow1_off interrupt
          (display controller, display stream1)
      - description: |
          framegen1 underrun1_on interrupt
          (display controller, display stream1)
      - description: |
          framegen1 underrun1_off interrupt
          (display controller, display stream1)
      - description: |
          framegen1 threshold1_rise interrupt
          (display controller, display stream1)
      - description: |
          framegen1 threshold1_Fall interrupt
          (display controller, display stream1)

  interrupt-names:
    items:
      - const: store9_shdload
      - const: store9_framecomplete
      - const: store9_seqcomplete
      - const: extdst0_shdload
      - const: extdst0_framecomplete
      - const: extdst0_seqcomplete
      - const: extdst4_shdload
      - const: extdst4_framecomplete
      - const: extdst4_seqcomplete
      - const: extdst1_shdload
      - const: extdst1_framecomplete
      - const: extdst1_seqcomplete
      - const: extdst5_shdload
      - const: extdst5_framecomplete
      - const: extdst5_seqcomplete
      - const: domainblend0_shdload
      - const: domainblend0_framecomplete
      - const: domainblend0_seqcomplete
      - const: disengcfg_shdload0
      - const: disengcfg_framecomplete0
      - const: disengcfg_seqcomplete0
      - const: framegen0_int0
      - const: framegen0_int1
      - const: framegen0_int2
      - const: framegen0_int3
      - const: sig0_shdload
      - const: sig0_valid
      - const: sig0_error
      - const: sig0_cluster_error
      - const: sig0_cluster_match
      - const: sig2_shdload
      - const: sig2_valid
      - const: sig2_error
      - const: sig2_cluster_error
      - const: sig2_cluster_match
      - const: idhash0_shdload
      - const: idhash0_valid
      - const: idhash0_window_error
      - const: domainblend1_shdload
      - const: domainblend1_framecomplete
      - const: domainblend1_seqcomplete
      - const: disengcfg_shdload1
      - const: disengcfg_framecomplete1
      - const: disengcfg_seqcomplete1
      - const: framegen1_int0
      - const: framegen1_int1
      - const: framegen1_int2
      - const: framegen1_int3
      - const: sig1_shdload
      - const: sig1_valid
      - const: sig1_error
      - const: sig1_cluster_error
      - const: sig1_cluster_match
      - const: cmdseq_error
      - const: comctrl_sw0
      - const: comctrl_sw1
      - const: comctrl_sw2
      - const: comctrl_sw3
      - const: framegen0_primsync_on
      - const: framegen0_primsync_off
      - const: framegen0_overflow0_on
      - const: framegen0_overflow0_off
      - const: framegen0_underrun0_on
      - const: framegen0_underrun0_off
      - const: framegen0_threshold0_rise
      - const: framegen0_threshold0_fail
      - const: framegen0_overflow1_on
      - const: framegen0_overflow1_off
      - const: framegen0_underrun1_on
      - const: framegen0_underrun1_off
      - const: framegen0_threshold1_rise
      - const: framegen0_threshold1_fail
      - const: framegen1_primsync_on
      - const: framegen1_primsync_off
      - const: framegen1_overflow0_on
      - const: framegen1_overflow0_off
      - const: framegen1_underrun0_on
      - const: framegen1_underrun0_off
      - const: framegen1_threshold0_rise
      - const: framegen1_threshold0_fail
      - const: framegen1_overflow1_on
      - const: framegen1_overflow1_off
      - const: framegen1_underrun1_on
      - const: framegen1_underrun1_off
      - const: framegen1_threshold1_rise
      - const: framegen1_threshold1_fail

  clocks:
    maxItems: 6

  clock-names:
    items:
      - const: pix
      - const: apb
      - const: axi
      - const: ocram
      - const: ldb
      - const: ldb_vco

  power-domains:
    maxItems: 1

  nxp,blk-ctrl:
    $ref: /schemas/types.yaml#/definitions/phandle
    description: |
      A phandle which points to NXP displaymix blk-ctrl.

  ports:
    $ref: /schemas/graph.yaml#/properties/ports

    properties:
      port@0:
        $ref: /schemas/graph.yaml#/properties/port
        description: The DPU output port node from display stream0.

      port@1:
        $ref: /schemas/graph.yaml#/properties/port
        description: The DPU output port node from display stream1.

    required:
      - port@0
      - port@1

required:
  - compatible
  - reg
  - interrupts
  - interrupt-names
  - clocks
  - clock-names
  - power-domains
  - nxp,blk-ctrl
  - ports

additionalProperties: false

examples:
  - |
    #include <dt-bindings/clock/fsl,imx95-clock.h>
    #include <dt-bindings/power/fsl,imx95-power.h>
    display-controller@4b400000 {
      compatible = "nxp,imx95-dpu";
      reg = <0x4b400000 0x400000>;
      interrupt-parent = <&displaymix_irqsteer>;
      interrupts = <448>, <449>, <450>,  <64>,
                   <65>,  <66>,  <67>,  <68>,
                   <69>, <192>, <193>, <194>,
                  <195>, <196>, <197>,  <70>,
                   <71>,  <72>,  <73>,  <74>,
                   <75>,  <76>,  <77>,  <78>,
                   <79>,  <80>,  <81>,  <82>,
                   <83>,  <84>,  <85>,  <86>,
                   <87>,  <88>,  <89>,  <90>,
                   <91>,  <92>, <198>, <199>,
                  <200>, <201>, <202>, <203>,
                  <204>, <205>, <206>, <207>,
                  <208>, <209>, <210>, <211>,
                  <212>, <451>,   <1>,   <2>,
                    <3>,   <4>,  <93>,  <94>,
                   <95>,  <96>,  <97>,  <98>,
                   <99>, <100>, <101>, <102>,
                  <103>, <104>, <105>, <106>,
                  <213>, <214>, <215>, <216>,
                  <217>, <218>, <219>, <220>,
                  <221>, <222>, <223>, <224>,
                  <225>, <226>;
      interrupt-names = "store9_shdload",
                        "store9_framecomplete",
                        "store9_seqcomplete",
                        "extdst0_shdload",
                        "extdst0_framecomplete",
                        "extdst0_seqcomplete",
                        "extdst4_shdload",
                        "extdst4_framecomplete",
                        "extdst4_seqcomplete",
                        "extdst1_shdload",
                        "extdst1_framecomplete",
                        "extdst1_seqcomplete",
                        "extdst5_shdload",
                        "extdst5_framecomplete",
                        "extdst5_seqcomplete",
                        "domainblend0_shdload",
                        "domainblend0_framecomplete",
                        "domainblend0_seqcomplete",
                        "disengcfg_shdload0",
                        "disengcfg_framecomplete0",
                        "disengcfg_seqcomplete0",
                        "framegen0_int0",
                        "framegen0_int1",
                        "framegen0_int2",
                        "framegen0_int3",
                        "sig0_shdload",
                        "sig0_valid",
                        "sig0_error",
                        "sig0_cluster_error",
                        "sig0_cluster_match",
                        "sig2_shdload",
                        "sig2_valid",
                        "sig2_error",
                        "sig2_cluster_error",
                        "sig2_cluster_match",
                        "idhash0_shdload",
                        "idhash0_valid",
                        "idhash0_window_error",
                        "domainblend1_shdload",
                        "domainblend1_framecomplete",
                        "domainblend1_seqcomplete",
                        "disengcfg_shdload1",
                        "disengcfg_framecomplete1",
                        "disengcfg_seqcomplete1",
                        "framegen1_int0",
                        "framegen1_int1",
                        "framegen1_int2",
                        "framegen1_int3",
                        "sig1_shdload",
                        "sig1_valid",
                        "sig1_error",
                        "sig1_cluster_error",
                        "sig1_cluster_match",
                        "cmdseq_error",
                        "comctrl_sw0",
                        "comctrl_sw1",
                        "comctrl_sw2",
                        "comctrl_sw3",
                        "framegen0_primsync_on",
                        "framegen0_primsync_off",
                        "framegen0_overflow0_on",
                        "framegen0_overflow0_off",
                        "framegen0_underrun0_on",
                        "framegen0_underrun0_off",
                        "framegen0_threshold0_rise",
                        "framegen0_threshold0_fail",
                        "framegen0_overflow1_on",
                        "framegen0_overflow1_off",
                        "framegen0_underrun1_on",
                        "framegen0_underrun1_off",
                        "framegen0_threshold1_rise",
                        "framegen0_threshold1_fail",
                        "framegen1_primsync_on",
                        "framegen1_primsync_off",
                        "framegen1_overflow0_on",
                        "framegen1_overflow0_off",
                        "framegen1_underrun0_on",
                        "framegen1_underrun0_off",
                        "framegen1_threshold0_rise",
                        "framegen1_threshold0_fail",
                        "framegen1_overflow1_on",
                        "framegen1_overflow1_off",
                        "framegen1_underrun1_on",
                        "framegen1_underrun1_off",
                        "framegen1_threshold1_rise",
                        "framegen1_threshold1_fail";
      clocks = <&scmi_clk IMX95_CLK_DISP1PIX>,
               <&scmi_clk IMX95_CLK_DISPAPB>,
               <&scmi_clk IMX95_CLK_DISPAXI>,
               <&scmi_clk IMX95_CLK_DISPOCRAM>,
               <&ldb_pll_pixel>,
               <&scmi_clk IMX95_CLK_LDBPLL_VCO>;
      clock-names = "pix", "apb", "axi", "ocram", "ldb", "ldb_vco";
      power-domains = <&scmi_devpd IMX95_PD_DISPLAY>;
      nxp,blk-ctrl = <&dispmix_csr>;

      ports {
        #address-cells = <1>;
        #size-cells = <0>;

        port@0 {
          reg = <0>;
        };

        port@1 {
          reg = <1>;
        };
      };
    };
```
