## Documentation/devicetree/bindings/display/bridge/nxp,imx95-pixel-interleaver.yaml
```yaml
# SPDX-License-Identifier: (GPL-2.0-only OR BSD-2-Clause)
%YAML 1.2
---
$id: http://devicetree.org/schemas/display/bridge/nxp,imx95-pixel-interleaver.yaml#
$schema: http://devicetree.org/meta-schemas/core.yaml#

title: NXP i.MX95 Pixel Interleaver Bridge

maintainers:
  - Liu Ying <victor.liu@nxp.com>

description: |
  Pixel Interleaver receives and processes 2 input display streams from the
  display controller. The processed streams are routed to 3 pixel link output
  ports. The module's main functions include YUV444 to YUV422 conversion and
  interleaving operation. Pixel Interleaver supports 2 modes of operations.
  It is also an interface between the display controller and those IPs that
  support pixel link input.

properties:
  compatible:
    const: nxp,imx95-pixel-interleaver

  "#address-cells":
    const: 1

  "#size-cells":
    const: 0

  reg:
    maxItems: 1

  interrupts:
    maxItems: 1

  clocks:
    maxItems: 1

  power-domains:
    maxItems: 1

  nxp,blk-ctrl:
    $ref: /schemas/types.yaml#/definitions/phandle
    description: |
      A phandle which points to NXP displaymix blk-ctrl.

patternProperties:
  "^channel@[0-1]$":
    type: object
    description: Represents a channel of pixel interleaver.

    properties:
      "#address-cells":
        const: 1

      "#size-cells":
        const: 0

      reg:
        description: The channel index.
        enum: [ 0, 1 ]

      port@0:
        $ref: /schemas/graph.yaml#/properties/port
        description: Input port of the channel.

      port@1:
        $ref: /schemas/graph.yaml#/properties/port
        description: Output port of the channel.

    required:
      - "#address-cells"
      - "#size-cells"
      - reg

    additionalProperties: false

required:
  - compatible
  - "#address-cells"
  - "#size-cells"
  - reg
  - interrupts
  - clocks
  - power-domains
  - nxp,blk-ctrl
  - channel@0
  - channel@1

additionalProperties: false

examples:
  - |
    #include <dt-bindings/clock/fsl,imx95-clock.h>
    #include <dt-bindings/power/fsl,imx95-power.h>
    bridge@4b0d0000 {
      compatible = "nxp,imx95-pixel-interleaver";
      #address-cells = <1>;
      #size-cells = <0>;
      reg = <0x4b0d0000 0x20000>;
      interrupt-parent = <&displaymix_irqsteer>;
      interrupts = <62>;
      clocks = <&scmi_clk IMX95_CLK_DISPAPB>;
      power-domains = <&scmi_devpd IMX95_PD_DISPLAY>;
      nxp,blk-ctrl = <&dispmix_csr>;

      channel@0 {
        #address-cells = <1>;
        #size-cells = <0>;
        reg = <0>;

        port@0 {
          reg = <0>;

          pixel_interleaver_disp0_to_dpu_disp0: endpoint {
            remote-endpoint = <&dpu_disp0_to_pixel_interleaver_disp0>;
          };
        };
      };

      channel@1 {
        #address-cells = <1>;
        #size-cells = <0>;
        reg = <1>;

        port@0 {
          reg = <0>;

          pixel_interleaver_disp1_to_dpu_disp1: endpoint {
            remote-endpoint = <&dpu_disp1_to_pixel_interleaver_disp1>;
          };
        };
      };
    };
```

## Documentation/devicetree/bindings/display/bridge/nxp,imx95-pixel-link.yaml
```yaml
# SPDX-License-Identifier: (GPL-2.0-only OR BSD-2-Clause)
%YAML 1.2
---
$id: http://devicetree.org/schemas/display/bridge/nxp,imx95-pixel-link.yaml#
$schema: http://devicetree.org/meta-schemas/core.yaml#

title: NXP i.MX95 Display Pixel Link

maintainers:
  - Liu Ying <victor.liu@nxp.com>

description: |
  Pixel link is designed to transport 1 pixel per clock.

properties:
  compatible:
    const: nxp,imx95-dc-pixel-link

  reg:
    maxItems: 1

  ports:
    $ref: /schemas/graph.yaml#/properties/ports

    properties:
      port@0:
        $ref: /schemas/graph.yaml#/properties/port
        description: |
          The pixel link input port node from display controller display
          stream0.

      port@1:
        $ref: /schemas/graph.yaml#/properties/port
        description: |
          The pixel link input port node from display controller display
          stream1.

      port@2:
        $ref: /schemas/graph.yaml#/properties/port
        description: |
          The pixel link output port node from port@0.

      port@3:
        $ref: /schemas/graph.yaml#/properties/port
        description: |
          The pixel link output port node from port@1.

    required:
      - port@0
      - port@1
      - port@2
      - port@3

required:
  - compatible
  - reg
  - ports

additionalProperties: false

examples:
  - |
    bridge@8 {
      compatible = "nxp,imx95-dc-pixel-link";
      reg = <0x8 0x4>;

      ports {
        #address-cells = <1>;
        #size-cells = <0>;

        port@0 {
          reg = <0>;

          display_pixel_link0_to_pixel_interleaver_disp0: endpoint {
            remote-endpoint = <&pixel_interleaver_disp0_to_display_pixel_link0>;
          };
        };

        port@1 {
          reg = <1>;

          display_pixel_link1_to_pixel_interleaver_disp1: endpoint {
            remote-endpoint = <&pixel_interleaver_disp1_to_display_pixel_link1>;
          };
        };

        port@2 {
          reg = <2>;
        };

        port@3 {
          reg = <3>;
        };
      };
    };
```

## Documentation/devicetree/bindings/display/bridge/nxp,seiko-43wvfig.txt
```
Legacy Freescale RA169Z20 adapter card for Seiko 43WVFIG panel, driver bindings

This is an adapter card made for the 4.3", 800x480, LCD panel Seiko 43WVFIG.
The LCD panel is a 24bit DPI bus, while the adapter card has two ports:
18-bit and 24-bit data input. For the 18-bit data input, the adapter card
is demuxing some of the data lines, in order to feed all of the 24 lines
needed by the LCD.

Required properties:
- compatible: 	"nxp,seiko-43wvfig"
- bus_mode:	must be one of <18> or <24>, depending on the input port
		used (18-bit or 24-bit)
- port:		input and output port nodes with endpoint definitions as
		defined in Documentation/devicetree/bindings/graph.txt;
		the input port should be connected to an lcd controller
		while the output port should be connected to the Seiko
		43wvfig LCD panel

Example:
	seiko_adapter: seiko-adapter {
		#address-cells = <1>;
		#size-cells = <0>;
		compatible = "nxp,seiko-43wvfig";
		bus_mode = <18>;

		port@0 {
			reg = <0>;
			adapter_in: endpoint {
				remote-endpoint = <&lcdif_out>;
			};
		};
		port@1 {
			reg = <1>;
			adapter_out: endpoint {
				remote-endpoint = <&panel_in>;
			};
		};
	};

-
```

## Documentation/devicetree/bindings/display/bridge/sec_dsim.txt
```
Samsung MIPI DSIM bridge bindings

The MIPI DSIM host controller drives the video signals from
display controller to video peripherals using DSI protocol.
This is an un-managed DSI bridge. In order to use this bridge,
an encoder or bridge must be implemented to manage the platform
specific initializations.

Required properties:
- compatible: 		"fsl,imx8mm-mipi-dsim"
- reg: 			the register range of the MIPI DSIM controller
- interrupts: 		the interrupt number for this module
- clock, clock-names: 	phandles to the MIPI-DSI clocks described in
  Documentation/devicetree/bindings/clock/clock-bindings.txt
	"cfg"		- DSIM access clock
	"pll-ref"	- DSIM PHY PLL reference clock
	"pixel"		- DSIM input pixel clock, required only by i.MX8MP.
- assigned-clocks:	phandles to clocks that requires initial configuration
- assigned-clock-rates:	rates of the clocks that requires initial configuration
- pref-clk:		Assign DPHY PLL reference clock frequency. If not exists,
			DSIM bridge driver will use the default lock frequency
			which is 27MHz.
- port: 		input and output port nodes with endpoint definitions as
			defined in Documentation/devicetree/bindings/graph.txt;
			the input port should be connected to an encoder or a
			bridge that manages this MIPI DSIM host and the output
			port should be connected to a panel or a bridge input
			port

Optional properties:
-dsi-gpr:		a phandle which provides the MIPI DSIM control and gpr registers

example:
	mipi_dsi: mipi_dsi@32E10000 {
		compatible = "fsl,imx8mm-mipi-dsim";
		reg = <0x0 0x32e10000 0x0 0x400>;
		clocks = <&clk IMX8MM_CLK_DSI_CORE_DIV>,
			 <&clk IMX8MM_CLK_DSI_PHY_REF_DIV>;
		clock-names = "cfg", "pll-ref";
		assigned-clocks = <&clk IMX8MM_CLK_DSI_CORE_SRC>,
				  <&clk IMX8MM_CLK_DSI_PHY_REF_SRC>;
		assigned-clock-parents = <&clk IMX8MM_SYS_PLL1_266M>,
					 <&clk IMX8MM_VIDEO_PLL1_OUT>;
		assigned-clock-rates = <266000000>, <594000000>;
		interrupts = <GIC_SPI 18 IRQ_TYPE_LEVEL_HIGH>;
		dsi-gpr = <&dispmix_gpr>;
		status = "disabled";

		port@0 {
			dsim_from_lcdif: endpoint {
				remote-endpoint = <&lcdif_to_dsim>;
			};
		};

		port@1 {
			dsim_to_adv7535: endpoint {
				remote-endpoint = <&adv7535_from_dsim>;
			};
		};

	};
```

## Documentation/devicetree/bindings/display/imx/dsi_nwl.txt
```
NXP specific extensions to the Northwest Logic MIPI-DSI
================================

Platform specific extentions for the NWL MIPI-DSI host controller found in
MX8 platforms. This is an encoder/bridge that manages the platform specific
initializations required for the NWL MIPI-DSI host.

Required properties:
- compatible: 		"fsl,<chip>-mipi-dsi"
	The following strings are expected:
			"fsl,imx8qm-mipi-dsi"
			"fsl,imx8qxp-mipi-dsi"
- reg: 			the register range of the MIPI-DSI controller
- interrupts: 		the interrupt number for this module
- clock, clock-names: 	phandles to the MIPI-DSI clocks
	The following clocks are expected on all platforms:
		"phy_ref" - PHY_REF clock
		"tx_esc"  - TX_ESC clock (used in escape mode)
		"rx_esc"  - RX_ESC clock (used in escape mode)
	The following clocks are expected on i.MX8qm and i.MX8qxp:
		"bypass"  - bypass clock
		"pixel"   - pixel clock (for the pixel link)
- assigned-clocks:	phandles to clocks that requires initial configuration
- assigned-clock-rates:	rates of the clocks that requires initial configuration
	The following clocks needs to have an initial configuration:
	"tx_esc" and "rx_esc"
- port: 		input and output port nodes with endpoint definitions as
			defined in Documentation/devicetree/bindings/graph.txt;
			the input port should be connected to a display
			interface and the output port should be connected to a
			NWL MIPI-DSI host
- phys: 		phandle to the phy module representing the DPHY
			inside MIPI-DSI IP block
- phy-names: 		should be "dphy"

Optional properties:
- power-domains 	phandle to the power domain
- interrupt-parent 	phandle to the interrupt parent, if there is one;
			usually, on i.MX8qm and i.MX8qxp there is an irq
			steer handling the MIPI DSI interrupts
- csr 			phandle to the CSR register set (required on i.MX8qm
			and i.MX8qxp for the reset functions)
- assigned-clock-parents phandles to parent clocks that needs to be assigned as
			parents to clocks defined in assigned-clocks
- sync-pol		horizontal and vertical sync polarity of the input
			signal; can be <0> for LOW (negative) or <1> for HIGH
			(positive) polarity; default value is <0>, when this
			property is ommited

Example:
	mipi_dsi1: mipi_dsi {
		compatible = "fsl,imx8qxp-mipi-dsi";
		clocks =
			<&clk IMX8QXP_MIPI0_PIXEL_CLK>,
			<&clk IMX8QXP_MIPI0_BYPASS_CLK>,
			<&clk IMX8QXP_CLK_DUMMY>;
		clock-names = "pixel", "bypass", "phy_ref";
		power-domains = <&pd_mipi_dsi0>;
		csr = <&mipi_dsi_csr1>;
		phys = <&mipi_dsi_phy1>;
		phy-names = "dphy";
		status = "disabled";

		port@0 {
			mipi_dsi1_in: endpoint {
				remote-endpoint = <&dpu_disp0_mipi_dsi>;
			};
		};

		port@1 {
			mipi_dsi1_out: endpoint {
				remote-endpoint = <&mipi_dsi_bridge1_in>;
			};
		};
	};
```

## Documentation/devicetree/bindings/display/imx/fsl,imx93-mipi-dsi.yaml
```yaml
# SPDX-License-Identifier: (GPL-2.0-only OR BSD-2-Clause)
%YAML 1.2
---
$id: http://devicetree.org/schemas/display/imx/fsl,imx93-mipi-dsi.yaml#
$schema: http://devicetree.org/meta-schemas/core.yaml#

title: Freescale i.MX93 Synopsys DesignWare MIPI DSI host controller

maintainers:
  - Liu Ying <victor.liu@nxp.com>

description:
  Synopsys DesignWare MIPI DSI host controller found in Freescale i.MX93 SoC.

allOf:
  - $ref: ../dsi-controller.yaml#

properties:
  compatible:
    const: fsl,imx93-mipi-dsi

  reg:
    maxItems: 1

  interrupts:
    maxItems: 1

  '#address-cells':
    const: 1

  '#size-cells':
    const: 0

  clocks:
    items:
      - description: byte clock
      - description: apb clock
      - description: pixel clock

  clock-names:
    items:
      - const: byte
      - const: pclk
      - const: pixel

  assigned-clocks: true
  assigned-clock-parents: true
  assigned-clock-rates: true

  phys:
    maxItems: 1
    description:
      Phandle to the phy module representing a MIPI DPHY.

  phy-names:
    items:
      - const: dphy

  power-domains:
    maxItems: 1

  ports:
    $ref: /schemas/graph.yaml#/properties/ports

    properties:
      port@0:
        $ref: /schemas/graph.yaml#/properties/port
        description:
          Input port node to receive pixel data from display controller.

      port@1:
        $ref: /schemas/graph.yaml#/properties/port
        description:
          Output port node to a panel or a bridge input port.

required:
  - compatible
  - reg
  - interrupts
  - clocks
  - clock-names
  - phys
  - phy-names
  - power-domains
  - ports

unevaluatedProperties: false

examples:
  - |
    #include <dt-bindings/clock/imx93-clock.h>
    #include <dt-bindings/interrupt-controller/arm-gic.h>
    #include <dt-bindings/power/imx93-power.h>
    dsi: dsi@4ae10000 {
        compatible = "fsl,imx93-mipi-dsi";
        reg = <0x4ae10000 0x4000>;
        interrupts = <GIC_SPI 177 IRQ_TYPE_LEVEL_HIGH>;
        clocks = <&clk IMX93_CLK_MIPI_TEST_BYTE>,
                 <&clk IMX93_CLK_MIPI_DSI_GATE>,
                 <&clk IMX93_CLK_MEDIA_DISP_PIX>;
        clock-names = "byte", "pclk", "pixel";
        assigned-clocks = <&clk IMX93_CLK_MIPI_TEST_BYTE>,
                          <&clk IMX93_CLK_MEDIA_APB>;
        assigned-clock-parents = <&clk IMX93_CLK_SYS_PLL_PFD0>,
                                 <&clk IMX93_CLK_SYS_PLL_PFD1_DIV2>;
        assigned-clock-rates = <20000000>, <133333333>;
        phys = <&dphy>;
        phy-names = "dphy";
        power-domains = <&media_blk_ctrl IMX93_MEDIABLK_PD_MIPI_DSI>;

        #address-cells = <1>;
        #size-cells = <0>;

        panel@0 {
            compatible = "raydium,rm67191";
            reg = <0>;
            dsi-lanes = <4>;
            video-mode = <2>;
            width-mm = <68>;
            height-mm = <121>;

            port {
                panel_in: endpoint {
                    remote-endpoint = <&dsi_out>;
                };
            };
        };

        ports {
            #address-cells = <1>;
            #size-cells = <0>;

            port@0 {
                reg = <0>;

                dsi_to_lcdif: endpoint {
                    remote-endpoint = <&lcdif_to_dsi>;
                };
            };

            port@1 {
                reg = <1>;

                dsi_out: endpoint {
                    remote-endpoint = <&panel_in>;
                };
            };
        };
    };

...
```
