## Documentation/devicetree/bindings/firmware/fsl,imx-se-fw.yaml
```yaml
# SPDX-License-Identifier: (GPL-2.0-only OR BSD-2-Clause)
%YAML 1.2
---
$id: http://devicetree.org/schemas/firmware/fsl,imx-se-fw.yaml#
$schema: http://devicetree.org/meta-schemas/core.yaml#

title: NXP i.MX EdgeLock Enclave Firmware (ELEFW)

maintainers:
  - Pankaj Gupta <pankaj.gupta@nxp.com>

description:
  The NXP's i.MX EdgeLock Enclave, a HW IP creating an embedded
  secure enclave within the SoC boundary to enable features like
  - HSM
  - SHE
  - V2X

  It uses message unit to communicate and coordinate to pass messages
  (e.g., data,  status and control) through its interfaces.

properties:
  compatible:
    enum:
      - fsl,imx8ulp-se-fw
      - fsl,imx93-se-fw
      - fsl,imx8dxl-se-fw

  mboxes:
    description:
      All MU channels must be within the same MU instance. Cross instances are
      not allowed. Users need to ensure that used MU instance does not conflict
      with other execution environments.
    items:
      - description: TX0 MU channel
      - description: RX0 MU channel

  mbox-names:
    items:
      - const: tx
      - const: rx

  fsl,mu-id:
    $ref: /schemas/types.yaml#/definitions/uint32
    description:
      Identifier to the message-unit among the multiple message-unit that exists on SoC.
      Per message-unit, multiple misc-devices are created, that are  used by userspace
      application as logical-waiter and logical-receiver.

  memory-region:
    items:
      - description: Reserved memory region that can be accessed by firmware. Used for
          exchanging the buffers between driver and firmware.

  sram:
    description: Phandle to the device SRAM
    $ref: /schemas/types.yaml#/definitions/phandle-array

required:
  - compatible
  - mboxes
  - mbox-names
  - fsl,mu-id

additionalProperties: false

examples:
  - |
    ele_fw: se-fw {
      compatible = "fsl,imx8ulp-se-fw";
      mbox-names = "tx", "rx";
      mboxes = <&s4muap 0 0>, <&s4muap 1 0>;
      fsl,mu-id = <2>;
    };
```

## Documentation/devicetree/bindings/firmware/fsl,imx-se.yaml
```yaml
# SPDX-License-Identifier: (GPL-2.0-only OR BSD-2-Clause)
%YAML 1.2
---
$id: http://devicetree.org/schemas/firmware/fsl,imx-se.yaml#
$schema: http://devicetree.org/meta-schemas/core.yaml#

title: NXP i.MX HW Secure Enclave(s) EdgeLock Enclave

maintainers:
  - Pankaj Gupta <pankaj.gupta@nxp.com>

description: |
  NXP's SoC may contain one or multiple embedded secure-enclave HW
  IP(s) like i.MX EdgeLock Enclave, V2X etc. These NXP's HW IP(s)
  enables features like
    - Hardware Security Module (HSM),
    - Security Hardware Extension (SHE), and
    - Vehicular to Anything (V2X)

  Communication interface to the secure-enclaves(se) is based on the
  messaging unit(s).

properties:
  compatible:
    enum:
      - fsl,imx8ulp-se-ele-hsm
      - fsl,imx93-se-ele-hsm
      - fsl,imx95-se-ele-hsm

  mboxes:
    items:
      - description: mailbox phandle to send message to se firmware
      - description: mailbox phandle to receive message from se firmware

  mbox-names:
    items:
      - const: tx
      - const: rx

  memory-region:
    maxItems: 1

  sram:
    maxItems: 1

required:
  - compatible
  - mboxes
  - mbox-names

allOf:
  # memory-region
  - if:
      properties:
        compatible:
          contains:
            enum:
              - fsl,imx8ulp-se-ele-hsm
              - fsl,imx93-se-ele-hsm
    then:
      required:
        - memory-region
    else:
      properties:
        memory-region: false

  # sram
  - if:
      properties:
        compatible:
          contains:
            enum:
              - fsl,imx8ulp-se-ele-hsm
    then:
      required:
        - sram

    else:
      properties:
        sram: false

additionalProperties: false

examples:
  - |
    secure-enclave {
      compatible = "fsl,imx95-se-ele-hsm";
      mboxes = <&ele_mu0 0 0>, <&ele_mu0 1 0>;
      mbox-names = "tx", "rx";
    };
...
```

## Documentation/devicetree/bindings/firmware/intel,stratix10-rsu.txt
```
Intel Remote System Update (RSU) for Stratix10 SoC FPGAs
============================================
The Intel Remote System Update (RSU) driver exposes interfaces
accessed through the Intel Service Layer to user space via SysFS
device attribute nodes. The RSU interfaces report/control some of
the optional RSU features of the Stratix 10 SoC FPGA.

The RSU feature provides a way for customers to update the boot
configuration of a Stratix 10 SoC device with significantly reduced
risk of corrupting the bitstream storage and bricking the system.

Required properties:
-------------------
The intel-rsu node has the following mandatory properties and must be located
under the firmware/svc node.

- compatible: "intel,stratix10-rsu"

Example:
-------

	firmware {
		svc {
			rsu {
				compatible = "intel,stratix10-rsu";
			};
		};
	};
```

## Documentation/devicetree/bindings/fpga/altera-fpga2sdram-bridge.txt
```
Altera FPGA To SDRAM Bridge Driver

Required properties:
- compatible		: Should contain "altr,socfpga-fpga2sdram-bridge"

Optional properties:
- bridge-enable		: 0 if driver should disable bridge at startup
			  1 if driver should enable bridge at startup
			  Default is to leave bridge in current state.

Example:
	fpga2sdram_br {
		compatible = "altr,socfpga-fpga2sdram-bridge";
		bridge-enable = <0>;
	};
```

## Documentation/devicetree/bindings/fpga/altera-hps2fpga-bridge.txt
```
Altera FPGA/HPS Bridge Driver

Required properties:
- regs		: base address and size for AXI bridge module
- compatible	: Should contain one of:
		  "altr,socfpga-lwhps2fpga-bridge",
		  "altr,socfpga-hps2fpga-bridge", or
		  "altr,socfpga-fpga2hps-bridge"
- reset-names	: Should contain one of:
		  "lwhps2fpga",
		  "hps2fpga", or
		  "fpga2hps"
- resets	: Phandle and reset specifier for the reset listed in
		  reset-names
- clocks	: Clocks used by this module.

Optional properties:
- bridge-enable	: 0 if driver should disable bridge at startup.
		  1 if driver should enable bridge at startup.
		  Default is to leave bridge in its current state.

Example:
	hps_fpgabridge0: fpgabridge@ff400000 {
		compatible = "altr,socfpga-lwhps2fpga-bridge";
		reg = <0xff400000 0x100000>;
		resets = <&rst LWHPS2FPGA_RESET>;
		reset-names = "lwhps2fpga";
		clocks = <&l4_main_clk>;
		bridge-enable = <0>;
	};

	hps_fpgabridge1: fpgabridge@ff500000 {
		compatible = "altr,socfpga-hps2fpga-bridge";
		reg = <0xff500000 0x10000>;
		resets = <&rst HPS2FPGA_RESET>;
		reset-names = "hps2fpga";
		clocks = <&l4_main_clk>;
		bridge-enable = <1>;
	};

	hps_fpgabridge2: fpgabridge@ff600000 {
		compatible = "altr,socfpga-fpga2hps-bridge";
		reg = <0xff600000 0x100000>;
		resets = <&rst FPGA2HPS_RESET>;
		reset-names = "fpga2hps";
		clocks = <&l4_main_clk>;
	};
```

## Documentation/devicetree/bindings/fpga/altera-partial-reconfig.txt
```
Altera Partial Reconfiguration IP Core

Required properties:
- compatible : should contain "altr,pr-ip-core"
- reg        : base address and size for memory mapped io.

Example:

	fpga_mgr: fpga-mgr@ff20c000 {
		compatible = "altr,pr-ip-core";
		reg = <0xff20c000 0x8>;
	};
```
