## Documentation/devicetree/bindings/fpga/intel-stratix10-soc-fpga-mgr.txt
```
Intel Stratix10 SoC FPGA Manager

Required properties:
The fpga_mgr node has the following mandatory property, must be located under
firmware/svc node.

- compatible : should contain "intel,stratix10-soc-fpga-mgr" or
	       "intel,agilex-soc-fpga-mgr" or "intel,agilex5-soc-fpga-mgr"

Optional properties:
The svc node has the following optional properties, must be located under
the fpga_mgr node.

- altr,smmu_enable_quirk: set when SMMU is enabled for the platform.

Example:

	firmware {
		svc {
			fpga_mgr: fpga-mgr {
				compatible = "intel,stratix10-soc-fpga-mgr";
			};
		};
	};
```

## Documentation/devicetree/bindings/gpio/adi,ad242x-gpio.yaml
```yaml
# SPDX-License-Identifier: (GPL-2.0 OR BSD-2-Clause)
%YAML 1.2
---
$id: "http://devicetree.org/schemas/gpio/adi,ad242x-gpio.yaml#"
$schema: "http://devicetree.org/meta-schemas/core.yaml#"

title: Analog Devices AD242x GPIO controller

maintainers:
  - Daniel Mack <daniel@zonque.org>

description: |
  This module is part of the AD242x MFD device. For more details and an example
  refer to Documentation/devicetree/bindings/mfd/ad242x.yaml.

properties:
  compatible:
    enum:
      - adi,ad2428w-gpio

  "#gpio-cells":
    const: 2

  gpio-controller: true

  gpio-over-distance:
    type: object
    description: |
      Sub-node to configure pins as 'GPIO over distance'.
      Pins in this mode are not accessible as regular GPIOs; instead, their
      state is transparantly mirrored between one or multiple nodes.

      Each child node of the 'gpio-over-distance' node describes one pin
      that is to be configured in 'over distance' mode

    properties:
      pin:
        type: object
        properties:
          reg:
            maxItems: 1

          adi,virtual-port-mask:
            $ref: '/schemas/types.yaml#/definitions/uint32'
            description: |
              The virtual port mask to assign this GPIO to.
              Multiple GPIOs can use the same virtual port to link them
              together. Refer to the datasheet for the details.

          adi,gpio-output:
            type: boolean
            description: Configures this GPIO as output. Defaults to input mode.

          adi,gpio-inverted:
            type: boolean
            description: Inverts the GPIO value

        required:
          - reg
          - adi,virtual-port-mask

required:
  - compatible
  - '#gpio-cells'
  - gpio-controller
```

## Documentation/devicetree/bindings/gpio/adi,adg1712.yaml
```yaml
# SPDX-License-Identifier: (GPL-2.0-only OR BSD-2-Clause)
%YAML 1.2
---
$id: http://devicetree.org/schemas/gpio/adi,adg1712.yaml#
$schema: http://devicetree.org/meta-schemas/core.yaml#

title: Analog Devices ADG1712/ADG2712 quad SPST switch GPIO controller

maintainers:
  - Antoniu Miclaus <antoniu.miclaus@analog.com>

description: |
  Bindings for Analog Devices ADG1712/ADG2712 quad single-pole, single-throw
  (SPST) switch controlled by GPIOs. The device features four independent
  switches, each controlled by a dedicated GPIO input pin.

  Each GPIO line exposed by this controller corresponds to one of the four
  switches (SW1-SW4). Setting a GPIO line high enables the corresponding
  switch, while setting it low disables the switch.

  The ADG2712 is a pin-compatible, ultra-low leakage variant of the ADG1712.

properties:
  compatible:
    enum:
      - adi,adg1712
      - adi,adg2712

  switch1-gpios:
    description: GPIO connected to the IN1 control pin (controls SW1)
    maxItems: 1

  switch2-gpios:
    description: GPIO connected to the IN2 control pin (controls SW2)
    maxItems: 1

  switch3-gpios:
    description: GPIO connected to the IN3 control pin (controls SW3)
    maxItems: 1

  switch4-gpios:
    description: GPIO connected to the IN4 control pin (controls SW4)
    maxItems: 1

  gpio-controller: true

  "#gpio-cells":
    const: 2
    description: |
      The first cell is the GPIO number (0-3 corresponding to SW1-SW4).
      The second cell specifies GPIO flags.

required:
  - compatible
  - switch1-gpios
  - switch2-gpios
  - switch3-gpios
  - switch4-gpios
  - gpio-controller
  - "#gpio-cells"

additionalProperties: false

examples:
  - |
    #include <dt-bindings/gpio/gpio.h>

    adg1712: gpio-expander {
        compatible = "adi,adg1712";
        gpio-controller;
        #gpio-cells = <2>;

        switch1-gpios = <&gpio 10 GPIO_ACTIVE_HIGH>;
        switch2-gpios = <&gpio 11 GPIO_ACTIVE_HIGH>;
        switch3-gpios = <&gpio 12 GPIO_ACTIVE_HIGH>;
        switch4-gpios = <&gpio 13 GPIO_ACTIVE_HIGH>;
    };

...
```

## Documentation/devicetree/bindings/gpio/adi,adg1736.yaml
```yaml
# SPDX-License-Identifier: (GPL-2.0-only OR BSD-2-Clause)
%YAML 1.2
---
$id: http://devicetree.org/schemas/gpio/adi,adg1736.yaml#
$schema: http://devicetree.org/meta-schemas/core.yaml#

title: Analog Devices ADG1736 dual SPDT switch GPIO controller

maintainers:
  - Antoniu Miclaus <antoniu.miclaus@analog.com>

description: |
  Bindings for Analog Devices ADG1736 dual single-pole, double-throw (SPDT)
  switch controlled by GPIOs. The device features two independent switches,
  each controlled by a dedicated GPIO input pin and each capable of connecting
  its input to one of two outputs (A or B).

  Each GPIO line exposed by this controller corresponds to one of the two
  switches (SW1-SW2) on the ADG1736. Setting a GPIO line high connects the
  switch to output A, while setting it low connects the switch to output B.

properties:
  compatible:
    const: adi,adg1736

  switch1-gpios:
    description: GPIO connected to the IN1 control pin (controls SW1)
    maxItems: 1

  switch2-gpios:
    description: GPIO connected to the IN2 control pin (controls SW2)
    maxItems: 1

  gpio-controller: true

  "#gpio-cells":
    const: 2
    description: |
      The first cell is the GPIO number (0-1 corresponding to SW1-SW2).
      The second cell specifies GPIO flags.

required:
  - compatible
  - switch1-gpios
  - switch2-gpios
  - gpio-controller
  - "#gpio-cells"

additionalProperties: false

examples:
  - |
    #include <dt-bindings/gpio/gpio.h>

    adg1736: gpio-expander {
        compatible = "adi,adg1736";
        gpio-controller;
        #gpio-cells = <2>;

        switch1-gpios = <&gpio 10 GPIO_ACTIVE_HIGH>;
        switch2-gpios = <&gpio 11 GPIO_ACTIVE_HIGH>;
    };

...
```

## Documentation/devicetree/bindings/gpio/adi,adgm3121.yaml
```yaml
# SPDX-License-Identifier: (GPL-2.0-only OR BSD-2-Clause)
%YAML 1.2
---
$id: http://devicetree.org/schemas/gpio/adi,adgm3121.yaml#
$schema: http://devicetree.org/meta-schemas/core.yaml#

title: ADI ADGM3121/ADGM3144 MEMS RF Switch

maintainers:
  - Antoniu Miclaus <antoniu.miclaus@analog.com>

description: |
  The ADGM3121 is a 3mm x 3mm DPDT (Dual-Pole Dual-Throw) MEMS switch
  operating from DC to 23 GHz. The ADGM3144 is a 3mm x 3mm SP4T
  (Single-Pole Four-Throw) MEMS switch with the same characteristics.

  ADGM3121: RF1A/1B and RF2A/2B ports connected to RFCA/RFCB
  ADGM3144: RF1-4 ports connected to RFC

  Both devices support two control modes:
  - Parallel GPIO mode: Direct control via IN1-IN4 GPIO pins
  - SPI mode: Control via SPI interface with register access

  Key features:
  - DC to 23 GHz frequency range
  - Low insertion loss: -0.5 dB (typical) at 6 GHz
  - High isolation: -22 dB (typical) at 6 GHz
  - Fast switching time: 200 µs (typical)
  - High cycle count: 100 million cycles minimum at +85°C

allOf:
  - $ref: /schemas/spi/spi-peripheral-props.yaml#

properties:
  compatible:
    enum:
      - adi,adgm3121
      - adi,adgm3144

  reg:
    description: SPI chip select number (SPI mode only)
    maxItems: 1

  spi-max-frequency:
    description: Maximum SPI frequency (SPI mode only)
    maximum: 10000000

  gpio-controller: true

  "#gpio-cells":
    description: |
      Number of cells used to specify a GPIO. The meaning of the cells are:
        - First cell: GPIO number (0-3)
        - Second cell: GPIO flags (GPIO_ACTIVE_HIGH/GPIO_ACTIVE_LOW)
    const: 2

  ngpios:
    description: Number of GPIOs available
    const: 4

  pin-spi-gpios:
    description: |
      GPIO specifier for the PIN/SPI mode select pin.
      HIGH = SPI mode, LOW = Parallel GPIO mode
    maxItems: 1

  in1-gpios:
    description: GPIO specifier for IN1 control pin (Parallel mode only)
    maxItems: 1

  in2-gpios:
    description: GPIO specifier for IN2 control pin (Parallel mode only)
    maxItems: 1

  in3-gpios:
    description: GPIO specifier for IN3 control pin (Parallel mode only)
    maxItems: 1

  in4-gpios:
    description: GPIO specifier for IN4 control pin (Parallel mode only)
    maxItems: 1

required:
  - compatible
  - gpio-controller
  - "#gpio-cells"
  - ngpios
  - pin-spi-gpios

if:
  required:
    - reg
then:
  # SPI mode
  required:
    - spi-max-frequency
else:
  # Parallel GPIO mode
  required:
    - in1-gpios
    - in2-gpios
    - in3-gpios
    - in4-gpios

additionalProperties: false

examples:
  - |
    #include <dt-bindings/gpio/gpio.h>

    // SPI mode example - ADGM3121 DPDT switch
    spi {
        #address-cells = <1>;
        #size-cells = <0>;

        switch@0 {
            compatible = "adi,adgm3121";
            reg = <0>;
            spi-max-frequency = <10000000>;
            gpio-controller;
            #gpio-cells = <2>;
            ngpios = <4>;
            pin-spi-gpios = <&gpio0 1 GPIO_ACTIVE_HIGH>;
        };
    };

  - |
    #include <dt-bindings/gpio/gpio.h>

    // SPI mode example - ADGM3144 SP4T switch
    spi {
        #address-cells = <1>;
        #size-cells = <0>;

        switch@0 {
            compatible = "adi,adgm3144";
            reg = <0>;
            spi-max-frequency = <10000000>;
            gpio-controller;
            #gpio-cells = <2>;
            ngpios = <4>;
            pin-spi-gpios = <&gpio0 1 GPIO_ACTIVE_HIGH>;
        };
    };

  - |
    #include <dt-bindings/gpio/gpio.h>

    // Parallel GPIO mode example - ADGM3121
    switch {
        compatible = "adi,adgm3121";
        gpio-controller;
        #gpio-cells = <2>;
        ngpios = <4>;
        pin-spi-gpios = <&gpio0 1 GPIO_ACTIVE_LOW>;
        in1-gpios = <&gpio0 2 GPIO_ACTIVE_HIGH>;
        in2-gpios = <&gpio0 3 GPIO_ACTIVE_HIGH>;
        in3-gpios = <&gpio0 4 GPIO_ACTIVE_HIGH>;
        in4-gpios = <&gpio0 5 GPIO_ACTIVE_HIGH>;
    };
```

## Documentation/devicetree/bindings/gpio/adi,adgs6414d.yaml
```yaml
# SPDX-License-Identifier: (GPL-2.0-only OR BSD-2-Clause)
%YAML 1.2
---
$id: http://devicetree.org/schemas/gpio/adi,adgs6414d.yaml#
$schema: http://devicetree.org/meta-schemas/core.yaml#

title: ADI ADGS6414D Octal SPST Switch

maintainers:
  - Antoniu Miclaus <antoniu.miclaus@analog.com>

description: |
  The ADGS6414D is a high-density octal SPST (Single-Pole Single-Throw)
  switch with ultra-low on-resistance and SPI control interface.

  Key features:
  - 8 independent SPST switches
  - 0.56Ω typical on-resistance
  - SPI control interface with robust error detection
  - 4mm × 5mm, 30-terminal LGA package
  - CRC error detection and SCLK count error detection
  - Daisy-chain capability for multiple devices
  - Pin-for-pin replacement for ADGS1414D and ADGS2414D

  Switch Channels:
  - SW1-SW8: 8 independent switch channels (bits 0-7 in control byte)

allOf:
  - $ref: /schemas/spi/spi-peripheral-props.yaml#

properties:
  compatible:
    const: adi,adgs6414d

  reg:
    description: SPI chip select number
    maxItems: 1

  spi-max-frequency:
    description: Maximum SPI frequency
    maximum: 25000000

  gpio-controller: true

  "#gpio-cells":
    description: |
      Number of cells used to specify a GPIO. The meaning of the cells are:
        - First cell: GPIO number (0-7, corresponding to SW1-SW8)
        - Second cell: GPIO flags (GPIO_ACTIVE_HIGH/GPIO_ACTIVE_LOW)
    const: 2

  ngpios:
    description: Number of GPIOs available (8 switches)
    const: 8

  initial-state:
    description: |
      Initial state of the switches as an 8-bit bitmask.
      Bit 0 = SW1, Bit 1 = SW2, ..., Bit 7 = SW8.
      1 = switch closed, 0 = switch open.
    $ref: /schemas/types.yaml#/definitions/uint8
    default: 0

required:
  - compatible
  - reg
  - gpio-controller
  - "#gpio-cells"
  - ngpios

additionalProperties: false

examples:
  - |
    #include <dt-bindings/gpio/gpio.h>

    spi {
        #address-cells = <1>;
        #size-cells = <0>;

        switch@0 {
            compatible = "adi,adgs6414d";
            reg = <0>;
            spi-max-frequency = <25000000>;
            gpio-controller;
            #gpio-cells = <2>;
            ngpios = <8>;
            initial-state = /bits/ 8 <0x00>; // All switches open initially
        };
    };

  - |
    #include <dt-bindings/gpio/gpio.h>

    // Example with some switches initially closed
    spi {
        #address-cells = <1>;
        #size-cells = <0>;

        switch@1 {
            compatible = "adi,adgs6414d";
            reg = <1>;
            spi-max-frequency = <10000000>;
            gpio-controller;
            #gpio-cells = <2>;
            ngpios = <8>;
            initial-state = /bits/ 8 <0x05>; // SW1 and SW3 closed initially
        };
    };
```

## Documentation/devicetree/bindings/gpio/adi,adrv906x-gpio.yaml
```yaml
# SPDX-License-Identifier: (GPL-2.0-only OR BSD-2-Clause)
%YAML 1.2
---
$id: http://devicetree.org/schemas/gpio/adi,adrv906x-gpio.yaml#
$schema: http://devicetree.org/meta-schemas/core.yaml#

title: Analog Devices ADRV906x SoC GPIO Controller

maintainers:
  - Woodrow Barlow <woodrow.barlow@analog.com>

description:
  Bindings for Analog Device Inc. ADRV906x SoC GPIO Controller.

properties:
  compatible:
    const: adi,adrv906x-gpio

  reg:
    maxItems: 1
    description:
      Physical base address and length of the GPIO controller register
      block.

  "#gpio-cells":
    const: 2
    description:
      See gpio.yaml in this directory for a description of the GPIO cells.

  gpio-controller:
    type: boolean
    description:
      Indicates that this node is a GPIO controller.

  ngpios:
    $ref: /schemas/types.yaml#/definitions/uint32
    description:
      Number of GPIO lines (0..n-1).
    minimum: 1

  pintmux:
    $ref: /schemas/types.yaml#/definitions/uint32-array
    maxItems: 1
    description:
      Base address of the pin interrupt mux associated with the GPIO
      controller.

required:
  - compatible
  - reg
  - "#gpio-cells"
  - gpio-controller
  - ngpios
  - pintmux

additionalProperties: false

examples:
  - |
    gpio1: gpio@2021b000 {
      compatible = "adi,adrv906x-gpio";
      reg = <0x2021b000 0x1000>;
      pintmux = <0x20102200>;
      gpio-controller;
      #gpio-cells = <2>;
      ngpios = <64>;
    };

...
```
