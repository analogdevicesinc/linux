## Documentation/devicetree/bindings/gpio/adi,adsp-port-gpio.yaml
```yaml
# SPDX-License-Identifier: (GPL-2.0-only OR BSD-2-Clause)
%YAML 1.2
---
$id: http://devicetree.org/schemas/gpio/adi,adsp-port-gpio.yaml#
$schema: http://devicetree.org/meta-schemas/core.yaml#

title: Analog Devices GPIO Port Driver for SC5XX-family processors

maintainers:
  - Nathan Barrett-Morrison <nathan.morrison@timesys.com>
  - Greg Malysa <greg.malysa@timesys.com>

description: |
  Analog Devices GPIO Port Driver for SC5XX-family processors

properties:
  compatible:
    enum:
      - adi,adsp-port-gpio

  reg:
    maxItems: 1

  gpio-controller: true

  "#gpio-cells":
    const: 2

  gpio-ranges:
    maxItems: 1
    description: "Associated pinmux controller and the GPIO range values"

  adi,pint:
    maxItems: 1
    description: "Associated pin interrupt controller driver"

  adi,gpio-base:
    maxItems: 1
    description: "Pin count offset for associated GPIO base"

required:
  - compatible
  - reg
  - "#gpio-cells"
  - gpio-controller
  - gpio-ranges
  - adi,pint
  - adi,gpio-base

additionalProperties: false

examples:
  - |
    gpa: gport@0x31004000 {
      compatible = "adi,adsp-port-gpio";
      gpio-controller;
      #gpio-cells = <2>;
      reg = <0x31004000 0x7F>;
      gpio-ranges = <&pinctrl0 0 0 16>;
      adi,pint = <&pint0 1>;
      adi,gpio-base = <0>;
    };

    gpb: gport@0x31004080 {
      compatible = "adi,adsp-port-gpio";
      gpio-controller;
      #gpio-cells = <2>;
      reg = <0x31004080 0x7F>;
      gpio-ranges = <&pinctrl0 0 16 16>;
      adi,pint = <&pint0 0>;
      adi,gpio-base = <16>;
    };
...
```

## Documentation/devicetree/bindings/gpio/adi,sc5xx-gpio.yaml
```yaml
# SPDX-License-Identifier: (GPL-2.0-only OR BSD-2-Clause)
%YAML 1.2
---
$id: http://devicetree.org/schemas/gpio/adi,sc5xx-gpio.yaml#
$schema: http://devicetree.org/meta-schemas/core.yaml#

title: Analog Devices GPIO Port Driver for SC5XX-family processors

maintainers:
  - Arturs Artamonovs <arturs.artamonovs@analog.com>
  - Utsav Agarwal <Utsav.Agarwal@analog.com>

description: |
  Analog Devices GPIO Port Driver for SC5XX-family processors

properties:
  compatible:
    enum:
      - adi,sc5xx-gpio

  gpio-controller: true

  "#gpio-cells":
    const: 2

  gpio-ranges:
    description: Associated pinmux controller and the GPIO range values

  adi,pint:
    $ref: /schemas/types.yaml#/definitions/phandle-array
    description: Associated pin interrupt controller driver
    items:
      - items:
          - description: phandle to pin interrupt controller driver
          - description: interrupt value

  reg:
    description: PORT GPIO control registers

required:
  - compatible
  - reg
  - "#gpio-cells"
  - gpio-controller
  - gpio-ranges

additionalProperties: false

examples:
  - |
    gpa: 31004000 {
      compatible = "adi,sc5xx-gpio";
      gpio-controller;
      #gpio-cells = <2>;
      reg = <0x31004000 0x7f>;
      gpio-ranges = <&pinctrl0 0 0 16>;
    };
```

## Documentation/devicetree/bindings/gpio/fsl,mpc8323-qe-pario-bank.yaml
```yaml
# SPDX-License-Identifier: (GPL-2.0-only OR BSD-2-Clause)
%YAML 1.2
---
$id: http://devicetree.org/schemas/soc/fsl/cpm_qe/fsl,mpc8323-qe-pario-bank.yaml#
$schema: http://devicetree.org/meta-schemas/core.yaml#

title: Freescale QUICC Engine Parallel I/O (QE PARIO) GPIO Bank

maintainers:
  - Christophe Leroy <christophe.leroy@csgroup.eu>

properties:
  compatible:
    items:
      - enum:
          - fsl,chip-qe-pario-bank
      - const: fsl,mpc8323-qe-pario-bank

  reg:
    maxItems: 1

  gpio-controller: true

  '#gpio-cells':
    const: 2

required:
  - compatible
  - reg
  - gpio-controller
  - '#gpio-cells'

additionalProperties: false

examples:
  - |
    gpio-controller@1400 {
        compatible = "fsl,mpc8360-qe-pario-bank", "fsl,mpc8323-qe-pario-bank";
        reg = <0x1400 0x18>;
        gpio-controller;
        #gpio-cells = <2>;
    };

    gpio-controller@1460 {
        compatible = "fsl,mpc8360-qe-pario-bank", "fsl,mpc8323-qe-pario-bank";
        reg = <0x1460 0x18>;
        gpio-controller;
        #gpio-cells = <2>;
    };
```

## Documentation/devicetree/bindings/gpio/fsl,qixis-cpld-gpio.yaml
```yaml
# SPDX-License-Identifier: (GPL-2.0-only OR BSD-2-Clause)
%YAML 1.2
---
$id: http://devicetree.org/schemas/gpio/fsl,qixis-cpld-gpio.yaml#
$schema: http://devicetree.org/meta-schemas/core.yaml#

title: GPIO controller embedded in the NXP LX2160A-RDB QIXIS CPLD

maintainers:
  - Ioana Ciornei <ioana.ciornei@nxp.com>

description: |
  This module is part of the QIXIS CPLD found on some Layerscape boards such as LX2160ARDB.
  For more details see ../mfd/fsl,qixis-cpld.yaml.

  Each controller supports a maximum of 8 GPIO lines and each line has fixed
  direction which cannot be changed using a direction register.

properties:
  compatible:
    enum:
      - fsl,lx2160a-rdb-qixis-cpld-gpio

  reg:
    maxItems: 1

  "#gpio-cells":
    const: 2

  gpio-controller: true

  gpio-line-names:
    minItems: 1
    maxItems: 8

required:
  - compatible
  - "#gpio-cells"
  - gpio-controller

additionalProperties: false
```

## Documentation/devicetree/bindings/gpio/gpio-adg1414.yaml
```yaml
# SPDX-License-Identifier: (GPL-2.0-only OR BSD-2-Clause)
%YAML 1.2
---
$id: http://devicetree.org/schemas/gpio/gpio-adg1414.yaml#
$schema: http://devicetree.org/meta-schemas/core.yaml#

title: ADG1414 SPST Switch Driver

maintainers:
  - Kim Seer Paller <kimseer.paller@analog.com>

description:
  The ADG1414 is a 9.5 Ω RON ±15 V/+12 V/±5 V iCMOS serially-controlled
  octal SPST switches.

properties:
  compatible:
    enum:
      - adi,adg1414

  reg:
    maxItems: 1

  gpio-controller: true

  '#gpio-cells':
    const: 2

  spi-cpha: true

  reset-gpios:
    description: GPIO specifier that resets the device.
    maxItems: 1

  '#daisy-chained-devices':
    description: The number of daisy-chained devices.
    default: 1
    minimum: 1
    maximum: 4

required:
  - compatible
  - reg
  - spi-cpha

allOf:
  - $ref: /schemas/spi/spi-peripheral-props.yaml#

unevaluatedProperties: false

examples:
  - |
    #include <dt-bindings/gpio/gpio.h>
    spi {
        #address-cells = <1>;
        #size-cells = <0>;

        gpio@0 {
            compatible = "adi,adg1414";
            reg = <0>;
            spi-max-frequency = <1000000>;
            spi-cpha;
            reset-gpios = <&gpio 17 GPIO_ACTIVE_HIGH>;
        };
    };
...
```

## Documentation/devicetree/bindings/gpio/gpio-adi-adrv906x.txt
```
Analog Device Inc. ADRV906x SoC GPIO Controller

Required properties:
- compatible: Compatible property value should be "adi,adrv906x-gpio".
- reg: Physical base address of the controller and length of memory mapped
  region.
- #gpio-cells: Should be two. For consumer use see gpio.txt.
- ngpios: Number of GPIO lines (0..n-1)
- gpio-controller: Specifies that the node is a gpio controller.
- pintmux: Specifies the base address for the pin interrupt mux associated with the GPIO controller

Example:

    gpio1: gpio@2021B000 {
        compatible = "adi,adrv906x-gpio";
        reg = <0x2021B000 0x1000>;
        pintmux = <0x20102200>;
        gpio-controller;
        #gpio-cells = <2>;
        ngpios = <ADI_ADRV906X_PIN_COUNT>;
    }; 
```

## Documentation/devicetree/bindings/gpio/gpio-imx-rpmsg.txt
```
Device-Tree bindings for drivers/gpio/gpio-imx-rpmsg.c gpio driver over
rpmsg. On i.mx7ULP PTA PTB are connected on M4 side, so rpmsg gpio driver
needed to get/set gpio status from M4 side by rpmsg.

Required properties:
- compatible : Should be "fsl,imx-rpmsg-gpio".
- port_idx : Specify the GPIO PORT index, PTA:0, PTB:1.
- gpio-controller : Mark the device node as a gpio controller.
- #gpio-cells : Should be two. The first cell is the pin number and
  the second cell is used to specify the gpio polarity:
      0 = active high
      1 = active low
- interrupt-controller: Marks the device node as an interrupt controller.
- #interrupt-cells : Should be 2.  The first cell is the GPIO number.
  The second cell bits[3:0] is used to specify trigger type and level flags:
      1 = low-to-high edge triggered.
      2 = high-to-low edge triggered.
      4 = active high level-sensitive.
      8 = active low level-sensitive.

Note: Each GPIO port should have an alias correctly numbered in "aliases"
node.

Examples:

aliases {
	gpio4 = &rpmsg_gpio0;
	gpio5 = &rpmsg_gpio1;
};

rpmsg_gpio0: rpmsg-gpio0 {
	compatible = "fsl,imx-rpmsg-gpio";
	port_idx = <0>;
	gpio-controller;
	#gpio-cells = <2>;
	#interrupt-cells = <2>;
	interrupt-controller;
	interrupt-parent = <&rpmsg_gpio0>;
	status = "okay";
};

rpmsg_gpio1: rpmsg-gpio1 {
	compatible = "fsl,imx-rpmsg-gpio";
	port_idx = <1>;
	gpio-controller;
	#gpio-cells = <2>;
	#interrupt-cells = <2>;
	interrupt-controller;
	interrupt-parent = <&rpmsg_gpio1>;
	status = "okay";
};

&skeleton_node {
	interrupt-parent = <&rpmsg_gpio1>;
	interrupts = <7 2>;
	wakeup-gpios = <&rpmsg_gpio1 7 GPIO_ACTIVE_LOW>;
};
```

## Documentation/devicetree/bindings/hwmon/adi,axi_fan_control.yaml
```yaml
# SPDX-License-Identifier: GPL-2.0
# Copyright 2019 Analog Devices Inc.
%YAML 1.2
---
$id: http://devicetree.org/schemas/bindings/hwmon/adi,axi_fan_control.yaml#
$schema: http://devicetree.org/meta-schemas/core.yaml#

title: Analog Devices AXI FAN Control Device Tree Bindings

maintainers:
  - Nuno Sá <nuno.sa@analog.com>

description: |+
  Bindings for the Analog Devices AXI FAN Control driver. Spefications of the
  core can be found in:

  https://wiki.analog.com/resources/fpga/docs/axi_fan_control

select: false

properties:
  compatible:
    enum:
        - adi,axi-fan-control-1.00.a

  reg:
    maxItems: 1

  clocks:
    maxItems: 1

  interrupts:
    maxItems: 1

  adi,pulses-per-revolution:
    description: Value specifying the number of pulses per revolution of the controlled FAN.
    allOf:
      - $ref: /schemas/types.yaml#/definitions/uint32

required:
  - compatible
  - reg
  - clocks
  - interrupts
  - adi,pulses-per-revolution

examples:
  - |
    axi_fan_control: axi-fan-control@80000000 {
      compatible = "adi,axi-pulse-capture-1.00.a";
      reg = <0x0 0x80000000 0x10000>;
      clocks = <&clk 71>;
      interrupts = <0 110 0>;
      adi,pulses-per-revolution = <2>;
    };
...
```

## Documentation/devicetree/bindings/hwmon/adi,ltc2947.yaml
```yaml
%YAML 1.2
---
$id: http://devicetree.org/schemas/bindings/hwmon/adi,ltc2947.yaml#
$schema: http://devicetree.org/meta-schemas/core.yaml#

title: Analog Devices LTC2947 high precision power and energy monitor

maintainers:
  - Nuno Sá <nuno.sa@analog.com>

description: |
  Analog Devices LTC2947 high precision power and energy monitor over SPI or I2C.

  https://www.analog.com/media/en/technical-documentation/data-sheets/LTC2947.pdf

properties:
  compatible:
    enum:
      - adi,ltc2947

  reg:
    maxItems: 1

  clocks:
    description:
      The LTC2947 uses either a trimmed internal oscillator or an external clock as the time
      base for determining the integration period to represent time, charge and energy. When
      an external clock is used, this property must be set accordingly.
    maxItems: 1

required:
  - compatible
  - reg


examples:
  - |
    spi0 {
           #address-cells = <1>;
           #size-cells = <0>;

           ltc2947_spi: ltc2947@0 {
                   compatible = "adi,ltc2947";
                   reg = <0>;
           };
    };
...
```

## Documentation/devicetree/bindings/hwmon/adi,ltc2991.yaml
```yaml
# SPDX-License-Identifier: (GPL-2.0 OR BSD-2-Clause)
%YAML 1.2
---

$id: http://devicetree.org/schemas/hwmon/adi,ltc2991.yaml#
$schema: http://devicetree.org/meta-schemas/core.yaml#

title: Analog Devices LTC2991 Octal I2C Voltage, Current and Temperature Monitor

maintainers:
  - Antoniu Miclaus <antoniu.miclaus@analog.com>

description: |
  The LTC2991 is used to monitor system temperatures, voltages and currents.
  Through the I2C serial interface, the eight monitors can individually measure
  supply voltages and can be paired for differential measurements of current
  sense resistors or temperature sensing transistors.

  Datasheet:
    https://www.analog.com/en/products/ltc2991.html

properties:
  compatible:
    enum:
      - adi,ltc2991

  reg:
    maxItems: 1

  '#address-cells':
    const: 1

  '#size-cells':
    const: 0

  vcc-supply: true

patternProperties:
  "^channel@[0-3]$":
    type: object
    description: |
      Represents the differential/temperature channels.

    properties:
      reg:
        description: |
          The channel number. LTC2992 can monitor 4 currents/temperatures.
        items:
          minimum: 0
          maximum: 3

      shunt-resistor-mili-ohms:
        description:
          The value of curent sense resistor in miliohms. Enables differential
          input pair.

      temperature-enable:
        description:
          Enables temperature readings for a input pair.

required:
  - compatible
  - reg

additionalProperties: false

examples:
  - |
    i2c {
        #address-cells = <1>;
        #size-cells = <0>;

        hwmon@48 {
            compatible = "adi,ltc2991";
            reg = <0x48>;
            vcc-supply = <&vcc>;
        };
    };
  - |
    i2c {
        #address-cells = <1>;
        #size-cells = <0>;

        hwmon@48 {
            #address-cells = <1>;
            #size-cells = <0>;

            compatible = "adi,ltc2991";
            reg = <0x48>;
            vcc-supply = <&vcc>;

            channel@0 {
                    reg = <0x0>;
                    shunt-resistor-mili-ohms = <100>;
            };

            channel@1 {
                    reg = <0x1>;
                    shunt-resistor-mili-ohms = <100>;
            };

            channel@2 {
                    reg = <0x2>;
                    temperature-enable;
            };

            channel@3 {
                    reg = <0x3>;
                    temperature-enable;
            };
        };
    };
...
```

## Documentation/devicetree/bindings/hwmon/adi,ltc4283-hwmon.yaml
```yaml
%YAML 1.2
---
$id: http://devicetree.org/schemas/hwmon/adi,ltc4282-hwmon.yaml#
$schema: http://devicetree.org/meta-schemas/core.yaml#

title: HWMON driver for LTC4282 Negative Voltage Hot Swap Controller

maintainers:
  - Nuno Sá <nuno.sa@analog.com>

description: |
  This module is part of the LTC4283 MFD device.
  see Documentation/devicetree/bindings/mfd/adi,ltc4283.yaml
  This implements the HWMON bindings for the LTC4283 negative voltage hot swap
  controller.

properties:
  compatible:
    enum:
      - adi,ltc4283-hwmon

required:
  - compatible
  - adi,rsense-nano-ohms
```
