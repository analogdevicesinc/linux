## Documentation/devicetree/bindings/iio/accel/adi,adxl380.yaml
```yaml
# SPDX-License-Identifier: (GPL-2.0-only OR BSD-2-Clause)
%YAML 1.2
---
$id: http://devicetree.org/schemas/iio/accel/adi,adxl380.yaml#
$schema: http://devicetree.org/meta-schemas/core.yaml#

title: Analog Devices ADXL380/382 3-Axis Digital Accelerometer

maintainers:
  - Ramona Gradinariu <ramona.gradinariu@analog.com>

description: |
  The ADXL380/ADXL382 is a low noise density, low power, 3-axis
  accelerometer with selectable measurement ranges. The ADXL380
  supports the ±4 g, ±8 g, and ±16 g ranges, and the ADXL382 supports
  ±15 g, ±30 g, and ±60 g ranges.
  The ADXL380/ADXL382 offers industry leading noise, enabling precision
  applications with minimal calibration. The low noise, and low power
  ADXL380/ADXL382 enables accurate measurement in an environment with
  high vibration, heart sounds and audio.

  In addition to its low power consumption, the ADXL380/ADXL382 has
  many features to enable true system level performance. These
  include a built-in micropower temperature sensor, single / double /
  triple tap detection and a state machine to prevent a false
  triggering. In addition, the ADXL380/ADXL382 has provisions for
  external control of the sampling time and/or an external clock.

    https://www.analog.com/en/products/adxl380.html

properties:
  compatible:
    enum:
      - adi,adxl380
      - adi,adxl382

  reg:
    maxItems: 1

  interrupts:
    maxItems: 1

required:
  - compatible
  - reg
  - interrupts

allOf:
  - $ref: /schemas/spi/spi-peripheral-props.yaml#

unevaluatedProperties: false

examples:
  - |
    #include <dt-bindings/interrupt-controller/irq.h>

    i2c {
      #address-cells = <1>;
      #size-cells = <0>;

      accelerometer@54 {
        compatible = "adi,adxl380";
        reg = <0x54>;
        interrupt-parent = <&gpio>;
        interrupts = <25 IRQ_TYPE_LEVEL_HIGH>;
      };
    };
  - |
    #include <dt-bindings/interrupt-controller/irq.h>

    spi {
      #address-cells = <1>;
      #size-cells = <0>;

      accelerometer@0 {
        compatible = "adi,adxl380";
        reg = <0>;
        spi-max-frequency = <8000000>;
        interrupt-parent = <&gpio>;
        interrupts = <25 IRQ_TYPE_LEVEL_HIGH>;
      };
    };
```

## Documentation/devicetree/bindings/iio/adc/ad400x.txt
```
Analog Devices AD400X ADC device driver

Required properties for the AD400X:
	- compatible: Must be one of
		* "adi,ad4000"
		* "adi,ad4001"
		* "adi,ad4002"
		* "adi,ad4003"
		* "adi,ad4004"
		* "adi,ad4005"
		* "adi,ad4006"
		* "adi,ad4007"
		* "adi,ad4008"
		* "adi,ad4010"
		* "adi,ad4011"
		* "adi,ad4020"
		* "adi,ad4021"
		* "adi,ad4022"
	- reg: SPI chip select number for the device.
	- spi-max-frequency: See Documentation/devicetree/bindings/spi/spi-bus.txt.
	- dmas: DMA specifier, consisting of a phandle to DMA controller node.
	- dma-names: Must be "rx".
	- vref-supply: phandle to the regulator for ADC reference voltage.

Example:

ad4020: adc@0 {
	compatible = "adi,ad4020";
	reg = <0>;
	spi-max-frequency = <71000000>;

	dmas = <&rx_dma 0>;
	dma-names = "rx";

	vref-supply = <&vref>;
	#io-channel-cells = <1>;
};
```

## Documentation/devicetree/bindings/iio/adc/ad7091r5.txt
```
* Analog Devices AD7091R5 Analog to Digital Converter (ADC)

Required properties:
  - compatible: Must be "adi,ad7091r5".
  - reg: I2C address for the device

Optional properties:
  - vref-supply: phandle + specifier to a regulator for the external VREF
	supply. If no external VREF is supplied this attribute should be omitted.
	see: Documentation/devicetree/bindings/regulator/regulator.txt

Example:
adc@0 {
	compatible: "adi,ad7091r5";
	reg = <0x2F>;
};
```

## Documentation/devicetree/bindings/iio/adc/adi,ad400x.yaml
```yaml
# SPDX-License-Identifier: (GPL-2.0-only OR BSD-2-Clause)
%YAML 1.2
---
$id: http://devicetree.org/schemas/iio/adc/adi,ad400x.yaml#
$schema: http://devicetree.org/meta-schemas/core.yaml#

title: Analog Devices AD400X ADC device driver

maintainers:
  - Marcelo Schmitt <marcelo.schmitt@analog.com>

description: |
  Analog Devices AD400X family Analog to Digital Converters with SPI support.
  Specifications can be found at:
    https://www.analog.com/en/products/ad4001.html
    https://www.analog.com/en/products/ad4002.html
    https://www.analog.com/en/products/ad4003.html
    https://www.analog.com/en/products/ad4004.html
    https://www.analog.com/en/products/ad4005.html
    https://www.analog.com/en/products/ad4006.html
    https://www.analog.com/en/products/ad4007.html
    https://www.analog.com/en/products/ad4008.html
    https://www.analog.com/en/products/ad4010.html
    https://www.analog.com/en/products/ad4011.html
    https://www.analog.com/en/products/ad4020.html
    https://www.analog.com/en/products/ad4021.html
    https://www.analog.com/en/products/ad4022.html
    https://www.analog.com/en/products/adaq4003.html

properties:
  compatible:
    enum:
      - adi,ad4001
      - adi,ad4002
      - adi,ad4003
      - adi,ad4004
      - adi,ad4005
      - adi,ad4006
      - adi,ad4007
      - adi,ad4008
      - adi,ad4010
      - adi,ad4011
      - adi,ad4020
      - adi,ad4021
      - adi,ad4022
      - adi,adaq4003

  reg: true
  spi-max-frequency: true

  dmas:
    description: |
      DMA specifier, consisting of a phandle to DMA controller node.
    maxItems: 1

  dma-names:
    const: rx

  clocks:
    maxItems: 1

  clock-names:
    const: ref_clk
    description: AD400X reference clock name.

  pwms:
    description: |
      PWM used as trigger source for the SPI engine, also represents the
      acquisition rate for the samples.
    maxItems: 1

  pwm-names:
    const: cnv

  vref-supply:
    description: Phandle to the regulator for ADC reference voltage.

  '#address-cells':
    const: 1

  '#size-cells':
    const: 0

patternProperties:
  "^channel@([0-1])$":
    $ref: adc.yaml
    type: object
    description: Represents the external channel connected to the ADC.

    properties:
      reg:
        maxItems: 1

      diff-channels: true

    required:
      - reg

    additionalProperties: false

required:
  - compatible
  - reg
  - dmas
  - dma-names
  - vref-supply

allOf:
  - $ref: /schemas/spi/spi-peripheral-props.yaml#

  - if:
      properties:
        compatible:
          contains:
            enum:
              - adi,adaq4003

    then:
      required:
        - compatible
        - reg
        - dmas
        - dma-names
        - clocks
        - clock-names
        - pwms
        - pwm-names
        - vref-supply

unevaluatedProperties: false

examples:
  - |
    spi {
        #address-cells = <1>;
        #size-cells = <0>;
        /* Example for a AD400X devices */
        adc@0 {
            compatible = "adi,ad4020";
            reg = <0>;
            spi-max-frequency = <71000000>;
            vref-supply = <&vref>;

            dmas = <&rx_dma 0>;
            dma-names = "rx";

            #address-cells = <1>;
            #size-cells = <0>;

            channel@0 {
                reg = <0>;
                diff-channels = <0 1>;
            };
        };
    };
  - |
    spi {
        #address-cells = <1>;
        #size-cells = <0>;

        /* Example for a ADAQ400X devices */
        adc@0 {
            compatible = "adi,adaq4003";
            reg = <0>;
            spi-max-frequency = <80000000>;
            dmas = <&rx_dma 0>;
            dma-names = "rx";
            clocks = <&spi_clk>;
            clock-names = "ref_clk";
            pwms = <&adc_trigger 0 0>;
            pwm-names = "cnv";
            vref-supply = <&vref>;

            #address-cells = <1>;
            #size-cells = <0>;

            channel@0 {
                reg = <0>;
                diff-channels = <0 1>;
            };
        };
    };
```

## Documentation/devicetree/bindings/iio/adc/adi,ad4030.yaml
```yaml
# SPDX-License-Identifier: (GPL-2.0-only OR BSD-2-Clause)
# Copyright 2024 Analog Devices Inc.
# Copyright 2024 BayLibre, SAS.
%YAML 1.2
---
$id: http://devicetree.org/schemas/iio/adc/adi,ad4030.yaml#
$schema: http://devicetree.org/meta-schemas/core.yaml#

title: Analog Devices AD4030 and AD4630 ADC families

maintainers:
  - Michael Hennerich <michael.hennerich@analog.com>
  - Nuno Sa <nuno.sa@analog.com>

description: |
  Analog Devices AD4030 single channel and AD4630/AD4632 dual channel precision
  SAR ADC families

  * https://www.analog.com/media/en/technical-documentation/data-sheets/ad4030-24-4032-24.pdf
  * https://www.analog.com/media/en/technical-documentation/data-sheets/ad4630-24_ad4632-24.pdf
  * https://www.analog.com/media/en/technical-documentation/data-sheets/ad4630-16-4632-16.pdf
  * https://www.analog.com/media/en/technical-documentation/data-sheets/adaq4216.pdf
  * https://www.analog.com/media/en/technical-documentation/data-sheets/adaq4224.pdf

$ref: /schemas/spi/spi-peripheral-props.yaml#

properties:
  compatible:
    enum:
      - adi,ad4030-24
      - adi,ad4032-24
      - adi,ad4630-16
      - adi,ad4630-24
      - adi,ad4632-16
      - adi,ad4632-24
      - adi,adaq4216
      - adi,adaq4224

  reg:
    maxItems: 1

  spi-max-frequency:
    maximum: 102040816

  spi-rx-bus-width:
    enum: [1, 2, 4]

  vdd-5v-supply: true
  vdd-1v8-supply: true
  vio-supply: true

  ref-supply:
    description:
      Optional External unbuffered reference. Used when refin-supply is not
      connected.

  refin-supply:
    description:
      Internal buffered Reference. Used when ref-supply is not connected.

  vddh-supply:
    description:
      PGIA Positive Power Supply.

  vdd-fda-supply:
    description:
      FDA Positive Power Supply.

  cnv-gpios:
    description:
      The Convert Input (CNV). It initiates the sampling conversions.
    maxItems: 1

  reset-gpios:
    description:
      The Reset Input (/RST). Used for asynchronous device reset.
    maxItems: 1

  pga-gpios:
    description:
      A0 and A1 pins for gain selection. For devices that have PGA configuration
      input pins, pga-gpios should be defined if adi,gain-milli is absent.
    minItems: 2
    maxItems: 2

  adi,pga-value:
    $ref: /schemas/types.yaml#/definitions/uint32
    description: |
      Should be present if PGA control inputs are pin-strapped. The values
      specify the gain per mille. For example, 333 means the input signal is
      scaled by a 0.333 factor (i.e. attenuated to one third of it's original
      magnitude). Possible values:
      Gain 333 (A1=0, A0=0)
      Gain 555 (A1=0, A0=1)
      Gain 2222 (A1=1, A0=0)
      Gain 6666 (A1=1, A0=1)
      If defined, pga-gpios must be absent.
    enum: [333, 555, 2222, 6666]

  pwms:
    description: PWM signal connected to the CNV pin.
    maxItems: 1

  interrupts:
    description:
      The BUSY pin is used to signal that the conversions results are available
      to be transferred when in SPI Clocking Mode. This nodes should be
      connected to an interrupt that is triggered when the BUSY line goes low.
    maxItems: 1

  interrupt-names:
    const: busy

required:
  - compatible
  - reg
  - vdd-5v-supply
  - vdd-1v8-supply
  - vio-supply
  - cnv-gpios

allOf:
  - oneOf:
      - required:
          - ref-supply
      - required:
          - refin-supply
  # ADAQ devices require a gain property to indicate how hardware PGA is set
  - if:
      properties:
        compatible:
          contains:
            pattern: ^adi,adaq
    then:
      allOf:
        - required: [vddh-supply, vdd-fda-supply]
          properties:
            ref-supply: false
        - oneOf:
            - required:
                - adi,pga-value
            - required:
                - pga-gpios
    else:
      properties:
        adi,pga-value: false
        pga-gpios: false


unevaluatedProperties: false

examples:
  - |
    #include <dt-bindings/gpio/gpio.h>

    spi {
        #address-cells = <1>;
        #size-cells = <0>;

        adc@0 {
            compatible = "adi,ad4030-24";
            reg = <0>;
            spi-max-frequency = <80000000>;
            vdd-5v-supply = <&supply_5V>;
            vdd-1v8-supply = <&supply_1_8V>;
            vio-supply = <&supply_1_8V>;
            ref-supply = <&supply_5V>;
            cnv-gpios = <&gpio0 0 GPIO_ACTIVE_HIGH>;
            reset-gpios = <&gpio0 1 GPIO_ACTIVE_LOW>;
        };
    };
```
