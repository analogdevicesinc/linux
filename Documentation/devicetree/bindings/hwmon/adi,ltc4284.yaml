## Documentation/devicetree/bindings/hwmon/intel,soc64-hwmon.yaml
```yaml
# SPDX-License-Identifier: (GPL-2.0-only OR BSD-2-Clause)
%YAML 1.2
---
$id: http://devicetree.org/schemas/hwmon/intel,soc64-hwmon.yaml#
$schema: http://devicetree.org/meta-schemas/core.yaml#

title: Intel Hardware monitor SOC FPGA

maintainers:
  - Ang Tien Sung <tien.sung.ang@intel.com>

description: |
  This is the Intel SoC FPGA hardware monitor unit provides you with
  on-chip voltage and temperature sensors. You can use these sensors
  to monitor external voltages and on-chip operation conditions such
  as internal power rail and on-chip junction temperature.

properties:
  compatible: "intel,soc64-hwmon"
  temperature:
    description:
      Specifies the possible mappings of temperature sensors
      diodes on the SOC FPGA main die.
  voltage:
    description:
      Specifies the possible mappings of the voltage sensors
      on the SOC FPGA analog to digital converter of the secure device
      manager (SDM).
  input:
    description:
      Specifies each sensor.
  reg:
    description:
      The sensor mapping address denoted by lower 16bits being
      the channel mask location that defines the channel number.
      The upper 16bits denotes the page number.
      The bit mask of 0x1 represents channel 1. The supported
      page and channel is dependent on the SOC FPGA variant.
      Page number greater than 0 is only supported on the
      temperature sensors.
  label:
    description:
      A label to describe the sensors.

required:
  - compatible
  - reg

examples:
  - |
    temp_volt {
      compatible = "intel,soc64-hwmon";
      voltage {
        #address-cells = <1>;
        #size-cells = <0>;
        input@2 {
          label = "0.8V VCC";
          reg = <2>;
        };

        input@3 {
          label = "1.8V VCCIO_SDM";
          reg = <3>;
        };

        input@4 {
          label = "1.8V VCCPT";
          reg = <4>;
        };

        input@5 {
          label = "1.2V VCCCRCORE";
          reg = <5>;
        };

        input@6 {
          label = "0.9V VCCH";
          reg = <6>;
        };

        input@7 {
          label = "0.8V VCCL";
          reg = <7>;
        };
      };

      temperature {
        #address-cells = <1>;
        #size-cells = <0>;

        input@0 {
          label = "Main Die SDM";
          reg = <0x0>;
        };

        input@10001 {
          label = "Main Die corner bottom left 1";
          reg = <0x10001>;
        };

        input@10002 {
          label = "Main Die corner bottom left 1";
          reg = <0x10002>;
        };

        input@20001 {
          label = "Main Die corner top left 1";
          reg = <0x20001>;
        };

        input@20002 {
          label = "Main Die corner top left 2";
          reg = <0x20002>;
        };

        input@30001 {
          label = "Main Die corner bottom right 1";
          reg = <0x30001>;
        };

        input@30002 {
          label = "Main Die corner bottom right 2";
          reg = <0x30002>;
        };

        input@40001 {
          label = "Main Die corner top right HPS 1";
          reg = <0x40001>;
        };

        input@40002 {
          label = "Main Die corner bottom right";
          reg = <0x40002>;
        };
      };
    };
```

## Documentation/devicetree/bindings/hwmon/pmbus/adi,adp1050.yaml
```yaml
# SPDX-License-Identifier: (GPL-2.0 OR BSD-2-Clause)
%YAML 1.2
---
$id: http://devicetree.org/schemas/hwmon/pmbus/adi,adp1050.yaml#
$schema: http://devicetree.org/meta-schemas/core.yaml#

title: Analog Devices ADP1050 digital controller with PMBus interface

maintainers:
  - Radu Sabau <radu.sabau@analog.com>

description: |
   The ADP1050, ADP1051, and ADP1055 are used to monitor system voltages,
   currents, power and temperatures.

   Through the PMBus interface, the ADP1050 targets isolated power supplies
   and has four individual monitors for input/output voltage, input current
   and temperature.
   Datasheet:
     https://www.analog.com/en/products/adp1050.html

   Through the PMBus interface, the ADP1051 targets isolated power supplies
   and has six individual monitors for input/output voltage, input/output
   current and temperature.
   Datasheet:
     https://www.analog.com/en/products/adp1051.html

   Through the PMBus interface, the ADP1055 targets isolated power supplies
   and has six individual monitors for input/output voltage, input/output
   current, power, and temperature.
   Datasheet:
     https://www.analog.com/en/products/adp1055.html

properties:

  compatible:
    items:
      - enum:
          - adi,adp1050
          - adi,adp1051
          - adi,adp1055

  reg:
    maxItems: 1

  vcc-supply: true

required:
  - compatible
  - reg
  - vcc-supply

additionalProperties: false

examples:
  - |
    i2c {
        #address-cells = <1>;
        #size-cells = <0>;
        clock-frequency = <100000>;
        status = "okay";

        hwmon@70 {
            compatible = "adi,adp1050", "adi,adp1051";
            reg = <0x70>;
            vcc-supply = <&vcc>;
            status = "okay";
        };

        hwmon@4b {
            compatible = "adi,adp1055";
            reg = <0x4b>;
            vcc-supply = <&vcc>;
            status = "okay";
        };
    };
...
```

## Documentation/devicetree/bindings/hwmon/pmbus/adi,ltp8800.yaml
```yaml
# SPDX-License-Identifier: (GPL-2.0-only OR BSD-2-Clause)
%YAML 1.2
---
$id: http://devicetree.org/schemas/hwmon/pmbus/adi,ltp8800.yaml#
$schema: http://devicetree.org/meta-schemas/core.yaml#

title: Analog Devices LTP8800 DC/DC uModule regulator with PMBus interface

maintainers:
  - Cedric Encarnacion <cedricjustine.encarnacion@analog.com>

description: |
  The LTP8800 is a family of step-down μModule regulators that provides
  microprocessor core voltage from 54V power distribution architecture. LTP8800
  features telemetry monitoring of input/output voltage, input current, output
  power, and temperature over PMBus.

properties:
  compatible:
    enum:
      - adi,ltp8800-1a
      - adi,ltp8800-4a
      - adi,ltp8800-2

  reg:
    maxItems: 1

required:
  - compatible
  - reg

additionalProperties: false

examples:
  - |
    i2c {
        #address-cells = <1>;
        #size-cells = <0>;

        hwmon@41 {
            compatible = "adi,ltp8800-2";
            reg = <0x41>;
        };
    };
```

## Documentation/devicetree/bindings/hwmon/pmbus/adi,max17616.yaml
```yaml
# SPDX-License-Identifier: (GPL-2.0-only OR BSD-2-Clause)
%YAML 1.2
---
$id: http://devicetree.org/schemas/hwmon/pmbus/adi,max17616.yaml#
$schema: http://devicetree.org/meta-schemas/core.yaml#

title: Analog Devices MAX17616/MAX17616A

maintainers:
  - Kim Seer Paller <kimseer.paller@analog.com>

description: |
  The MAX17616/MAX17616A is a 3V to 80V, 7A current-limiter with overvoltage,
  surge, undervoltage, reverse polarity, and loss of ground protection. It
  features a PMBus interface for configuration and monitoring.
  Datasheet:
    https://www.analog.com/media/en/technical-documentation/data-sheets/max17616-max17616a.pdf

properties:
  compatible:
    enum:
      - adi,max17616
      - adi,max17616a

  reg:
    maxItems: 1

  vcc-supply: true

required:
  - compatible
  - reg
  - vcc-supply

additionalProperties: false

examples:
  - |
    i2c {
        #address-cells = <1>;
        #size-cells = <0>;

        hwmon@16 {
            compatible = "adi,max17616";
            reg = <0x16>;
            vcc-supply = <&vcc>;
        };
    };
...
```

## Documentation/devicetree/bindings/i2c/adi,ad242x-i2c.yaml
```yaml
# SPDX-License-Identifier: (GPL-2.0 OR BSD-2-Clause)
%YAML 1.2
---
$id: "http://devicetree.org/schemas/i2c/adi,ad242x-i2c.yaml#"
$schema: "http://devicetree.org/meta-schemas/core.yaml#"

title: Analog Devices AD242x I2C controller

maintainers:
  - Daniel Mack <daniel@zonque.org>

allOf:
  - $ref: /schemas/i2c/i2c-controller.yaml#

description: |
  This module is part of the AD242x MFD device. For more details and an example
  refer to Documentation/devicetree/bindings/mfd/ad242x.yaml.

properties:
  compatible:
    enum:
      - adi,ad2428w-i2c

  clock-frequency:
    $ref: '/schemas/types.yaml#/definitions/uint32'
    default: 100000
    enum: [100000, 400000]
    description: Specifies the I²C clock frequency in Hz.

required:
  - compatible
```

## Documentation/devicetree/bindings/i2c/adi,adp5588-gpio.yaml
```yaml
# SPDX-License-Identifier: (GPL-2.0-only OR BSD-2-Clause)
%YAML 1.2
---
$id: http://devicetree.org/schemas/i2c/adi,adp5588-gpio.yaml#
$schema: http://devicetree.org/meta-schemas/core.yaml#

title: Analog Devices ADP5588 GPIO Expander

maintainers:
  - Michael Hennerich <michael.hennerich@analog.com>
  - Nathan Barrett-Morrison <nathan.morrison@timesys.com>
  - Greg Malysa <greg.malysa@timesys.com>

description: |
  Basic I2C-based GPIO expander

properties:
  compatible:
    enum:
      - adi,adp5588-gpio

  reg:
    maxItems: 1

  gpio-controller: true

  "#gpio-cells":
    const: 2

required:
  - compatible
  - reg
  - gpio-controller
  - "#gpio-cells"

additionalProperties: false

examples:
  - |
    &i2c2 {
      gpio_expander: adp5588@30 {
        compatible = "adi,adp5588-gpio";
        gpio-controller;
        #gpio-cells = <2>;
        reg = <0x30>;
        status = "okay";
      };
    };
```

## Documentation/devicetree/bindings/i2c/adi,sc5xx-i2c.yaml
```yaml
# SPDX-License-Identifier: (GPL-2.0-only OR BSD-2-Clause)
%YAML 1.2
---
$id: http://devicetree.org/schemas/i2c/adi,sc5xx-i2c.yaml#
$schema: http://devicetree.org/meta-schemas/core.yaml#

title: Analog Devices I2C Peripheral for SC5XX Processor Family

maintainers:
  - Arturs Artamonovs <arturs.artamonovs@analog.com>
  - Utsav Agarwal <Utsav.Agarwal@analog.com>

description: Analog Devices I2C Peripheral driver for SC5XX Processor Family

properties:
  compatible:
    enum:
      - adi,sc5xx-i2c

  "#address-cells":
    const: 1

  "#size-cells":
    const: 0

  reg:
    maxItems: 1

  interrupts:
    maxItems: 1

  clock-khz:
    $ref: /schemas/types.yaml#/definitions/uint32

  clocks:
    maxItems: 1

  clock-names:
    maxItems: 1

required:
  - compatible
  - "#address-cells"
  - "#size-cells"
  - reg
  - interrupts
  - clock-khz
  - clocks
  - clock-names

additionalProperties: false

examples:
  - |
    #include <dt-bindings/interrupt-controller/arm-gic.h>
    #include <dt-bindings/interrupt-controller/irq.h>
    #include <dt-bindings/clock/adi-sc5xx-clock.h>

    i2c@31001400 {
      #address-cells = <1>;
      #size-cells = <0>;
      compatible = "adi,sc5xx-i2c";
      reg = <0x31001400 0xff>;
      interrupts = <GIC_SPI 150 IRQ_TYPE_LEVEL_HIGH>;
      clock-khz = <100>;
      clocks = <&clk ADSP_CLK_CGU0_SCLK0>;
      clock-names = "sclk0";
    };
```

## Documentation/devicetree/bindings/i2c/adi,twi.yaml
```yaml
# SPDX-License-Identifier: (GPL-2.0-only OR BSD-2-Clause)
%YAML 1.2
---
$id: http://devicetree.org/schemas/i2c/adi,twi.yaml#
$schema: http://devicetree.org/meta-schemas/core.yaml#

title: Analog Devices Inter IC (I2C) controller

maintainers:
  - Slawomir Kulig <slawomir.kulig@analog.com>

properties:
  compatible:
    enum:
      - adi,twi

  "#address-cells":
    const: 1

  "#size-cells":
    const: 0

  reg:
    maxItems: 1

  interrupts:
    maxItems: 1

  clocks:
    maxItems: 1

  clock-khz:
    description: Desired I2C bus clock frequency in kHz. If not specified,
                 frequency defined by CONFIG_I2C_ADI_TWI_CLK_KHZ will be
                 used (default 50 kHz).
                 If timing parameters match, the bus clock frequency can
                 be from 21 to 400 kHz.
    default: 50
    minimum: 21
    maximum: 400

required:
  - compatible
  - "#address-cells"
  - "#size-cells"
  - reg
  - interrupts
  - clock-khz
  - clocks

additionalProperties: false

examples:
  - |
    i2c0: twi@I2C_0_BASE_UADDR {
        #address-cells = <1>;
        #size-cells = <0>;
        compatible = "adi,twi";
        reg = <I2C_0_BASE 0xFF>;
        interrupts = <GIC_SPI I2C_IRQ_S2F_0 IRQ_TYPE_LEVEL_HIGH>;
        clock-khz = <100>;
        clocks = <&sysclk>;
        status = "disabled";
    };
```

## Documentation/devicetree/bindings/i2c/i2c-imx-flexio.yaml
```yaml
# SPDX-License-Identifier: (GPL-2.0-only OR BSD-2-Clause)
%YAML 1.2
---
$id: http://devicetree.org/schemas/i2c/i2c-imx-flexio.yaml#
$schema: http://devicetree.org/meta-schemas/core.yaml#

title: NXP iMX Flexible Input/Output (FlexIO) I2C Mode

allOf:
  - $ref: /schemas/i2c/i2c-controller.yaml#

properties:
  compatible:
    items:
      - const: nxp,imx-flexio-i2c-master

  clock-frequency:
    minimun: 1
    default: 100000
    maximum: 400000

  sda:
    maxItems: 1

  scl:
    maxItems: 1

required:
  - compatible
  - clock-frequency
  - sda
  - scl
  - '#address-cells'
  - '#size-cells'

additionalProperties: false

examples:
  - |
    #include <dt-bindings/interrupt-controller/arm-gic.h>

    i2c-master {
      #address-cells = <1>;
      #size-cells = <0>;
      compatible = "nxp,imx-flexio-i2c-master";
      clock-frequency = <100000>;
      sda = /bits/ 8 <0xa>;
      scl = /bits/ 8 <0xb>;
    };
```

## Documentation/devicetree/bindings/i2c/i2c-rpmsg-imx.txt
```
* Freescale Virtual I2C RPMSG bus driver for i.MX

Required properties:
- compatible :
  - "fsl,i2c-rpbus" for I2C bus over RPMSG compatible on i.MX8QXP/QM soc
The i2c-rpbus node should define its bus id (which is the node communicating
with M4) in alias.

Examples:

aliases {
	...
	i2c1 = &i2c_rpbus_1;
	...
};

&i2c_rpbus_1 {
	compatible = "fsl,i2c-rpbus";
	#address-cells = <1>;
	#size-cells = <0>;
	status = "okay";

	devs_in_this_i2c_bus__for_example: pca6416@20 {
		compatible = "ti,tca6416";
		reg = <0x20>;
		gpio-controller;
		#gpio-cells = <2>;
	};
};
```

## Documentation/devicetree/bindings/i2c/i2c-xen.txt
```
* XEN frontend i2c controller

Required properties:
- compatible :
  - "xen,i2c" for xen i2c frontend
- be-adapter : the backend i2c adapter name

Examples:

xen_i2c0: xen_i2c@0 {
	compatible = "xen,i2c";
	be-adapter = "5a800000.i2c";
	status = "okay";
};
```

## Documentation/devicetree/bindings/i3c/adi,i3c-master.yaml
```yaml
# SPDX-License-Identifier: GPL-2.0-only OR BSD-2-Clause
%YAML 1.2
---
$id: http://devicetree.org/schemas/i3c/adi,i3c-master.yaml#
$schema: http://devicetree.org/meta-schemas/core.yaml#

title: Analog Devices I3C Controller

description: |
  The ADI I3C controller implements a subset of the I3C-basic specification to
  interface I3C and I2C peripherals [1].

  [1] https://analogdevicesinc.github.io/hdl/library/i3c_controller

maintainers:
  - Jorge Marques <jorge.marques@analog.com>

properties:
  compatible:
    const: adi,i3c-master

  reg:
    maxItems: 1

  clocks:
    minItems: 1
    items:
      - description: The AXI interconnect clock.
      - description: The I3C controller clock.

  clock-names:
    items:
      - const: axi
      - const: i3c

  interrupts:
    maxItems: 1

required:
  - compatible
  - reg
  - clocks
  - clock-names
  - interrupts

allOf:
  - $ref: i3c.yaml#

unevaluatedProperties: false

examples:
  - |
    i3c@44a00000 {
        compatible = "adi,i3c-master";
        reg = <0x44a00000 0x1000>;
        interrupts = <0 56 4>;
        clocks = <&clkc 15>, <&clkc 15>;
        clock-names = "axi", "i3c";
        #address-cells = <3>;
        #size-cells = <0>;

        /* I3C and I2C devices */
    };
```
