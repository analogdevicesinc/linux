## Documentation/devicetree/bindings/iio/adc/adi,ad4052.yaml
```yaml
# SPDX-License-Identifier: (GPL-2.0-only OR BSD-2-Clause)
# Copyright 2025 Analog Devices Inc.
%YAML 1.2
---
$id: http://devicetree.org/schemas/iio/adc/adi,ad4052.yaml#
$schema: http://devicetree.org/meta-schemas/core.yaml#

title: Analog Devices AD4052 ADC family device driver

maintainers:
  - Jorge Marques <jorge.marques@analog.com>

description: |
  Analog Devices AD4052 Single Channel Precision SAR ADC family

  https://www.analog.com/media/en/technical-documentation/data-sheets/ad4050-ad4056.pdf
  https://www.analog.com/media/en/technical-documentation/data-sheets/ad4052-ad4058.pdf

properties:
  compatible:
    enum:
      - adi,ad4050
      - adi,ad4052
      - adi,ad4056
      - adi,ad4058

  reg:
    maxItems: 1

  interrupts:
    items:
      - description: Signal coming from the GP0 pin.
      - description: Signal coming from the GP1 pin.

  interrupt-names:
    items:
      - const: gp0
      - const: gp1

  cnv-gpios:
    description: The Convert Input (CNV). If omitted, CNV is tied to SPI CS.
    maxItems: 1

  pwms:
    maxItems: 1
    description: PWM connected to the CNV pin.

  trigger-sources:
    minItems: 1
    maxItems: 2
    description:
      Describes the output pin and event associated.

  "#trigger-source-cells":
    const: 2
    description: |
      Output pins used as trigger source.

      Cell 0 defines the event:
      * 0 = Data ready
      * 1 = Min threshold
      * 2 = Max threshold
      * 3 = Either threshold
      * 4 = CHOP control
      * 5 = Device enable
      * 6 = Device ready (only GP1)

      Cell 1 defines which pin:
      * 0 = GP0
      * 1 = GP1

      For convenience, macros for these values are available in
      dt-bindings/iio/adc/adi,ad4052.h.

  spi-max-frequency:
    maximum: 83333333

  vdd-supply:
    description: Analog power supply.

  vio-supply:
    description: Digital interface logic power supply.

  ref-supply:
    description: |
      Reference voltage to set the ADC full-scale range. If not present,
      vdd-supply is used as the reference voltage.

required:
  - compatible
  - reg
  - vdd-supply
  - vio-supply

allOf:
  - $ref: /schemas/spi/spi-peripheral-props.yaml#

unevaluatedProperties: false

examples:
  - |
    #include <dt-bindings/gpio/gpio.h>
    #include <dt-bindings/interrupt-controller/irq.h>
    #include <dt-bindings/iio/adc/adi,ad4052.h>

    spi {
        #address-cells = <1>;
        #size-cells = <0>;

        adc@0 {
            compatible = "adi,ad4052";
            reg = <0>;
            vdd-supply = <&vdd>;
            vio-supply = <&vio>;
            ref-supply = <&ref>;
            spi-max-frequency = <83333333>;

            #trigger-source-cells = <2>;
            trigger-sources = <&adc AD4052_TRIGGER_EVENT_EITHER_THRESH
                                    AD4052_TRIGGER_PIN_GP0
                               &adc AD4052_TRIGGER_EVENT_DATA_READY
                                    AD4052_TRIGGER_PIN_GP1>;
            interrupt-parent = <&gpio>;
            interrupts = <0 0 IRQ_TYPE_EDGE_RISING>,
                         <0 1 IRQ_TYPE_EDGE_FALLING>;
            interrupt-names = "gp0", "gp1";
            cnv-gpios = <&gpio 2 GPIO_ACTIVE_HIGH>;
        };
    };
  - |
    #include <dt-bindings/gpio/gpio.h>
    #include <dt-bindings/interrupt-controller/irq.h>
    #include <dt-bindings/iio/adc/adi,ad4052.h>

    rx_dma {
            #dma-cells = <1>;
    };

    spi {
        #address-cells = <1>;
        #size-cells = <0>;

        dmas = <&rx_dma 0>;
        dma-names = "offload0-rx";
        trigger-sources = <&adc AD4052_TRIGGER_EVENT_DATA_READY
                                AD4052_TRIGGER_PIN_GP1>;

        adc@0 {
            compatible = "adi,ad4052";
            reg = <0>;
            vdd-supply = <&vdd>;
            vio-supply = <&vio>;
            spi-max-frequency = <83333333>;
            pwms = <&adc_trigger 0 10000 0>;

            #trigger-source-cells = <2>;
            trigger-sources = <&adc AD4052_TRIGGER_EVENT_EITHER_THRESH
                                    AD4052_TRIGGER_PIN_GP0
                               &adc AD4052_TRIGGER_EVENT_DATA_READY
                                    AD4052_TRIGGER_PIN_GP1>;
            interrupt-parent = <&gpio>;
            interrupts = <0 0 IRQ_TYPE_EDGE_RISING>,
                         <0 1 IRQ_TYPE_EDGE_FALLING>;
            interrupt-names = "gp0", "gp1";
            cnv-gpios = <&gpio 2 GPIO_ACTIVE_HIGH>;
        };
    };
```

## Documentation/devicetree/bindings/iio/adc/adi,ad4062.yaml
```yaml
# SPDX-License-Identifier: (GPL-2.0-only OR BSD-2-Clause)
# Copyright 2024 Analog Devices Inc.
%YAML 1.2
---
$id: http://devicetree.org/schemas/iio/adc/adi,ad4062.yaml#
$schema: http://devicetree.org/meta-schemas/core.yaml#

title: Analog Devices AD4062 ADC family device driver

maintainers:
  - Jorge Marques <jorge.marques@analog.com>

description: |
  Analog Devices AD4062 Single Channel Precision SAR ADC family

  https://www.analog.com/media/en/technical-documentation/data-sheets/ad4060.pdf
  https://www.analog.com/media/en/technical-documentation/data-sheets/ad4062.pdf

properties:
  compatible:
    enum:
      - adi,ad4060
      - adi,ad4062

  reg:
    maxItems: 1

  interrupts:
    description:
      The interrupt pins are digital outputs that can be configured at runtime
      as multiple interrupt signals. Each can be configured as GP_INTR, RDY,
      DEV_EN, logic low, logic high and DEV_RDY (GP1 only). RDY is the
      active-low data ready signal, indicates when new ADC data are ready to
      read. DEV_EN synchronizes the enable and power-down states of signal
      chain devices with the ADC sampling instant. DEV_RDY is an active-high
      signal that indicates when the device is ready to accept serial interface
      communications. In GP_INTR mode, the interrupt outputs one of the
      threshold detection interrupt signals (MIN_INTR, MAX_INTR or either).
    minItems: 1
    items:
      - description:
          gp0, interrupt line for GP0 pin, cannot be configured as DEV_RDY.
      - description:
          gp1, interrupt line for GP1 pin, can be configured to any setting.

  interrupt-names:
    items:
      - const: gp0
      - const: gp1

  gpio-controller:
    description:
      Marks the device node as a GPIO controller. GPs not listed in
      interrupt-names are exposed as a GPO.

  '#gpio-cells':
    const: 2
    description:
      The first cell is the GPIO number and the second cell specifies
      GPIO flags, as defined in <dt-bindings/gpio/gpio.h>.

  vdd-supply:
    description: Analog power supply.

  vio-supply:
    description: Digital interface logic power supply.

  ref-supply:
    description:
      Reference voltage to set the ADC full-scale range. If not present,
      vdd-supply is used as the reference voltage.

required:
  - compatible
  - reg
  - vdd-supply
  - vio-supply

allOf:
  - $ref: /schemas/i3c/i3c.yaml#

unevaluatedProperties: false

examples:
  - |
    #include <dt-bindings/gpio/gpio.h>
    #include <dt-bindings/interrupt-controller/irq.h>

    i3c {
        #address-cells = <3>;
        #size-cells = <0>;

        adc@0,2ee007c0000 {
            reg = <0x0 0x2ee 0x7c0000>;
            vdd-supply = <&vdd>;
            vio-supply = <&vio>;
            ref-supply = <&ref>;

            interrupt-parent = <&gpio>;
            interrupts = <0 0 IRQ_TYPE_EDGE_RISING>,
                         <0 1 IRQ_TYPE_EDGE_FALLING>;
            interrupt-names = "gp0", "gp1";
        };
    };

  - |
    #include <dt-bindings/gpio/gpio.h>
    #include <dt-bindings/interrupt-controller/irq.h>

    i3c {
        #address-cells = <3>;
        #size-cells = <0>;

        adc@0,2ee007c0000 {
            reg = <0x0 0x2ee 0x7c0000>;
            vdd-supply = <&vdd>;
            vio-supply = <&vio>;
            ref-supply = <&ref>;

            gpio-controller;
            #gpio-cells = <2>;
        };
    };
```

## Documentation/devicetree/bindings/iio/adc/adi,ad4080.yaml
```yaml
# SPDX-License-Identifier: (GPL-2.0-only OR BSD-2-Clause)
%YAML 1.2
---
$id: http://devicetree.org/schemas/iio/adc/adi,ad4080.yaml#
$schema: http://devicetree.org/meta-schemas/core.yaml#

title: Analog Devices AD4080 20-Bit, 40 MSPS, Differential SAR ADC

maintainers:
  - Antoniu Miclaus <antoniu.miclaus@analog.com>

description: |
  The AD4080 is a high speed, low noise, low distortion, 20-bit, Easy Drive,
  successive approximation register (SAR) analog-to-digital converter (ADC).
  Maintaining high performance (SINAD > 90 dBFS) at signal frequencies up to
  5MHz, enables the AD4080 to service a wide variety of precision, wide
  bandwidth data acquisition applications. For applications that do not require
  the low result latency of the AD4080, simplification of the input anti-alias
  filter design can be accomplished with use of oversampling techniques using
  the integrated digital filtering to reduce both the input referred noise and
  output data rate

properties:
  compatible:
    enum:
      - adi,ad4080

  reg:
    maxItems: 1

  clocks:
    maxItems: 1

  clock-names:
    items:
      - const: adc-clk

required:
  - compatible
  - reg
  - clocks
  - clock-names

additionalProperties: false

examples:
  - |
    spi {
        #address-cells = <1>;
        #size-cells = <0>;

        adc@0 {
          compatible = "adi,ad4080";
          reg = <0>;
          clocks = <&adc_clk>;
          clock-names = "adc-clk";
        };
    };
...
```
