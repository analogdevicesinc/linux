## Documentation/devicetree/bindings/hwmon/adi,ltc4284.yaml
```yaml
# SPDX-License-Identifier: (GPL-2.0-only OR BSD-2-Clause)
%YAML 1.2
---
$id: http://devicetree.org/schemas/hwmon/adi,ltc4284.yaml#
$schema: http://devicetree.org/meta-schemas/core.yaml#

title: Analog Devices LTC4284 High Power Negative Voltage Hot Swap Controller

maintainers:
  - Carlos Jones Jr <carlosjr.jones@analog.com>

description: |
  The LTC4284 is a high power negative voltage hot swap controller with an
  integrated energy monitor. It provides voltage, current, power, and energy
  monitoring with multiple auxiliary ADC channels.

  Datasheet:
    https://www.analog.com/media/en/technical-documentation/data-sheets/ltc4284.pdf

properties:
  compatible:
    const: adi,ltc4284

  reg:
    maxItems: 1

  vin-supply:
    description:
      Power supply for the VIN pin (positive supply input).
      VIN is internally regulated to 11.5V and must be bypassed with at least
      0.1µF capacitor. For EEPROM fault logging during brown-out, use 68µF.

  interrupts:
    maxItems: 1
    description:
      Interrupt line connected to ALERT pin for fault notifications.

  adi,rsense1-nano-ohms:
    description:
      Value of the primary current sense resistor in nano-ohms. This resistor
      is used for the main SENSE and SENSE1 current measurements.

  adi,rsense2-nano-ohms:
    description:
      Value of the secondary current sense resistor in nano-ohms. This resistor
      is used for the SENSE2 current measurement. Optional.

  adi,current-limit-sense-microvolt:
    description:
      Current limit voltage threshold across the sense resistor in microvolts.
      Valid range is 15000-30000 µV (15mV to 30mV) in 1mV steps. Values rounded
      down to the nearest 1mV. This sets the overcurrent protection threshold.
      If not specified, the value programmed in EEPROM will be used.
    minimum: 15000
    maximum: 30000

  adi,vpwr-millivolt:
    description:
      The actual system voltage being monitored, accounting for any external
      resistor divider on the VPWR pin. The chip can measure up to 2.048V
      directly, so higher voltages require a divider. Specify the actual
      system voltage here (e.g., 48000 for a 48V system with divider).
    default: 2048

  adi,adin1-millivolt:
    description:
      Full-scale voltage for ADIN1 channel in millivolts, accounting for
      any external divider.
    default: 2048

  adi,adin2-millivolt:
    description:
      Full-scale voltage for ADIN2 channel in millivolts, accounting for
      any external divider.
    default: 2048

  adi,adin3-millivolt:
    description:
      Full-scale voltage for ADIN3 channel in millivolts, accounting for
      any external divider.
    default: 2048

  adi,adin4-millivolt:
    description:
      Full-scale voltage for ADIN4 channel in millivolts, accounting for
      any external divider.
    default: 2048

  adi,adio1-millivolt:
    description:
      Full-scale voltage for ADIO1 channel in millivolts, accounting for
      any external divider.
    default: 2048

  adi,adio2-millivolt:
    description:
      Full-scale voltage for ADIO2 channel in millivolts, accounting for
      any external divider.
    default: 2048

  adi,adio3-millivolt:
    description:
      Full-scale voltage for ADIO3 channel in millivolts, accounting for
      any external divider.
    default: 2048

  adi,adio4-millivolt:
    description:
      Full-scale voltage for ADIO4 channel in millivolts, accounting for
      any external divider.
    default: 2048

required:
  - compatible
  - reg
  - adi,rsense1-nano-ohms

additionalProperties: false

examples:
  - |
    #include <dt-bindings/interrupt-controller/irq.h>
    i2c {
        #address-cells = <1>;
        #size-cells = <0>;

        hotswap@15 {
            compatible = "adi,ltc4284";
            reg = <0x15>;
            vin-supply = <&reg_12v>;
            interrupts = <42 IRQ_TYPE_LEVEL_LOW>;
            adi,rsense1-nano-ohms = <5000000>;  /* 5 mOhm */
            adi,rsense2-nano-ohms = <330000>;   /* 0.33 mOhm */
            adi,current-limit-sense-microvolt = <25000>;  /* 25mV */
            adi,vpwr-millivolt = <48000>;  /* 48V system with divider */
        };
    };
...
```

## Documentation/devicetree/bindings/hwmon/adi,max31732.yaml
```yaml
# SPDX-License-Identifier: (GPL-2.0-only OR BSD-2-Clause)
%YAML 1.2
---
$id: http://devicetree.org/schemas/hwmon/adi,max31732.yaml#
$schema: http://devicetree.org/meta-schemas/core.yaml#

title: Analog Devices MAX31732 Temperature Sensor

maintainers:
  - Sinan Divarci <Sinan.Divarci@analog.com>

description: |
  The Analog Devices MAX31732 is a local plus four-channel remote temperature
  sensor that exposes two ALARM outputs, programmable limits and calibration
  aids. The driver reports readings through the Linux hwmon subsystem and can
  optionally use the ALARM pins as interrupts.

properties:
  compatible:
    const: adi,max31732

  reg:
    description: I2C address of the device.
    maxItems: 1

  interrupts:
    description: Optional ALARM1/ALARM2 interrupt lines.
    minItems: 1
    maxItems: 2

  interrupt-names:
    description: Names matching the provided interrupts.
    minItems: 1
    maxItems: 2
    items:
      - const: ALARM1
      - const: ALARM2

  adi,alarm1-interrupt-mode:
    type: boolean
    description: Use the ALARM1 output in interrupt (latching) mode.

  adi,alarm2-interrupt-mode:
    type: boolean
    description: Use the ALARM2 output in interrupt (latching) mode.

  adi,alarm1-fault-queue:
    description: Number of consecutive faults required to assert ALARM1.
    enum: [1, 2, 4, 6]
    default: 1

  adi,alarm2-fault-queue:
    description: Number of consecutive faults required to assert ALARM2.
    enum: [1, 2, 4, 6]
    default: 1

  adi,extended-range:
    type: boolean
    description: |
      Enable the device extended range (+64°C offset) at probe time. When set,
      the temperature reading range shifts from [-128°C, +127.9375°C] to
      [-64°C, +191.9375°C] for primary limits and [-64°C, +191°C] for
      secondary limits.

  adi,ignore-isc2gnd:
    type: boolean
    description: |
      Mask short-circuit-to-ground faults for remote channels. When set,
      the device ignores shorts between DXN and ground.

  adi,custom-ideality-factor-r1:
    $ref: /schemas/types.yaml#/definitions/uint32
    minimum: 1
    maximum: 255
    description: |
      Custom ideality factor for remote channel 1. Allows calibration for
      non-standard diode characteristics. When specified, overrides the
      default ideality factor for this channel.

  adi,custom-ideality-factor-r2:
    $ref: /schemas/types.yaml#/definitions/uint32
    minimum: 1
    maximum: 255
    description: Custom ideality factor for remote channel 2.

  adi,custom-ideality-factor-r3:
    $ref: /schemas/types.yaml#/definitions/uint32
    minimum: 1
    maximum: 255
    description: Custom ideality factor for remote channel 3.

  adi,custom-ideality-factor-r4:
    $ref: /schemas/types.yaml#/definitions/uint32
    minimum: 1
    maximum: 255
    description: Custom ideality factor for remote channel 4.

  adi,filter-channels:
    $ref: /schemas/types.yaml#/definitions/uint32
    minimum: 0
    maximum: 0x1e
    description: |
      Bitmask to enable digital filtering on remote channels (bits 1-4).
      The filter averages the previous four temperature conversions.
      Bit 0 (local channel) is ignored. Bit 1 = remote1, bit 2 = remote2,
      bit 3 = remote3, bit 4 = remote4.

  adi,beta-compensation-channels:
    $ref: /schemas/types.yaml#/definitions/uint32
    minimum: 0
    maximum: 0x1e
    description: |
      Bitmask to enable beta compensation on remote channels (bits 1-4).
      Bit encoding same as adi,filter-channels.

  adi,highest-temp-channels:
    $ref: /schemas/types.yaml#/definitions/uint32
    minimum: 0
    maximum: 0x1f
    description: |
      Bitmask to enable highest temperature tracking per channel (bits 0-4).
      Bit 0 = local, bits 1-4 = remote channels 1-4. The hardware records
      the highest temperature seen on enabled channels.

  adi,reference-temp-local:
    $ref: /schemas/types.yaml#/definitions/int32
    description: |
      Reference junction temperature for the local channel in milli-degrees
      Celsius. Used for calibration purposes.

  adi,reference-temp-remote1:
    $ref: /schemas/types.yaml#/definitions/int32
    description: Reference junction temperature for remote channel 1 (in m°C).

  adi,reference-temp-remote2:
    $ref: /schemas/types.yaml#/definitions/int32
    description: Reference junction temperature for remote channel 2 (in m°C).

  adi,reference-temp-remote3:
    $ref: /schemas/types.yaml#/definitions/int32
    description: Reference junction temperature for remote channel 3 (in m°C).

  adi,reference-temp-remote4:
    $ref: /schemas/types.yaml#/definitions/int32
    description: Reference junction temperature for remote channel 4 (in m°C).

  adi,alarm1-mask:
    $ref: /schemas/types.yaml#/definitions/uint32
    minimum: 0
    maximum: 0x1f
    description: |
      Bitmask to disable ALARM1 assertions for specific channels at probe time.
      Bit 0 = local channel, bits 1-4 = remote channels 1-4.
      Set bit to 1 to mask (disable) the alarm for that channel.

  adi,alarm2-mask:
    $ref: /schemas/types.yaml#/definitions/uint32
    minimum: 0
    maximum: 0x1f
    description: |
      Bitmask to disable ALARM2 assertions for specific channels at probe time.
      Same bit encoding as adi,alarm1-mask.

required:
  - compatible
  - reg

additionalProperties: false

examples:
  - |
    #include <dt-bindings/interrupt-controller/irq.h>
    #include <dt-bindings/gpio/gpio.h>

    i2c {
        #address-cells = <1>;
        #size-cells = <0>;

        sensor@1c {
            compatible = "adi,max31732";
            reg = <0x1c>;
            interrupt-parent = <&gpio>;
            interrupts = <17 IRQ_TYPE_EDGE_FALLING>, <27 IRQ_TYPE_EDGE_FALLING>;
            interrupt-names = "ALARM1", "ALARM2";
            adi,alarm1-interrupt-mode;
            adi,alarm1-fault-queue = <4>;
            adi,alarm2-fault-queue = <2>;
            adi,extended-range;
            adi,ignore-isc2gnd;
            adi,custom-ideality-factor-r1 = <100>;
            adi,filter-channels = <0x1e>;  /* Enable for all remote channels */
            adi,beta-compensation-channels = <0x06>;  /* Enable for remote 1 and 2 */
            adi,highest-temp-channels = <0x1f>;  /* Track all channels */
            adi,reference-temp-local = <25000>;  /* 25°C in m°C */
            adi,reference-temp-remote1 = <25000>;
            adi,alarm1-mask = <0x08>;
            adi,alarm2-mask = <0x10>;
        };
    };
```

## Documentation/devicetree/bindings/hwmon/adi,max31875.yaml
```yaml
# SPDX-License-Identifier: (GPL-2.0-only OR BSD-2-Clause)
# Copyright 2024 Analog Devices Inc.
%YAML 1.2
---
$id: http://devicetree.org/schemas/hwmon/adi,max31875.yaml#
$schema: http://devicetree.org/meta-schemas/core.yaml#

title: Analog Devices MAX31875 Low-Power I2C Temperature Sensor

maintainers:
  - John Erasmus Mari Geronimo <johnerasmusmari.geronimo@analog.com>

description: |
  The MAX31875 is a ±1°C-accurate local temperature sensor with I2C/SMBus
  interface. The combination of tiny package and excellent temperature
  measurement accuracy makes this product ideal for a variety of equipment.
  https://www.analog.com/media/en/technical-documentation/data-sheets/MAX31875.pdf

properties:
  compatible:
    enum:
      - adi,max31875

  reg:
    maxItems: 1

  vdd-supply:
    description:
      Must have values in the interval (1.6V; 3.6V) in order for the device to
      function correctly. Must also have regulator-name of "vref".

  adi,extended-format:
    description:
      If present, the temperature register is read in extended format. If not
      present, the temperature register is read in normal format (default).
    type: boolean

  adi,comp-int:
    description:
      If present, the Overtemperature Status bit operates in interrupt mode. If
      not present, it operates in comparator mode (default).
    type: boolean

  adi,timeout-disable:
    description:
      Disables timeout. Bus timeout resets the I2C-compatible interface when SCL
      is low for more than 30ms (nominal).
    type: boolean

  adi,fault-q:
    description:
      Select how many consecutive overtemperature faults must occur before an
      overtemperature fault is indicated in the Overtemperature Status bit.
    $ref: /schemas/types.yaml#/definitions/uint32
    enum: [1, 2, 4, 6]

required:
  - compatible
  - reg
  - vdd-supply

additionalProperties: false

examples:
  - |
    i2c {
        #address-cells = <1>;
        #size-cells = <0>;
        status = "okay";

        temperature-sensor@48 {
            compatible = "adi,max31875";
            reg = <0x48>;
            vdd-supply = <&vdd>;

            adi,extended-format;
            adi,comp-int;
            adi,timeout-disable;
            adi,fault-q = <1>;
        };
    };
...
```

## Documentation/devicetree/bindings/hwmon/adi,max42500.yaml
```yaml
# SPDX-License-Identifier: (GPL-2.0-only OR BSD-2-Clause)
%YAML 1.2
---
$id: http://devicetree.org/schemas/hwmon/adi,max42500.yaml#
$schema: http://devicetree.org/meta-schemas/core.yaml#

title: Analog Devices MAX42500 Industrial Power System Monitor

maintainers:
  - Kent Libetario <Kent.Libetario@analog.com>

description: |
  Analog Devices MAX42500 Industrial Power System Monitor Family
  https://www.analog.com/media/en/technical-documentation/data-sheets/max42500.pdf

properties:
  compatible:
    enum:
      - adi,max42500
  reg:
    maxItems: 1

  gpios:
    maximum: 2

required:
  - compatible
  - reg
  - gpios

additionalProperties: false

examples:
  - |
    #include <dt-bindings/gpio/gpio.h>
    i2c {
      #address-cells = <1>;
      #size-cells = <0>;

      hwmon@28 {
        compatible = "adi,max42500";
        reg = <0x28>;
        gpios = <&gpio 0 0>, <&gpio 1 0>;
      };
    };
```

## Documentation/devicetree/bindings/hwmon/common.yaml
```yaml
# SPDX-License-Identifier: (GPL-2.0 OR BSD-2-Clause)
%YAML 1.2
---
$id: http://devicetree.org/schemas/hwmon/common.yaml#
$schema: http://devicetree.org/meta-schemas/core.yaml#

title: Common properties for hwmon sensors

maintainers:
  - Jean Delvare <jdelvare@suse.com>
  - Guenter Roeck <linux@roeck-us.net>

description: |
  This document defines device tree properties common to several hwmon
  sensors. It doesn't constitue a device tree binding specification by itself but
  is meant to be referenced by device tree bindings.

  When referenced from sensor tree bindings the properties defined in this
  document are defined as follows. The sensor tree bindings are responsible for
  defining whether each property is required or optional.

properties:
  label:
    $ref: /schemas/types.yaml#/definitions/string
    description: >
      Descriptive label that allows to uniquely identify a device within
      the system.

additionalProperties: true

...
```
