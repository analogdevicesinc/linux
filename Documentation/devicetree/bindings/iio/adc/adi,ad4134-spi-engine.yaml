## Documentation/devicetree/bindings/iio/adc/adi,ad9081.yaml
```yaml
# SPDX-License-Identifier: (GPL-2.0-only OR BSD-2-Clause)
%YAML 1.2
---
$id: http://devicetree.org/schemas/iio/adc/adi,ad9081.yaml#
$schema: http://devicetree.org/meta-schemas/core.yaml#

title: Analog Devices AD9081 Mixed-Signal Front End (MxFE)

maintainers:
  - Michael Hennerich <michael.hennerich@analog.com>

description: |
  The AD9081 is a high-performance, single-chip, mixed-signal front end (MxFE)
  integrating four 16-bit, 12 GSPS maximum sample rate, RF digital-to-analog
  converter (DAC) cores, and four 12-bit, 4 GSPS rate, RF analog-to-digital
  converter (ADC) cores.

properties:
  compatible:
    enum:
      - adi,ad9081
      - adi,ad9082
      - adi,ad9988
      - adi,ad9986
      - adi,ad9177
      - adi,ad9207
      - adi,ad9209

  reg:
    maxItems: 1

  spi-max-frequency:
    maximum: 25000000

  clocks:
    items:
      - description: Device clock

  clock-names:
    items:
      - const: dev_clk

  reset-gpios:
    maxItems: 1

  interrupts:
    maxItems: 1

  adi,standalone-enable:
    type: boolean
    description: Enable standalone mode for the device.

  adi,multidevice-instance-count:
    $ref: /schemas/types.yaml#/definitions/uint32
    description: Number of devices in a multidevice synchronization setup.

  adi,dual-link-use-separate-tpl-enable:
    type: boolean
    description: Enable separate TPL for dual-link mode.

  adi,jesd-sync-pins-01-swap-enable:
    type: boolean
    description: Swap JESD sync pins 0 and 1.

  adi,jesd-sync-pin-0a-cmos-enable:
    type: boolean
    description: Enable CMOS mode for JESD sync pin 0A.

  adi,lmfc-delay-dac-clk-cycles:
    $ref: /schemas/types.yaml#/definitions/uint32
    description: LMFC delay in DAC clock cycles.

  adi,nco-sync-ms-extra-lmfc-num:
    $ref: /schemas/types.yaml#/definitions/uint32
    description: Extra LMFC cycles for NCO synchronization in master-slave mode.

  adi,nco-sync-direct-sysref-mode-enable:
    type: boolean
    description: Enable direct SYSREF mode for NCO synchronization.

  adi,sysref-average-cnt-exp:
    $ref: /schemas/types.yaml#/definitions/uint32
    minimum: 0
    maximum: 15
    description: SYSREF averaging count exponent (2^n).

  adi,sysref-ac-coupling-enable:
    type: boolean
    description: Enable AC coupling for SYSREF.

  adi,sysref-cmos-input-enable:
    type: boolean
    description: Enable CMOS input mode for SYSREF.

  adi,sysref-single-end-pos-termination:
    $ref: /schemas/types.yaml#/definitions/uint32
    minimum: 0
    maximum: 3
    description: Termination resistance for positive single-ended SYSREF input.

  adi,sysref-single-end-neg-termination:
    $ref: /schemas/types.yaml#/definitions/uint32
    minimum: 0
    maximum: 3
    description: Termination resistance for negative single-ended SYSREF input.

  adi,continuous-sysref-mode-disable:
    type: boolean
    description: Disable continuous SYSREF mode.

  adi,direct-loopback-mode-dac-adc-mapping:
    $ref: /schemas/types.yaml#/definitions/uint32
    minimum: 0
    maximum: 255
    description: Mapping for direct loopback mode between DAC and ADC.

  adi,master-slave-sync-gpio-num:
    $ref: /schemas/types.yaml#/definitions/uint32
    minimum: 0
    maximum: 15
    description: GPIO number for master-slave synchronization.

  adi,tx-dacs:
    type: object
    description: TX DAC configuration node.

    properties:
      '#address-cells':
        const: 1

      '#size-cells':
        const: 0

      adi,dac-frequency-hz:
        description: |
          DAC operating frequency in Hz.
          type: uint64 to support frequencies > 4GHz.
          Requires /bits/ 64 <value>

      adi,ffh-hopf-via-gpio-enable:
        type: boolean
        description: Enable FFH HOPF via GPIO.

      adi,pa-protection-gpio-as-pa-enable:
        type: boolean
        description: |
          Configure GPIO pins 0-3 as PA enable outputs (pa0_en - pa3_en).
          This is a global setting affecting all DACs.

      adi,pa-protection-rotation-mode:
        $ref: /schemas/types.yaml#/definitions/uint32
        minimum: 0
        maximum: 3
        description: |
          Rotation mode configuration. This is a global setting.
          Bit 0: Enable JESD auto off/on during rotation
          Bit 1: Enable datapath auto soft off/on during rotation
          Use bitmask values from dt-bindings/iio/adc/adi,ad9081.h

      adi,main-data-paths:
        type: object
        description: Configuration for main data paths.

        properties:
          '#address-cells':
            const: 1

          '#size-cells':
            const: 0

          adi,interpolation:
            $ref: /schemas/types.yaml#/definitions/uint32
            enum: [1, 2, 3, 4, 6, 8, 12]
            description: Interpolation factor for main data paths.

        patternProperties:
          "^dac@[0-3]$":
            type: object
            description: Per-DAC configuration. DAC index 0-3.

            properties:
              reg:
                minimum: 0
                maximum: 3
                description: DAC channel index (0-3).

              adi,nco-frequency-shift-hz:
                description: |
                  NCO frequency shift in Hz for this DAC.
                  type: uint64 to support frequencies > 4GHz.
                  Requires /bits/ 64 <value>

              adi,full-scale-current-ua:
                $ref: /schemas/types.yaml#/definitions/uint32
                minimum: 7750
                maximum: 40320
                description: Full-scale current in microamperes.

              adi,maindp-dac-1x-non1x-crossbar-select:
                $ref: /schemas/types.yaml#/definitions/uint32
                minimum: 0
                maximum: 3
                description: Crossbar selection for 1x/non-1x mode.

              adi,crossbar-select:
                $ref: /schemas/types.yaml#/definitions/phandle
                description: |
                  Phandle reference to channelizer path(s) to be used for this DAC.
                  References nodes defined under adi,channelizer-paths.

              # PA Protection per-DAC properties
              adi,pa-protection-soft-off-enable:
                type: boolean
                description: Enable soft-off gain control for this DAC.

              adi,pa-protection-soft-off-new-gain-enable:
                type: boolean
                description: Enable new soft-off gain block for this DAC.

              adi,pa-protection-soft-off-ramp-rate:
                $ref: /schemas/types.yaml#/definitions/uint32
                minimum: 0
                maximum: 15
                description: |
                  Soft-off gain ramp rate. The gain will ramp from 0-1 (or 1-0)
                  in 32 steps over 2^(code+8) DAC clock periods.

              adi,pa-protection-soft-off-triggers:
                $ref: /schemas/types.yaml#/definitions/uint32
                description: |
                  Bitmask of soft-off triggers. Use values from
                  dt-bindings/iio/adc/adi,ad9081.h (AD9081_PA_SOFT_OFF_*).
                  Multiple triggers can be OR'd together.

              adi,pa-protection-soft-on-triggers:
                $ref: /schemas/types.yaml#/definitions/uint32
                description: |
                  Bitmask of soft-on triggers. Use values from
                  dt-bindings/iio/adc/adi,ad9081.h (AD9081_PA_SOFT_ON_*).

              adi,pa-protection-long-avg-enable:
                type: boolean
                description: |
                  Enable long averaging power calculation and error detection.

              adi,pa-protection-long-avg-time:
                $ref: /schemas/types.yaml#/definitions/uint32
                minimum: 0
                maximum: 255
                description: |
                  Time for long averaging. Required if long-avg-enable is true.

              adi,pa-protection-long-avg-threshold:
                $ref: /schemas/types.yaml#/definitions/uint32
                minimum: 0
                maximum: 65535
                description: |
                  Long average power threshold (I² + Q²).
                  Required if long-avg-enable is true.

              adi,pa-protection-short-avg-enable:
                type: boolean
                description: |
                  Enable short averaging power calculation and error detection.

              adi,pa-protection-short-avg-time:
                $ref: /schemas/types.yaml#/definitions/uint32
                minimum: 0
                maximum: 255
                description: |
                  Time for short averaging. Required if short-avg-enable is
                  true.

              adi,pa-protection-short-avg-threshold:
                $ref: /schemas/types.yaml#/definitions/uint32
                minimum: 0
                maximum: 65535
                description: |
                  Short average power threshold (I² + Q²).
                  Required if short-avg-enable is true.

              adi,pa-protection-dsa-enable:
                type: boolean
                description: Enable Digital Step Attenuator (DSA) for this DAC.

              adi,pa-protection-dsa-code:
                $ref: /schemas/types.yaml#/definitions/uint32
                minimum: 0
                maximum: 235
                description: |
                  DSA attenuation code. 0 = no attenuation,
                  235 = 47dB attenuation. Required if dsa-enable is true.

              adi,pa-protection-dsa-cutover:
                $ref: /schemas/types.yaml#/definitions/uint32
                minimum: 0
                maximum: 255
                description: |
                  DSA cutover threshold for switching from analog to
                  digital gain. Required if dsa-enable is true.

              adi,pa-protection-dsa-boost:
                $ref: /schemas/types.yaml#/definitions/uint32
                minimum: 0
                maximum: 15
                description: |
                  DSA boost setting to elevate full-scale current above
                  26mA baseline. Required if dsa-enable is true.

              adi,pa-protection-dsa-gain:
                $ref: /schemas/types.yaml#/definitions/uint32
                minimum: 0
                maximum: 4095
                description: |
                  12-bit DSA digital gain value.
                  Required if dsa-enable is true.

            required:
              - reg

            additionalProperties: false

        required:
          - adi,interpolation

        additionalProperties: false

      adi,channelizer-paths:
        type: object
        description: Configuration for channelizer paths.

        properties:
          '#address-cells':
            const: 1

          '#size-cells':
            const: 0

          adi,interpolation:
            $ref: /schemas/types.yaml#/definitions/uint32
            enum: [1, 2, 3, 4, 6, 8]
            description: Interpolation factor for channelizer paths.

        patternProperties:
          "^channel@[0-7]$":
            type: object
            description: Per-channelizer configuration.

            properties:
              reg:
                minimum: 0
                maximum: 7
                description: Channelizer index (0-7).

              adi,nco-frequency-shift-hz:
                description: |
                  NCO frequency shift in Hz.
                  type: uint64 to support frequencies > 4GHz.
                  Requires /bits/ 64 <value>

              adi,nco-phase-offset:
                $ref: /schemas/types.yaml#/definitions/uint32
                minimum: 0
                maximum: 65535
                description: NCO phase offset.

              adi,gain:
                $ref: /schemas/types.yaml#/definitions/uint32
                minimum: 0
                maximum: 4095
                description: Channel gain (12-bit).

            required:
              - reg

            additionalProperties: false

        required:
          - adi,interpolation

        additionalProperties: false

      adi,jesd-links:
        type: object
        description: JESD204 link configuration for TX.
        properties:
          '#address-cells':
            const: 1

          '#size-cells':
            const: 0
        patternProperties:
          "^link@[0-1]$":
            type: object
            description: Per-link JESD204 configuration. Link index 0-1.

            properties:
              reg:
                minimum: 0
                maximum: 1
                description: JESD204 link index (0-1).

              adi,logical-lane-mapping:
                $ref: /schemas/types.yaml#/definitions/uint8-array
                minItems: 1
                maxItems: 8
                description: Logical lane mapping for JESD lanes.

              adi,link-mode:
                $ref: /schemas/types.yaml#/definitions/uint32
                description: JESD quick configuration mode.

              adi,subclass:
                $ref: /schemas/types.yaml#/definitions/uint32
                enum: [0, 1, 2]
                description: JESD subclass (0, 1, or 2).

              adi,version:
                $ref: /schemas/types.yaml#/definitions/uint32
                enum: [0, 1, 2]
                description: JESD version (0=204A, 1=204B, 2=204C).

              adi,dual-link:
                $ref: /schemas/types.yaml#/definitions/uint32
                enum: [0, 1]
                description: JESD dual link mode (0=disabled, 1=enabled).

              adi,converters-per-device:
                $ref: /schemas/types.yaml#/definitions/uint32
                minimum: 1
                maximum: 16
                description: JESD M parameter.

              adi,octets-per-frame:
                $ref: /schemas/types.yaml#/definitions/uint32
                minimum: 1
                maximum: 256
                description: JESD F parameter.

              adi,frames-per-multiframe:
                $ref: /schemas/types.yaml#/definitions/uint32
                minimum: 1
                maximum: 32
                description: JESD K parameter.

              adi,converter-resolution:
                $ref: /schemas/types.yaml#/definitions/uint32
                minimum: 1
                maximum: 32
                description: JESD N parameter.

              adi,bits-per-sample:
                $ref: /schemas/types.yaml#/definitions/uint32
                minimum: 1
                maximum: 32
                description: JESD NP' parameter.

              adi,control-bits-per-sample:
                $ref: /schemas/types.yaml#/definitions/uint32
                minimum: 0
                maximum: 3
                description: JESD CS parameter.

              adi,lanes-per-device:
                $ref: /schemas/types.yaml#/definitions/uint32
                minimum: 1
                maximum: 8
                description: JESD L parameter.

              adi,samples-per-converter-per-frame:
                $ref: /schemas/types.yaml#/definitions/uint32
                minimum: 1
                maximum: 32
                description: JESD S parameter.

              adi,high-density:
                $ref: /schemas/types.yaml#/definitions/uint32
                enum: [0, 1]
                description: JESD HD parameter (0=disabled, 1=enabled).

              adi,tpl-phase-adjust:
                $ref: /schemas/types.yaml#/definitions/uint32
                description: TPL phase adjustment value.

              jesd204-device-id:
                $ref: /schemas/types.yaml#/definitions/uint32
                minimum: 0
                maximum: 255
                description: JESD204 device ID.

              jesd204-lanes-per-device:
                $ref: /schemas/types.yaml#/definitions/uint32
                minimum: 1
                maximum: 8
                description: Number of lanes per device.

              jesd204-converters-per-device:
                $ref: /schemas/types.yaml#/definitions/uint32
                minimum: 1
                maximum: 16
                description: Number of converters per device.

              jesd204-octets-per-frame:
                $ref: /schemas/types.yaml#/definitions/uint32
                minimum: 1
                maximum: 256
                description: Number of octets per frame.

              jesd204-frames-per-multiframe:
                $ref: /schemas/types.yaml#/definitions/uint32
                minimum: 1
                maximum: 32
                description: Number of frames per multiframe.

              jesd204-converter-resolution:
                $ref: /schemas/types.yaml#/definitions/uint32
                minimum: 1
                maximum: 32
                description: Converter resolution in bits.

              jesd204-bits-per-sample:
                $ref: /schemas/types.yaml#/definitions/uint32
                minimum: 1
                maximum: 32
                description: Number of bits per sample.

              jesd204-control-bits-per-sample:
                $ref: /schemas/types.yaml#/definitions/uint32
                minimum: 0
                maximum: 3
                description: Number of control bits per sample.

              jesd204-samples-per-converter-per-frame:
                $ref: /schemas/types.yaml#/definitions/uint32
                minimum: 1
                maximum: 32
                description: Number of samples per converter per frame.

              jesd204-high-density:
                $ref: /schemas/types.yaml#/definitions/uint32
                enum: [0, 1]
                description: High density mode (0=disabled, 1=enabled).

              jesd204-version:
                $ref: /schemas/types.yaml#/definitions/uint32
                enum: [0, 1, 2]
                description: JESD204 version (0=A, 1=B, 2=C).

              jesd204-subclass:
                $ref: /schemas/types.yaml#/definitions/uint32
                enum: [0, 1, 2]
                description: JESD204 subclass (0, 1, or 2).

            required:
              - reg

            additionalProperties: false

        additionalProperties: false

    required:
      - adi,dac-frequency-hz
      - adi,main-data-paths

    additionalProperties: false

  adi,rx-adcs:
    type: object
    description: RX ADC configuration node.

    properties:
      '#address-cells':
        const: 1

      '#size-cells':
        const: 0

      adi,adc-frequency-hz:
        description: |
          ADC operating frequency in Hz.
          type: uint64 to support frequencies > 4GHz.
          Requires /bits/ 64 <value>

      adi,nyquist-zone:
        $ref: /schemas/types.yaml#/definitions/uint32
        enum: [0, 1]
        description: Global Nyquist zone for all ADCs (0=odd, 1=even).
        default: 0

      adi,main-data-paths:
        type: object
        description: Configuration for main data paths.
        properties:
          '#address-cells':
            const: 1

          '#size-cells':
            const: 0

        patternProperties:
          "^adc@[0-3]$":
            type: object
            description: Per-ADC configuration. ADC index 0-3.

            properties:
              reg:
                minimum: 0
                maximum: 3
                description: ADC channel index (0-3).

              adi,decimation:
                $ref: /schemas/types.yaml#/definitions/uint32
                enum: [1, 2, 3, 4, 6, 8, 12]
                description: Decimation factor for this ADC.

              adi,nco-frequency-shift-hz:
                description: |
                  NCO frequency shift in Hz (can be negative).
                  type: uint64 to support frequencies > 4GHz.
                  Requires /bits/ 64 <value>

              adi,nco-mixer-mode:
                $ref: /schemas/types.yaml#/definitions/uint32
                enum: [0, 1, 2, 3]
                description: |
                  NCO mixer mode:
                  0 = Variable IF Mode (AD9081_ADC_NCO_VIF)
                  1 = Zero IF Mode (AD9081_ADC_NCO_ZIF)
                  2 = Fs/4 Hz IF Mode (AD9081_ADC_NCO_FS_4_IF)
                  3 = Test Mode (AD9081_ADC_NCO_TEST)

              adi,nyquist-zone:
                $ref: /schemas/types.yaml#/definitions/uint32
                enum: [0, 1]
                description: |
                  Nyquist zone for this ADC (0=odd, 1=even).
                  Overrides the global adi,nyquist-zone value for this ADC.

              adi,crossbar-select:
                $ref: /schemas/types.yaml#/definitions/phandle-array
                description: |
                  Phandle references to channelizer paths used for this ADC.

            required:
              - reg
              - adi,decimation

            additionalProperties: false

        additionalProperties: false

      adi,channelizer-paths:
        type: object
        description: Configuration for channelizer paths.
        properties:
          '#address-cells':
            const: 1

          '#size-cells':
            const: 0

        patternProperties:
          "^channel@[0-7]$":
            type: object
            description: Per-channelizer configuration. Channel index 0-7.

            properties:
              reg:
                minimum: 0
                maximum: 7
                description: Channelizer index (0-7).

              adi,decimation:
                $ref: /schemas/types.yaml#/definitions/uint32
                enum: [1, 2, 3, 4, 6, 8]
                description: Decimation factor for this channelizer.

              adi,gain:
                $ref: /schemas/types.yaml#/definitions/uint32
                minimum: 0
                maximum: 4095
                description: Channel gain (12-bit).

              adi,nco-frequency-shift-hz:
                description: |
                  NCO frequency shift in Hz (can be negative).
                  type: uint64 to support frequencies > 4GHz.
                  Requires /bits/ 64 <value>

              adi,nco-phase-offset:
                $ref: /schemas/types.yaml#/definitions/uint32
                minimum: 0
                maximum: 65535
                description: NCO phase offset.

              adi,6db-gain-enable:
                $ref: /schemas/types.yaml#/definitions/uint32
                enum: [0, 1]
                description: Enable 6dB gain for this channelizer.

              adi,complex-to-real-enable:
                $ref: /schemas/types.yaml#/definitions/uint32
                enum: [0, 1]
                description: Enable complex-to-real conversion for this channelizer.

            required:
              - reg
              - adi,decimation

            additionalProperties: false

        additionalProperties: false

      adi,jesd-links:
        type: object
        description: JESD204 link configuration for RX.
        properties:
          '#address-cells':
            const: 1

          '#size-cells':
            const: 0

        patternProperties:
          "^link@[0-1]$":
            type: object
            description: Per-link JESD204 configuration. Link index 0-1.

            properties:
              reg:
                minimum: 0
                maximum: 1
                description: JESD204 link index (0-1).

              adi,converter-select:
                $ref: /schemas/types.yaml#/definitions/phandle-array
                description: |
                  Phandle references to converters with FDDC_I/FDDC_Q selection.
                  Format: <&channelizer_phandle FDDC_I_or_Q>
                  Example: <&ad9081_rx_fddc_chan0 FDDC_I>, <&ad9081_rx_fddc_chan0 FDDC_Q>

              adi,logical-lane-mapping:
                $ref: /schemas/types.yaml#/definitions/uint8-array
                minItems: 1
                maxItems: 8
                description: Logical lane mapping for JESD lanes.

              adi,link-mode:
                $ref: /schemas/types.yaml#/definitions/uint32
                description: JESD quick configuration mode.

              adi,subclass:
                $ref: /schemas/types.yaml#/definitions/uint32
                enum: [0, 1, 2]
                description: JESD subclass (0, 1, or 2).

              adi,version:
                $ref: /schemas/types.yaml#/definitions/uint32
                enum: [0, 1, 2]
                description: JESD version (0=204A, 1=204B, 2=204C).

              adi,dual-link:
                $ref: /schemas/types.yaml#/definitions/uint32
                enum: [0, 1]
                description: JESD dual link mode (0=disabled, 1=enabled).

              adi,converters-per-device:
                $ref: /schemas/types.yaml#/definitions/uint32
                minimum: 1
                maximum: 16
                description: JESD M parameter.

              adi,octets-per-frame:
                $ref: /schemas/types.yaml#/definitions/uint32
                minimum: 1
                maximum: 256
                description: JESD F parameter.

              adi,frames-per-multiframe:
                $ref: /schemas/types.yaml#/definitions/uint32
                minimum: 1
                maximum: 32
                description: JESD K parameter.

              adi,converter-resolution:
                $ref: /schemas/types.yaml#/definitions/uint32
                minimum: 1
                maximum: 32
                description: JESD N parameter.

              adi,bits-per-sample:
                $ref: /schemas/types.yaml#/definitions/uint32
                minimum: 1
                maximum: 32
                description: JESD NP' parameter.

              adi,control-bits-per-sample:
                $ref: /schemas/types.yaml#/definitions/uint32
                minimum: 0
                maximum: 3
                description: JESD CS parameter.

              adi,lanes-per-device:
                $ref: /schemas/types.yaml#/definitions/uint32
                minimum: 1
                maximum: 8
                description: JESD L parameter.

              adi,samples-per-converter-per-frame:
                $ref: /schemas/types.yaml#/definitions/uint32
                minimum: 1
                maximum: 32
                description: JESD S parameter.

              adi,high-density:
                $ref: /schemas/types.yaml#/definitions/uint32
                enum: [0, 1]
                description: JESD HD parameter (0=disabled, 1=enabled).

              jesd204-device-id:
                $ref: /schemas/types.yaml#/definitions/uint32
                minimum: 0
                maximum: 255
                description: JESD204 device ID.

              jesd204-lanes-per-device:
                $ref: /schemas/types.yaml#/definitions/uint32
                minimum: 1
                maximum: 8
                description: Number of lanes per device.

              jesd204-converters-per-device:
                $ref: /schemas/types.yaml#/definitions/uint32
                minimum: 1
                maximum: 16
                description: Number of converters per device.

              jesd204-octets-per-frame:
                $ref: /schemas/types.yaml#/definitions/uint32
                minimum: 1
                maximum: 256
                description: Number of octets per frame.

              jesd204-frames-per-multiframe:
                $ref: /schemas/types.yaml#/definitions/uint32
                minimum: 1
                maximum: 32
                description: Number of frames per multiframe.

              jesd204-converter-resolution:
                $ref: /schemas/types.yaml#/definitions/uint32
                minimum: 1
                maximum: 32
                description: Converter resolution in bits.

              jesd204-bits-per-sample:
                $ref: /schemas/types.yaml#/definitions/uint32
                minimum: 1
                maximum: 32
                description: Number of bits per sample.

              jesd204-control-bits-per-sample:
                $ref: /schemas/types.yaml#/definitions/uint32
                minimum: 0
                maximum: 3
                description: Number of control bits per sample.

              jesd204-samples-per-converter-per-frame:
                $ref: /schemas/types.yaml#/definitions/uint32
                minimum: 1
                maximum: 32
                description: Number of samples per converter per frame.

              jesd204-high-density:
                $ref: /schemas/types.yaml#/definitions/uint32
                enum: [0, 1]
                description: High density mode (0=disabled, 1=enabled).

              jesd204-version:
                $ref: /schemas/types.yaml#/definitions/uint32
                enum: [0, 1, 2]
                description: JESD204 version (0=A, 1=B, 2=C).

              jesd204-subclass:
                $ref: /schemas/types.yaml#/definitions/uint32
                enum: [0, 1, 2]
                description: JESD204 subclass (0, 1, or 2).

            required:
              - reg

            additionalProperties: false

        additionalProperties: false

    required:
      - adi,adc-frequency-hz
      - adi,main-data-paths

    additionalProperties: false

required:
  - compatible
  - reg
  - clocks
  - clock-names

additionalProperties: false

examples:
  - |
    #include <dt-bindings/iio/adc/adi,ad9081.h>
    #include <dt-bindings/gpio/gpio.h>

    spi {
        #address-cells = <1>;
        #size-cells = <0>;

        ad9081@0 {
            compatible = "adi,ad9081";
            reg = <0>;
            spi-max-frequency = <25000000>;

            clocks = <&adf4371_clk>;
            clock-names = "dev_clk";

            reset-gpios = <&gpio 55 GPIO_ACTIVE_HIGH>;

            adi,tx-dacs {
                #address-cells = <1>;
                #size-cells = <0>;
                adi,dac-frequency-hz = /bits/ 64 <12000000000>;
                adi,pa-protection-gpio-as-pa-enable;
                adi,pa-protection-rotation-mode =
                    <(AD9081_PA_ROTATION_JESD_AUTO |
                      AD9081_PA_ROTATION_DATAPATH_AUTO)>;

                adi,main-data-paths {
                    #address-cells = <1>;
                    #size-cells = <0>;
                    adi,interpolation = <2>;

                    dac@0 {
                        reg = <0>;
                        adi,nco-frequency-shift-hz = /bits/ 64 <1000000000>;
                        adi,full-scale-current-ua = <20000>;
                        adi,crossbar-select = <&tx_chan0>;

                        adi,pa-protection-soft-off-enable;
                        adi,pa-protection-soft-off-ramp-rate = <3>;
                        adi,pa-protection-soft-off-triggers =
                            <(AD9081_PA_SOFT_OFF_SPI |
                              AD9081_PA_SOFT_OFF_TXEN |
                              AD9081_PA_SOFT_OFF_JESD_ERR)>;
                        adi,pa-protection-long-avg-enable;
                        adi,pa-protection-long-avg-time = <10>;
                        adi,pa-protection-long-avg-threshold = <1000>;
                    };
                };

                adi,channelizer-paths {
                    #address-cells = <1>;
                    #size-cells = <0>;
                    adi,interpolation = <1>;

                    tx_chan0: channel@0 {
                        reg = <0>;
                        adi,gain = <2048>;
                        adi,nco-frequency-shift-hz = /bits/ 64 <0>;
                    };
                };

                adi,jesd-links {
                    #address-cells = <1>;
                    #size-cells = <0>;
                    link@0 {
                        reg = <0>;
                        jesd204-device-id = <0>;
                        jesd204-lanes-per-device = <4>;
                        jesd204-converters-per-device = <4>;
                        jesd204-octets-per-frame = <1>;
                        jesd204-frames-per-multiframe = <32>;
                        jesd204-converter-resolution = <16>;
                        jesd204-bits-per-sample = <16>;
                        jesd204-control-bits-per-sample = <0>;
                        jesd204-samples-per-converter-per-frame = <1>;
                        jesd204-high-density = <0>;
                        jesd204-version = <1>;
                        jesd204-subclass = <1>;
                    };
                };
            };

            adi,rx-adcs {
                #address-cells = <1>;
                #size-cells = <0>;
                adi,adc-frequency-hz = /bits/ 64 <4000000000>;

                adi,main-data-paths {
                    #address-cells = <1>;
                    #size-cells = <0>;
                    adc@0 {
                        reg = <0>;
                        adi,decimation = <2>;
                        adi,nco-frequency-shift-hz = /bits/ 64 <400000000>;
                        adi,nco-mixer-mode = <AD9081_ADC_NCO_VIF>;
                    };
                    adc@1 {
                        reg = <1>;
                        adi,decimation = <2>;
                        adi,nco-frequency-shift-hz = /bits/ 64 <(-400000000)>;
                        adi,nco-mixer-mode = <AD9081_ADC_NCO_VIF>;
                        /* Override global nyquist zone for this ADC */
                        adi,nyquist-zone = <1>;
                    };
                    adc@2 {
                        reg = <2>;
                        adi,decimation = <2>;
                        adi,nco-frequency-shift-hz = /bits/ 64 <100000000>;
                        adi,nco-mixer-mode = <AD9081_ADC_NCO_VIF>;
                    };
                    adc@3 {
                        reg = <3>;
                        adi,decimation = <2>;
                        adi,nco-frequency-shift-hz = /bits/ 64 <100000000>;
                        adi,nco-mixer-mode = <AD9081_ADC_NCO_VIF>;
                    };
                };

                adi,channelizer-paths {
                    #address-cells = <1>;
                    #size-cells = <0>;
                    channel@0 {
                        reg = <0>;
                        adi,decimation = <2>;
                        adi,gain = <2048>;
                        adi,nco-frequency-shift-hz = /bits/ 64 <0>;
                    };
                    channel@1 {
                        reg = <1>;
                        adi,decimation = <2>;
                        adi,gain = <2048>;
                        adi,nco-frequency-shift-hz = /bits/ 64 <0>;
                    };
                };

                adi,jesd-links {
                    #address-cells = <1>;
                    #size-cells = <0>;
                    link@0 {
                        reg = <0>;
                        jesd204-device-id = <0>;
                        jesd204-lanes-per-device = <8>;
                        jesd204-converters-per-device = <4>;
                        jesd204-octets-per-frame = <1>;
                        jesd204-frames-per-multiframe = <32>;
                        jesd204-converter-resolution = <12>;
                        jesd204-bits-per-sample = <16>;
                        jesd204-control-bits-per-sample = <0>;
                        jesd204-samples-per-converter-per-frame = <1>;
                        jesd204-high-density = <0>;
                        jesd204-version = <1>;
                        jesd204-subclass = <1>;
                    };
                };
            };
        };
    };
...
```
