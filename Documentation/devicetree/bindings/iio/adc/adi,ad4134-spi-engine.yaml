## Documentation/devicetree/bindings/iio/adc/adi,ad7091r8.yaml
```yaml
# SPDX-License-Identifier: GPL-2.0-only OR BSD-2-Clause
%YAML 1.2
---
$id: http://devicetree.org/schemas/iio/adc/adi,ad7091r8.yaml#
$schema: http://devicetree.org/meta-schemas/core.yaml#

title: Analog Devices AD7091R8 8-Channel 12-Bit ADC

maintainers:
  - Marcelo Schmitt <marcelo.schmitt@analog.com>

description: |
  Analog Devices AD7091R-8 8-Channel 12-Bit ADC
  https://www.analog.com/media/en/technical-documentation/data-sheets/AD7091R-2_7091R-4_7091R-8.pdf

properties:
  compatible:
    enum:
      - adi,ad7091r2
      - adi,ad7091r4
      - adi,ad7091r8

  reg:
    maxItems: 1

  vref-supply: true

  spi-max-frequency: true

  adi,conversion-start-gpios:
    description:
      Device tree identifier of the CONVST pin.
      This logic input is used to initiate conversions on the analog
      input channels.
    maxItems: 1

  reset-gpios:
    maxItems: 1

  interrupts:
    maxItems: 1

required:
  - compatible
  - reg
  - adi,conversion-start-gpios

patternProperties:
  "^channel@[0-7]$":
    $ref: "adc.yaml"
    type: object
    description: Represents the external channels which are connected to the ADC.

    properties:
      reg:
        minimum: 0
        maximum: 7

    required:
      - reg

allOf:
  - $ref: /schemas/spi/spi-peripheral-props.yaml#

  # AD7091R-2 does not have ALERT/BUSY/GPO pin
  - if:
      properties:
        compatible:
          contains:
            enum:
              - adi,ad7091r4
              - adi,ad7091r8
    then:
      properties:
        interrupts: true
    else:
      properties:
        interrupts: false

unevaluatedProperties: false

examples:
  - |
    #include <dt-bindings/interrupt-controller/irq.h>
    #include <dt-bindings/gpio/gpio.h>
    spi {
        #address-cells = <1>;
        #size-cells = <0>;

        adc@0 {
                compatible = "adi,ad7091r8";
                reg = <0x0>;
                spi-max-frequency = <45454545>;
                vref-supply = <&adc_vref>;
                adi,conversion-start-gpios = <&gpio 25 GPIO_ACTIVE_LOW>;
                reset-gpios = <&gpio 27 GPIO_ACTIVE_LOW>;
                interrupts = <22 IRQ_TYPE_EDGE_FALLING>;
                interrupt-parent = <&gpio>;
        };
    };
...
```

## Documentation/devicetree/bindings/iio/adc/adi,ad7124.txt
```
Analog Devices AD7124 ADC device driver

Required properties for the AD7124:
	- compatible: Must be one of "adi,ad7124-4" or "adi,ad7124-8"
	- reg: SPI chip select number for the device
	- spi-max-frequency: Max SPI frequency to use
		see: Documentation/devicetree/bindings/spi/spi-bus.txt
	- clocks: phandle to the master clock (mclk)
		see: Documentation/devicetree/bindings/clock/clock-bindings.txt
	- clock-names: Must be "mclk".
	- interrupts: IRQ line for the ADC
		see: Documentation/devicetree/bindings/interrupt-controller/interrupts.txt

	- adi,channels: List of external channels connected to the ADC:
	  Required properties:
		* #address-cells: Must be 2.
		* #size-cells: Must be 0.

	  The child nodes of this node represent the external channels which are
	  connected to the ADC.

	  Each child node represents one channel and has the following
	  properties:
		Required properties:
			* reg: Pins the channel is connected to. The first value specifies
			  the positive input pin, the second value the negative input pin.
			* adi,channel-number: It can have up to 4 channels on ad7124-4 and
			  8 channels on ad7124-8, numbered from 0 to 15.

		Optional properties:
			* adi,bipolar: If set the channel is used in bipolar mode.
			* adi,reference-select: Select the reference source to use when
			  converting on the the specific channel. Valid values are:
			  0: REFIN1(+)/REFIN1(−).
			  1: REFIN2(+)/REFIN2(−).
			  3: AVDD
			  If this field is left empty, internal reference is selected.
			* adi,gain: Select the gain when converting on the specific channel.
			  Valid values are: 1, 2, 4, 8, 16, 32, 64, 128.
			  If this field is left empty, gain of 1 is selected.
			* adi,odr-hz: The output data rate can be programmed from:
			  9 to 19200 for full power mode (when the master clock is 614.4 kHz)
			  2 to 4800 for mid power mode (when the master clock is 153.6 kHz)
			  1 to 2400 for low power mode (when the master clock is 76.8 kHz)
			  If this field is left empty, odr of 9 is selected.

Optional properties:
	- refin1-supply: refin1 supply can be used as reference for conversion.
	- refin2-supply: refin2 supply can be used as reference for conversion.
	- avdd-supply: avdd supply can be used as reference for conversion.

Example:
	adc@0 {
		compatible = "adi,ad7124-4";
		reg = <0>;
		spi-max-frequency = <5000000>;
		interrupts = <25 2>;
		interrupt-parent = <&gpio>;
		refin1-supply = <&adc_vref>;
		clocks = <&ad7124_mclk>;
		clock-names = "mclk";

		adi,channels {
			#address-cells = <2>;
			#size-cells = <0>;

			channel@0 {
				reg = <0 1>;
				adi,channel-number = <0>;
				adi,reference-select = <0>;
				adi,gain = <2>;
				adi,odr-hz = <10>;
			};

			channel@1 {
				reg = <2 3>;
				adi,bipolar;
				adi,channel-number = <1>;
				adi,reference-select = <0>;
				adi,gain = <4>;
				adi,odr-hz = <50>;
			};

			channel@2 {
				reg = <4 5>;
				adi,channel-number = <2>;
				adi,gain = <128>;
				adi,odr-hz = <19200>;
			};

			channel@3 {
				reg = <6 7>;
				adi,channel-number = <3>;
			};
		};
	};
```

## Documentation/devicetree/bindings/iio/adc/adi,ad7124.yaml
```yaml
# SPDX-License-Identifier: GPL-2.0
# Copyright 2019 Analog Devices Inc.
%YAML 1.2
---
$id: http://devicetree.org/schemas/bindings/iio/adc/adi,ad7124.yaml#
$schema: http://devicetree.org/meta-schemas/core.yaml#

title: Analog Devices AD7124 ADC device driver

maintainers:
  - Stefan Popa <stefan.popa@analog.com>

description: |
  Bindings for the Analog Devices AD7124 ADC device. Datasheet can be
  found here:
    https://www.analog.com/media/en/technical-documentation/data-sheets/AD7124-8.pdf

properties:
  compatible:
    enum:
      - adi,ad7124-4
      - adi,ad7124-8

  reg:
    description: SPI chip select number for the device
    maxItems: 1

  clocks:
    maxItems: 1
    description: phandle to the master clock (mclk)

  clock-names:
    items:
      - const: mclk

  interrupts:
    description: IRQ line for the ADC
    maxItems: 1

  '#address-cells':
    const: 1

  '#size-cells':
    const: 0

  refin1-supply:
    description: refin1 supply can be used as reference for conversion.
    maxItems: 1

  refin2-supply:
    description: refin2 supply can be used as reference for conversion.
    maxItems: 1

  avdd-supply:
    description: avdd supply can be used as reference for conversion.
    maxItems: 1

required:
  - compatible
  - reg
  - clocks
  - clock-names
  - interrupts

patternProperties:
  "^channel@[01]$":
    type: object
    description: |
      Represents the external channels which are connected to the ADC.
      See Documentation/devicetree/bindings/iio/adc/adc.txt.

    properties:
      reg:
        description: |
          The channel number. It can have up to 8 channels on ad7124-4
          and 16 channels on ad7124-8, numbered from 0 to 15.
        maxItems: 1

      adi,reference-select:
        description: |
          Select the reference source to use when converting on
          the specific channel.
          If this field is left empty, internal reference is selected.
        maxItems: 1

      diff-channels:
        description: see Documentation/devicetree/bindings/iio/adc/adc.txt
        maxItems: 1

      bipolar:
        description: see Documentation/devicetree/bindings/iio/adc/adc.txt
        maxItems: 1

      adi,buffered-positive:
        description: Enable buffered mode for positive input.
        maxItems: 1

      adi,buffered-negative:
        description: Enable buffered mode for negative input.
        maxItems: 1

    required:
      - reg
      - diff-channels

examples:
  - |
    adc@0 {
      compatible = "adi,ad7124-4";
      reg = <0>;
      spi-max-frequency = <5000000>;
      interrupts = <25 2>;
      interrupt-parent = <&gpio>;
      refin1-supply = <&adc_vref>;
      clocks = <&ad7124_mclk>;
      clock-names = "mclk";

      #address-cells = <1>;
      #size-cells = <0>;

      channel@0 {
        reg = <0>;
        diff-channels = <0 1>;
        adi,reference-select = <0>;
        adi,buffered-positive;
      };

      channel@1 {
        reg = <1>;
        bipolar;
        diff-channels = <2 3>;
        adi,reference-select = <0>;
        adi,buffered-positive;
        adi,buffered-negative;
      };

      channel@2 {
        reg = <2>;
        diff-channels = <4 5>;
      };

      channel@3 {
        reg = <3>;
        diff-channels = <6 7>;
      };
    };
```

## Documentation/devicetree/bindings/iio/adc/adi,ad7173.txt
```
* Analog Devices AD7173 and similar Analog to Digital Converter (ADC)

Required properties:
	- compatible: Must be one of "adi,ad7172-2", "adi,ad7173-8", "adi,7175-2",
	  "adi,7176-2".
	- reg: SPI chip select number for the device
	- interrupts: IRQ line for the ADC
		see: Documentation/devicetree/bindings/interrupt-controller/interrupts.txt
	- spi-max-frequency: See Documentation/devicetree/bindings/spi/spi-bus.txt
	- spi-cpha: See Documentation/devicetree/bindings/spi/spi-bus.txt
	- spi-cpol: See Documentation/devicetree/bindings/spi/spi-bus.txt

Optional properties:
	- adi,channels: List of external channels connected to the ADC:
	  Required properties:
		* #address-cells: Must be 2.
		* #size-cells: Must be 0.

	  The child nodes of this node represent the external channels which are
	  connected to the ADC. If the property is no present no external
	  channels will be assumed to be connected.

	  Each child node represents one channel and has the following
	  properties:
		Required properties:
			* reg: Pins the channel is connected to. The first value specifies
			  the positive input pin, the second value the negative input pin.
		Optional properties:
			* adi,bipolar: If set the channel is used in bipolar mode.


Example:
	ad7173 {
		compatible = "adi,ad7173";
		reg = <0>;
		spi-cpol;
		spi-cpha;
		spi-max-frequency = <100000>;

		adi,channels {
			#address-cells = <2>;
			#size-cells = <0>;

			channel@0,1 {
				reg = <0 1>;
				adi,bipolar;
			};

			channel@2,3 {
				reg = <2 3>;
				adi,bipolar;
			};
		};
	};
```

## Documentation/devicetree/bindings/iio/adc/adi,ad7173.yaml
```yaml
# SPDX-License-Identifier: GPL-2.0
%YAML 1.2
---
$id: "http://devicetree.org/schemas/iio/adc/adi,ad7173.yaml#"
$schema: "http://devicetree.org/meta-schemas/core.yaml#"

title: Analog Devices AD7173 and similar Analog to Digital Converter (ADC)

maintainers:
  - Alexandru Ardelean <alexandru.ardelean@analog.com>

description: |
  Driver for Analog Devices AD7173 and similar Analog to Digital Converter (ADC)
    https://www.analog.com/en/products/ad7172-2.html
    https://www.analog.com/en/products/ad7173-8.html
    https://www.analog.com/en/products/ad7175-2.html
    https://www.analog.com/en/products/ad7176-2.html

properties:
  compatible:
    oneOf:
      - items:
          - enum:
              - adi,ad7172-2
              - adi,ad7173-8
              - adi,ad7175-2
              - adi,ad7176-2

  reg:
    description:
      The SPI chip select number of the device
    maxItems: 1

  spi-cpha:
    description:
      SPI clock phase must be set, to select SPI mode 3
    maxItems: 1

  spi-cpol:
    description:
      SPI clock polarity must be set, to select SPI mode 3
    maxItems: 1

  interrupts:
    description:
      Interrupt that triggers when the conversion is ready
    maxItems: 1

  adi,channels:
    description: |
      List of external channels connected to the ADC

patternProperties:
  '^channel@[0-9a-f]+,[0-9a-f]+$':
    description: |
      Definition for a channel provided via 'adi,channels'
    properties:
      '#address-cells':
        const: 2
      '#size-cells':
        const: 0
      reg:
        maxItems: 1
        description: |
          Pins the channel is connected to. The first value specifies the
          the positive input pin, the second value the negative input.
      adi,bipolar:
        maxItems: 1
        description: |
          If set the channel is used in bipolar mode.
    required:
      - '#address-cells'
      - '#size-cells'
      - reg

required:
  - compatible
  - reg
  - interrupts
  - spi-cpha
  - spi-cpol

examples:
  - |
    ad7173 {
        compatible = "adi,ad7173-8";
        reg = <0>;
        spi-cpol;
        spi-cpha;
        spi-max-frequency = <100000>;

        adi,channels {
                #address-cells = <2>;
                #size-cells = <0>;

                channel@0,1 {
                    reg = <0 1>;
                    adi,bipolar;
                };

                channel@2,3 {
                    reg = <2 3>;
                    adi,bipolar;
                };
        };
    };
```
