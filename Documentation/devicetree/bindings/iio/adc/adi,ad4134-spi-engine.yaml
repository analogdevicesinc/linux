## Documentation/devicetree/bindings/iio/adc/adi,ad4630.yaml
```yaml
# SPDX-License-Identifier: (GPL-2.0-only OR BSD-2-Clause)
# Copyright 2022 Analog Devices Inc.
%YAML 1.2
---
$id: http://devicetree.org/schemas/iio/adc/adi,ad4630.yaml#
$schema: http://devicetree.org/meta-schemas/core.yaml#

title: Analog Devices AD4630 ADC family device driver

maintainers:
  - Nuno Sa <nuno.sa@analog.com>

description: |
  Analog Devices AD4630 Dual Channel Precision SAR ADC family

  https://www.analog.com/media/en/technical-documentation/data-sheets/ad4630-24_ad4632-24.pdf
  https://www.analog.com/media/en/technical-documentation/data-sheets/ad4630-16-4632-16.pdf
  https://www.analog.com/media/en/technical-documentation/data-sheets/ad4030-24-4032-24.pdf

properties:

  compatible:
    enum:
      - adi,ad4030-24
      - adi,ad4630-16
      - adi,ad4630-24
      - adi,ad463x

  reg:
    maxItems: 1

  clocks:
    description:
      Trigger reference clock

  clock-names:
    const: trigger_clock

  dmas:
    maxItems: 1

  dma-names:
    const: rx

  pwms:
    minItems: 1
    maxItems: 2

  pwm-names:
    oneOf:
      - items:
          - const: cnv
          - const: spi_trigger
      - items:
          - const: cnv

  reset-gpios:
    maxItems: 1

  spi-max-frequency:
    maximum: 80000000

  vdd-supply: true
  vdd_1_8-supply: true
  vio-supply: true

  vref-supply:
    description:
      Optional External unbuffered reference. Used when vrefin-supply is not
      connected.

  vrefin-supply:
    description:
      Internal buffered Reference. Used when vref-supply is not connected.

  adi,lane-mode:
    description:
      Change the number of SPI data lanes.

      0 - 1 Lane per channel.
      1 - 2 Lanes per channel.
      2 - 4 Lanes per channel.
      3 - Interleaved Lanes. The Channel 0 and Channel 1 conversion data is
          interleaved on SDO0.
    $ref: /schemas/types.yaml#/definitions/uint32
    enum: [0, 1, 2, 3]
    default: 0

  adi,clock-mode:
    description:
      Change the clock distribution mode.

      0 - Spi-compatible. Normal SPI operation clocking.
      1 - Echo-clock. Synchronous clock echoing to ease timing requirements
          when using isolation on the digital interface.
      2 - Host. The Host clock mode uses an internal oscillator to clock out
          the data bits. In this mode, the spi controller is not driving SCLK.
    $ref: /schemas/types.yaml#/definitions/uint32
    enum: [0, 1, 2]
    default: 0

  adi,dual-data-rate:
    description:
      Enable dual data rate (DDR) in which two bits (per active lane) are
      transmitted in one clock cycle. This can reduce the serial clock to
      10 MHz while operating at a sample rate of 2 MSPS.
    type: boolean

  adi,out-data-mode:
    description:
      The device supports multiple sample formats.

      0 - Sample is 16 or 24 bit (depending on the device) differential voltage
      1 - Sample is composed of 16-bit differential voltage and 8-bit
          common voltage.
      2 - Sample is composed of 24-bit differential voltage and 8-bit
          common voltage,
      3 - Sample is an averaged 30-bit differential voltage.
    $ref: /schemas/types.yaml#/definitions/uint32
    enum: [0, 1, 2, 3]
    default: 0

required:
  - compatible
  - reg
  - clocks
  - clock-names
  - dmas
  - dma-names
  - pwms
  - pwm-names

allOf:
  - $ref: /schemas/spi/spi-peripheral-props.yaml#
  - if:
      properties:
        compatible:
          contains:
            const: adi,ad4630-16
    then:
      properties:
        adi,out-data-mode:
          enum: [0, 1, 3]
  - if:
      properties:
        compatible:
          contains:
            const: adi,ad4030-24
    then:
      properties:
        adi,lane-mode:
          enum: [0, 1, 2]
  - if:
      properties:
        adi,clock-mode:
          const: 0
    then:
      properties:
        adi,dual-data-rate: false


unevaluatedProperties: false

examples:
  - |
    #include <dt-bindings/gpio/gpio.h>

    spi {
        #address-cells = <1>;
        #size-cells = <0>;

        adc@0 {
            compatible = "adi,ad463x";
            reg = <0>;
            spi-max-frequency = <80000000>;

            vdd-supply = <&vdd>;
            vdd_1_8-supply = <&vdd_1_8>;
            vio-supply = <&vio>;
            vref-supply = <&vref>;

            clocks = <&clk0>;
            clock-names = "trigger_clock";
            dmas = <&dma 0>;
            dma-names = "rx";
            pwm-names = "cnv", "spi_trigger";
            pwms = <&axi_pwm_gen 1 0>, <&axi_pwm_gen 0 0>;
            reset-gpios = <&gpio 0 GPIO_ACTIVE_LOW>;

            adi,lane-mode = <1>;
            adi,clock-mode = <1>;
            adi,dual-data-rate;
            adi,out-data-mode = <3>;
        };
    };
...
```

## Documentation/devicetree/bindings/iio/adc/adi,ad4692.yaml
```yaml
# SPDX-License-Identifier: (GPL-2.0-only OR BSD-2-Clause)
%YAML 1.2
---
$id: http://devicetree.org/schemas/iio/adc/adi,ad4692.yaml#
$schema: http://devicetree.org/meta-schemas/core.yaml#

title: Analog Devices AD4692 MuxSAR Analog-to-Digital Converter

maintainers:
  - Radu Sabau  <radu.sabau@analog.com>

description: |
  The AD4692 family are compact, Easy Drive, 16-bit MUX SAR ADCs incorporating
  accumulators per-channel and a flexible channel sequencer to enable a
  diverse range of space-constrained precision measurement applications.

    https://www.analog.com/en/products/ad4692.html

properties:
  compatible:
    enum:
      - adi,ad4691
      - adi,ad4692
      - adi,ad4693
      - adi,ad4694

  reg:
    maxItems: 1

  spi-max-frequency:
    maximum: 1000000

  reset-gpios:
    maxItems: 1

  gpiomode0-gpios:
    maxItems: 1

  gpiomode1-gpios:
    maxItems: 1

  gpiomode2-gpios:
    maxItems: 1

  gpiomode3-gpios:
    maxItems: 1

  clocks:
    maxItems: 1

  clock-names:
    items:
      - const: ref_clk

  pwms:
    maxItems: 1

  pwm-names:
    items:
      - const: cnv

  interrupts:
    maxItems: 1

  interrupt-names:
    enum:
      - DRDY
      - ADCBUSY

  vref-supply: true
  vio-supply: true

  adi,spi-mode:
    description:
      Change the ADC Conversion Mode

      0 - CNV Clock Mode. Use CNV signal as the conversion oscillator, number
          of pulses matches the matches of samples retrieved by the master
          according to the sequencer configuration.
      1 - CNV Burst Mode. Use CNV signal in order to transmit one pulse to the
          ADC, then the Internal Oscillator is triggered by the rising edge of
          the pulse and Internal Oscillator acts the way CNV acts for CNV
          Clock Mode
      2 - Autonomous Mode. Set CONV_START bit in the CONV_START_REG in order
          to start a conversion where the internal osllator acts the way CNV
          acts in CNV Clock Mode. Clear CONV_START bit to stop the conversion.
      3 - SPI Burst Mode. Same as Autonomous Mode but CONV_START bit clears
          itself.
      4 - Manual Mode. Use CNV signal and between pulses a command code is
          transmitted and the result comes on the next transfer.
    $ref: /schemas/types.yaml#/definitions/uint32
    enum: [0, 1, 2, 3, 4]
    default: 0

required:
  - compatible
  - reset-gpios
  - gpiomode0-gpios
  - reg
  - clocks
  - clock-names
  - pwms
  - pwm-names
  - interrupts
  - interrupt-names
  - vref-supply
  - vio-supply
  - adi,spi-mode

additionalProperties: false

examples:
  - |
    #include <dt-bindings/interrupt-controller/irq.h>
    #include <dt-bindings/gpio/gpio.h>
    #include <dt-bindings/pwm/pwm.h>

    &spi0 {
      status = "okay";
      #address-cells = <1>;
      #size-cells = <0>;

      ad4692@0 {
        compatible = "adi,ad4692";
        reg = <0>;

        spi-max-frequency = <2000000>;
        vref-supply = <&vref>;
        vio-supply = <&vio>;

        reset-gpios = <&gpio0 87 GPIO_ACTIVE_LOW>;
        gpiomode0-gpios = <&gpio0 86 GPIO_ACTIVE_LOW>;

        clocks = <&ref_clk>;
        pwms = <&axi_pwm_gen 0 0>;
        pwm-names = "cnv";

        interrupt-parent = <&gpio0>;
        interrupts = <86 IRQ_TYPE_EDGE_FALLING>;
        interrupt-names = "ADCBUSY";

        adi,spi-mode = <4>;
      };
    };
...
```

## Documentation/devicetree/bindings/iio/adc/adi,ad4696.yaml
```yaml
# SPDX-License-Identifier: (GPL-2.0-only OR BSD-2-Clause)
# Copyright 2024 Analog Devices Inc.
%YAML 1.2
---
$id: http://devicetree.org/schemas/iio/adc/adi,ad4696.yaml#
$schema: http://devicetree.org/meta-schemas/core.yaml#

title: Analog Devices AD4696 ADC family device driver

maintainers:
  - Ramona Gradinariu <ramona.gradinariu@analog.com>

description: |
  Analog Devices AD4696 16-Bit Easy Drive Multiplexed SAR ADC

  https://www.analog.com/media/en/technical-documentation/data-sheets/ad4695_4696.pdf
  https://www.analog.com/media/en/technical-documentation/data-sheets/ad4697-4698.pdf

properties:
  compatible:
    enum:
      - adi,ad4695
      - adi,ad4696
      - adi,ad4697
      - adi,ad4698

  reg:
    maxItems: 1

  dmas:
    maxItems: 1

  dma-names:
    const: rx

  clocks:
    maxItems: 1

  clock-names:
    items:
      - const: ref_clk

  pwms:
    maxItems: 1

  pwm-names:
    items:
      - const: cnv

  spi-max-frequency:
    maximum: 80000000

  spi-cpha: true

  spi-cpol: true

  vref-supply:
    description: The regulator supply for ADC reference voltage.

  "#io-channel-cells":
    const: 1

  "#address-cells": true
  "#size-cells": true

required:
  - compatible
  - reg
  - clocks
  - dmas
  - dma-names
  - pwms
  - pwm-names
  - spi-cpol
  - spi-cpha
  - vref-supply
  - "#io-channel-cells"
  - "#address-cells"
  - "#size-cells"

patternProperties:
  "^channel@([0-9]|1[0-5])$":
    $ref: adc.yaml
    type: object
    unevaluatedProperties: false
    description: |
      Represents the external channels which are connected to the ADC.

    properties:
      reg:
        description: |
          The channel number. It can have up to 8 channels on ad4695 and ad4697
          and 16 channels on ad4696 and 4698, numbered from 0 to 15.
        items:
          minimum: 0
          maximum: 15

      adi,pair-select:
        description: |
          Select the pin-oairing option on the specific channel. Valid values
          are:
          0: Channel paired with REFGND.
          1: Channel paired with COM
          2: Even and odd channels pairing.
          If the channel is paired with REFGND, bipolar mode is not available.
          If even and odd channels pairing is selected, the channel number must
          be even.
        $ref: /schemas/types.yaml#/definitions/uint32
        enum: [0, 1, 2]

      adi,osr:
        description: |
          Select the oversampling ration select on the specific channel. Valid
          values are:
          0: OSR = 1 (no oversampling).
          1: OSR = 4. Output code result resolution increases to 17 bits.
          2: OSR = 16. Output code result resolution increases to 18 bits.
          3: OSR = 64. Output code result resolution increases to 19 bits.
          If this field is left empty, OSR = 1 is selected.
        $ref: /schemas/types.yaml#/definitions/uint32
        enum: [0, 1, 2, 3]

      bipolar:
        description: see Documentation/devicetree/bindings/iio/adc/adc.yaml
        type: boolean

    required:
      - reg
      - adi,pair-select

additionalProperties: false

allOf:
  - $ref: /schemas/spi/spi-peripheral-props.yaml#

examples:
  - |
    spi {
      #address-cells = <1>;
      #size-cells = <0>;

      adc@0 {
        compatible = "adi,ad4696";
        reg = <0>;
        spi-max-frequency = <80000000>;
        spi-cpha;
        spi-cpol;
        dmas = <&rx_dma 0>;
        dma-names = "rx";
        pwms = <&adc_trigger 0 0>;
        pwm-names = "cnv";
        clocks = <&spi_clk>;
        clock-names = "ref_clk";
        vref-supply = <&vref>;

        #address-cells = <1>;
        #size-cells = <0>;
        #io-channel-cells = <1>;

        channel@0 {
          reg = <0>;
          bipolar;
          adi,osr = <0>;
          adi,pair-select = <2>;
        };
        channel@2 {
          reg = <2>;
          adi,osr = <1>;
          adi,pair-select = <0>;
        };

        channel@3 {
          reg = <3>;
          adi,osr = <2>;
          adi,pair-select = <0>;
        };

        channel@4 {
          reg = <4>;
          adi,osr = <3>;
          adi,pair-select = <1>;
        };
      };
    };
```

## Documentation/devicetree/bindings/iio/adc/adi,ad485x.yaml
```yaml
# SPDX-License-Identifier: (GPL-2.0-only OR BSD-2-Clause)
# Copyright 2022 Analog Devices Inc.
%YAML 1.2
---
$id: http://devicetree.org/schemas/iio/adc/adi,ad485x.yaml#
$schema: http://devicetree.org/meta-schemas/core.yaml#

title: Analog Devices AD485X DAS family device driver

maintainers:
  - Sergiu Cuciurean <sergiu.cuciurean@analog.com>
  - Dragos Bogdan <dragos.bogdan@analog.com>
  - Antoniu Miclaus <antoniu.miclaus@analog.com>

description: |
  Analog Devices AD485X DAS family

  https://www.analog.com/media/en/technical-documentation/data-sheets/ad4858.pdf

properties:
  compatible:
    enum:
      - adi,ad4858
      - adi,ad4857
      - adi,ad4856
      - adi,ad4855
      - adi,ad4854
      - adi,ad4853
      - adi,ad4852
      - adi,ad4851
      - adi,ad4858i

  reg:
    maxItems: 1

  vcc-supply: true

  vdd-supply: true

  vddh-supply: true

  vio-supply: true

  pwms:
    maxItems: 1

  io-backends:
    maxItems: 1

  spi-max-frequency:
    maximum: 100000000

required:
  - compatible
  - reg
  - vcc-supply
  - vdd-supply
  - vddh-supply
  - vio-supply
  - pwms

unevaluatedProperties: false

examples:
  - |
    spi {
        #address-cells = <1>;
        #size-cells = <0>;

        adc@0{
            compatible = "adi,ad4858";
            reg = <0>;
            spi-max-frequency = <10000000>;
            vcc-supply = <&vcc>;
            vdd-supply = <&vdd>;
            vddh-supply = <&vddh>;
            vio-supply = <&vio>;
            pwms = <&pwm_gen 0 0>;
            io-backends = <&iio_backend>;
        };
    };
...
```
