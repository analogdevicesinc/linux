## Documentation/devicetree/bindings/iio/adc/adi,ad7191.yaml
```yaml
# SPDX-License-Identifier: (GPL-2.0 OR BSD-2-Clause)
# Copyright 2024 Analog Devices Inc.
%YAML 1.2
---
$id: http://devicetree.org/schemas/iio/adc/adi,ad7191.yaml#
$schema: http://devicetree.org/meta-schemas/core.yaml#

title: Analog Devices AD7191 ADC device driver

maintainers:
  - Alisa-Dariana Roman <alisa.roman@analog.com>

description: |
  Bindings for the Analog Devices AD7191 ADC device. Datasheet can be
  found here:
  https://www.analog.com/media/en/technical-documentation/data-sheets/AD7191.pdf

properties:
  compatible:
    enum:
      - adi,ad7191

  reg:
    maxItems: 1

  spi-cpol: true

  spi-cpha: true

  clocks:
    maxItems: 1
    description:
      Optionally, either a crystal can be attached externally between MCLK1 and
      MCLK2 pins, or an external CMOS-compatible clock can drive the MCLK2
      pin. If absent, internal 4.92MHz clock is used.

  interrupts:
    maxItems: 1

  avdd-supply:
    description: AVdd voltage supply

  dvdd-supply:
    description: DVdd voltage supply

  vref-supply:
    description: Vref voltage supply

  odr1-gpios:
    description: GPIO connected to ODR1 pin for output data rate selection
    maxItems: 1

  odr2-gpios:
    description: GPIO connected to ODR2 pin for output data rate selection
    maxItems: 1

  pga1-gpios:
    description: GPIO connected to PGA1 pin for gain selection
    maxItems: 1

  pga2-gpios:
    description: GPIO connected to PGA2 pin for gain selection
    maxItems: 1

  temp-gpios:
    description: GPIO connected to TEMP pin for temperature sensor enable
    maxItems: 1

  chan-gpios:
    description: GPIO connected to CHAN pin for input channel selection
    maxItems: 1

  clksel-gpios:
    description: GPIO connected to CLKSEL pin for clock source selection
    maxItems: 1

required:
  - compatible
  - reg
  - interrupts
  - avdd-supply
  - dvdd-supply
  - vref-supply
  - spi-cpol
  - spi-cpha
  - odr1-gpios
  - odr2-gpios
  - pga1-gpios
  - pga2-gpios
  - temp-gpios
  - chan-gpios
  - clksel-gpios

allOf:
  - $ref: /schemas/spi/spi-peripheral-props.yaml#

unevaluatedProperties: false

examples:
  - |
    #include <dt-bindings/gpio/gpio.h>
    #include <dt-bindings/interrupt-controller/irq.h>

    spi0 {
        #address-cells = <1>;
        #size-cells = <0>;

        adc@0 {
            compatible = "adi,ad7191";
            reg = <0>;
            spi-max-frequency = <1000000>;
            spi-cpol;
            spi-cpha;
            clocks = <&ad7191_mclk>;
            interrupts = <25 IRQ_TYPE_EDGE_FALLING>;
            interrupt-parent = <&gpio>;
            avdd-supply = <&avdd>;
            dvdd-supply = <&dvdd>;
            vref-supply = <&vref>;
            odr1-gpios = <&gpio 23 GPIO_ACTIVE_HIGH>;
            odr2-gpios = <&gpio 24 GPIO_ACTIVE_HIGH>;
            pga1-gpios = <&gpio 5 GPIO_ACTIVE_HIGH>;
            pga2-gpios = <&gpio 6 GPIO_ACTIVE_HIGH>;
            temp-gpios = <&gpio 22 GPIO_ACTIVE_HIGH>;
            chan-gpios = <&gpio 27 GPIO_ACTIVE_HIGH>;
            clksel-gpios = <&gpio 13 GPIO_ACTIVE_HIGH>;
        };
    };
```

## Documentation/devicetree/bindings/iio/adc/adi,ad7192.yaml
```yaml
# SPDX-License-Identifier: (GPL-2.0 OR BSD-2-Clause)
# Copyright 2019 Analog Devices Inc.
%YAML 1.2
---
$id: http://devicetree.org/schemas/iio/adc/adi,ad7192.yaml#
$schema: http://devicetree.org/meta-schemas/core.yaml#

title: Analog Devices AD7192 ADC device driver

maintainers:
  - Michael Hennerich <michael.hennerich@analog.com>

description: |
  Bindings for the Analog Devices AD7192 ADC device. Datasheet can be
  found here:
  https://www.analog.com/media/en/technical-documentation/data-sheets/AD7192.pdf

properties:
  compatible:
    enum:
      - adi,ad7190
      - adi,ad7192
      - adi,ad7193
      - adi,ad7194
      - adi,ad7195

  reg:
    maxItems: 1

  spi-cpol: true

  spi-cpha: true

  spi-max-frequency: true

  clocks:
    maxItems: 1
    description: phandle to the master clock (mclk)

  clock-names:
    items:
      - const: mclk

  interrupts:
    maxItems: 1

  dvdd-supply:
    description: DVdd voltage supply

  avdd-supply:
    description: AVdd voltage supply

  adi,rejection-60-Hz-enable:
    description: |
      This bit enables a notch at 60 Hz when the first notch of the sinc
      filter is at 50 Hz. When REJ60 is set, a filter notch is placed at
      60 Hz when the sinc filter first notch is at 50 Hz. This allows
      simultaneous 50 Hz/ 60 Hz rejection.
    type: boolean

  adi,refin2-pins-enable:
    description: |
      External reference applied between the P1/REFIN2(+) and P0/REFIN2(−) pins.
    type: boolean

  adi,buffer-enable:
    description: |
      Enables the buffer on the analog inputs. If cleared, the analog inputs
      are unbuffered, lowering the power consumption of the device. If this
      bit is set, the analog inputs are buffered, allowing the user to place
      source impedances on the front end without contributing gain errors to
      the system.
    type: boolean

  adi,burnout-currents-enable:
    description: |
      When this bit is set to 1, the 500 nA current sources in the signal
      path are enabled. When BURN = 0, the burnout currents are disabled.
      The burnout currents can be enabled only when the buffer is active
      and when chop is disabled.
    type: boolean

  bipolar:
    description: see Documentation/devicetree/bindings/iio/adc/adc.txt
    type: boolean

  adi,channels:
    description: |
      List of differential channels for AD7194.

patternProperties:
  '^channel@[0-9a-f]+,[0-9a-f]+$':
    description: |
      Definition for a channel provided via 'adi,channels'
    properties:
      '#address-cells':
        const: 2
      '#size-cells':
        const: 0
      reg:
        maxItems: 1
        description: |
          Pins the channel is connected to. The first value specifies the
          the positive input pin, the second value the negative input.
    required:
      - '#address-cells'
      - '#size-cells'
      - reg

required:
  - compatible
  - reg
  - clocks
  - clock-names
  - interrupts
  - dvdd-supply
  - avdd-supply
  - spi-cpol
  - spi-cpha

additionalProperties: false

examples:
  - |
    spi0 {
      #address-cells = <1>;
      #size-cells = <0>;

      adc@0 {
        compatible = "adi,ad7192";
        reg = <0>;
        spi-max-frequency = <1000000>;
        spi-cpol;
        spi-cpha;
        clocks = <&ad7192_mclk>;
        clock-names = "mclk";
        interrupts = <25 0x2>;
        interrupt-parent = <&gpio>;
        dvdd-supply = <&dvdd>;
        avdd-supply = <&avdd>;

        adi,refin2-pins-enable;
        adi,rejection-60-Hz-enable;
        adi,buffer-enable;
        adi,burnout-currents-enable;
      };
    };
  - |
    spi0 {
      status = "okay";
      ad7194: adc@0 {
        compatible = "adi,ad7194";
        reg = <0>;
        spi-max-frequency = <1000000>;
        spi-cpol;
        spi-cpha;
        interrupts = <86 0x2>;
        interrupt-parent = <&gpio0>;
        avdd-supply = <&avdd>;
        dvdd-supply = <&dvdd>;

        adi,channels {
          #address-cells = <2>;
          #size-cells = <0>;
          channel@1,2 {
            reg = <1 2>;
          };
          channel@2,3 {
            reg = <2 3>;
          };
        };
      };
    };
```

## Documentation/devicetree/bindings/iio/adc/adi,ad7292.yaml
```yaml
# SPDX-License-Identifier: GPL-2.0
%YAML 1.2
---
$id: http://devicetree.org/schemas/iio/adc/adi,ad7292.yaml#
$schema: http://devicetree.org/meta-schemas/core.yaml#

title: Analog Devices AD7292 10-Bit Monitor and Control System

maintainers:
  - Marcelo Schmitt <marcelo.schmitt1@gmail.com>

description: |
  Analog Devices AD7292 10-Bit Monitor and Control System with ADC, DACs,
  Temperature Sensor, and GPIOs
    https://www.analog.com/en/products/ad7292.html

properties:
  compatible:
    enum:
      - adi,ad7292

  reg:
    maxItems: 1

  spi-cpha:
    description: |
      See Documentation/devicetree/bindings/spi/spi-bus.txt
    maxItems: 1

  diff-channels:
    description: |
      Empty property to tell whether VIN0 and VIN1 shall work as differential
      inputs.
    maxItems: 1

  '#address-cells':
    const: 1

  '#size-cells':
    const: 0

required:
  - compatible
  - reg

examples:
  - |
    ad7292: ad7292@0 {
      compatible = "adi,ad7292";
      reg = <0>;
      spi-max-frequency = <16000000>;
      spi-cpha;
      diff-channels;
    };
```

## Documentation/devicetree/bindings/iio/adc/adi,ad7380.yaml
```yaml
# SPDX-License-Identifier: (GPL-2.0-only OR BSD-2-Clause)
%YAML 1.2
---
$id: http://devicetree.org/schemas/iio/adc/adi,ad7380.yaml#
$schema: http://devicetree.org/meta-schemas/core.yaml#

title: Analog Devices Simultaneous Sampling Analog to Digital Converters

maintainers:
  - Michael Hennerich <Michael.Hennerich@analog.com>
  - Nuno Sá <nuno.sa@analog.com>

description: |
  * https://www.analog.com/en/products/ad7380.html
  * https://www.analog.com/en/products/ad7381.html
  * https://www.analog.com/en/products/ad7383.html
  * https://www.analog.com/en/products/ad7384.html

$ref: /schemas/spi/spi-peripheral-props.yaml#

properties:
  compatible:
    enum:
      - adi,ad7380
      - adi,ad7381
      - adi,ad7383
      - adi,ad7384

  reg:
    maxItems: 1

  spi-max-frequency:
    maximum: 80000000
  spi-cpol: true
  spi-cpha: true

  spi-rx-bus-channels:
    description:
      In 1-wire mode, the SDOA pin acts as the sole data line and the SDOB/ALERT
      pin acts as the ALERT interrupt signal. In 2-wire mode, data for input A
      is read from SDOA and data for input B is read from SDOB/ALERT (and the
      ALERT interrupt signal is not available).
    enum: [1, 2]

  vcc-supply:
    description: A 3V to 3.6V supply that powers the chip.

  vlogic-supply:
    description:
      A 1.65V to 3.6V supply for the logic pins.

  refio-supply:
    description:
      A 2.5V to 3.3V supply for the external reference voltage. When omitted,
      the internal 2.5V reference is used.

  interrupts:
    description:
      When the device is using 1-wire mode, this property is used to optionally
      specify the ALERT interrupt.
    maxItems: 1

required:
  - compatible
  - reg
  - vcc-supply
  - vlogic-supply

allOf:
  - if:
      required:
        - spi-rx-bus-channels
    then:
      if:
        properties:
          spi-rx-bus-channels:
            const: 2
      then:
        properties:
          interrupts: false

unevaluatedProperties: false

examples:
  - |
    #include <dt-bindings/interrupt-controller/irq.h>

    spi {
        #address-cells = <1>;
        #size-cells = <0>;

        adc@0 {
            compatible = "adi,ad7380";
            reg = <0>;

            spi-cpol;
            spi-cpha;
            spi-max-frequency = <80000000>;

            interrupts = <27 IRQ_TYPE_EDGE_FALLING>;
            interrupt-parent = <&gpio0>;

            vcc-supply = <&supply_3_3V>;
            vlogic-supply = <&supply_3_3V>;
            refio-supply = <&supply_2_5V>;
        };
    };
```

## Documentation/devicetree/bindings/iio/adc/adi,ad7606x_pi.yaml
```yaml
# SPDX-License-Identifier: (GPL-2.0-only OR BSD-2-Clause)
%YAML 1.2
---
$id: http://devicetree.org/schemas/iio/adc/adi,ad7606x_pi.yaml#
$schema: http://devicetree.org/meta-schemas/core.yaml#

title: Analog Devices AD7606x Simultaneous Sampling ADC - Parallel Interface

maintainers:
  - Alin-Tudor Sferle <alin-tudor.sferle@analog.com>

description: |
  Analog Devices AD7606x Simultaneous Sampling ADC - Parallel Interface
  https://www.analog.com/media/en/technical-documentation/data-sheets/ad7606b.pdf
  https://www.analog.com/media/en/technical-documentation/data-sheets/ad7606c-16.pdf
  https://www.analog.com/media/en/technical-documentation/data-sheets/ad7606c-18.pdf
  https://www.analog.com/media/en/technical-documentation/user-guides/EVAL-AD7606BFMCZ-UG-1225.pdf
  https://www.analog.com/media/en/technical-documentation/user-guides/eval-ad7606c-fmcz-ug-1870.pdf

properties:

  compatible:
    enum:
      - ad7606x-pi-16
      - ad7606x-pi-18

  reg:
    maxItems: 1

  clocks:
    maxItems: 1
    description:
      Sampling clock

  clock-names:
    maxItems: 1
    description:
      Names of used clock in tree

  dmas:
    maxItems: 1

  dma-names:
    items:
      - const: ad7606x-pi-adc-dma

  pwms:
    maxItems: 1
    description:
      PWM signal used to start the sampling procedure

  pwm-names:
    items:
      - const: cnvst_n

  adi,adc_serpar:
    description:
      Must be the device tree identifier of the SERPAR pin. This pin is used
      to specify AD7606x chip interface type - logic high indicates Serial,
      and logic low indicates Parallel interface.
    maxItems: 1

  adi,adc_refsel:
    description:
      Must be the device tree identifier of the REF SELECT pin. This pin is
      set to logic high, the internal reference is selected and enabled.
      If the REF SELECT pin is set to logic low, the internal reference
      is disabled and an external reference voltage must be applied to
      the REFIN/REFOUT pin.
    maxItems: 1

  adi,adc_reset:
    description:
      Must be the device tree identifier of the RESET pin.
    maxItems: 1

  adi,adc_standby:
    description:
      Must be the device tree identifier of the STBY pin. This pin is used
      to place the AD7606 into one of two power-down modes, Standby mode or
      Shutdown mode.
    maxItems: 1

  adi,adc_range:
    description:
      Must be the device tree identifier of the RANGE pin. The polarity on
      this pin determines the input range of the analog input channels in
      ADC Hardware Mode.
    maxItems: 1

  adi,adc_os:
    description:
      Must be the device tree identifier of the over-sampling
      mode pins. As the line is active high, it should be marked
      GPIO_ACTIVE_HIGH to enter ADC Software Mode.
    maxItems: 3

required:
  - compatible
  - reg
  - clocks
  - clock-names
  - dmas
  - dma-names
  - pwms
  - pwm-names

unevaluatedProperties: false

examples:
  - |
    #include <dt-bindings/gpio/gpio.h>
    #include <dt-bindings/pwm/pwm.h>
    ad7606x_pi: adc@44a00000 {
                compatible = "ad7606x-pi-16";
                reg = <0x44a00000 0x20000>;
                clocks = <&ext_clk>;
                clock-names = "ad7606x_pi_clk";
                dmas = <&rx_dma 0>;
                dma-names = "ad7606x-pi-adc-dma";
                pwms = <&axi_pwm_gen 0 0>;
                pwm-names = "cnvst_n";
                adi,adc_serpar = <&gpio0 97 GPIO_ACTIVE_LOW>;
                adi,adc_refsel = <&gpio0 96 GPIO_ACTIVE_HIGH>;
                adi,adc_reset = <&gpio0 95 GPIO_ACTIVE_LOW>;
                adi,adc_standby = <&gpio0 94 GPIO_ACTIVE_HIGH>;
                adi,adc_range = <&gpio0 93 GPIO_ACTIVE_LOW>;
                adi,adc_os = <&gpio0 92 GPIO_ACTIVE_HIGH>,
                             <&gpio0 91 GPIO_ACTIVE_HIGH>,
                             <&gpio0 90 GPIO_ACTIVE_HIGH>;
    };
...
```

## Documentation/devicetree/bindings/iio/adc/adi,ad7768.txt
```
* Analog Devices AD7768 Analog to Digital Converter (ADC)

Required properties:
	- compatible: Must be one of "adi,ad7768".
	- reg: SPI chip select number for the device.
	- spi-max-frequency: See Documentation/devicetree/bindings/spi/spi-bus.txt.
	- dmas: DMA specifier, consisting of a phandle to DMA controller node.
	- dma-names: Must be "rx".
	- vref-supply: phandle to the regulator for ADC reference voltage.

Example:

ad7768: adc@0 {
	compatible = "adi,ad7768";
	reg = <0>;
	spi-max-frequency = <1000000>;

	dmas = <&rx_dma 0>;
	dma-names = "rx";

	vref-supply = <&vref>;
};
```
