## Documentation/devicetree/bindings/iio/proximity/vishay,vcnl36829.yaml
```yaml
# SPDX-License-Identifier: GPL-2.0-only OR BSD-2-Clause
%YAML 1.2
---
$id: http://devicetree.org/schemas/iio/proximity/vishay,vcnl36829.yaml#
$schema: http://devicetree.org/meta-schemas/core.yaml#

title: VISHAY VCNL36829 Proximity Sensor

maintainers:
  - Liu Yufei <lyf98405@gmail.com>

description: |
  Proximity sensor with VCSEL in an ultra thin small package with I2C
  interface.
  Datasheet: https://www.vishay.com/docs/80580/vcnl36829um.pdf

properties:
  compatible:
    const: vishay,vcnl36829

  reg:
    maxItems: 1

  vdd-supply: true

  vddio-supply: true

  interrupts:
    maxItems: 1

required:
  - compatible
  - reg
  - vdd-supply
  - vddio-supply

additionalProperties: false

examples:
  - |
    #include <dt-bindings/interrupt-controller/irq.h>
    i2c {
        #address-cells = <1>;
        #size-cells = <0>;

        proximity@60 {
            compatible = "vishay,vcnl36829";
            reg = <0x60>;
            vdd-supply = <&vdd_reg>;
            vddio-supply = <&vddio_reg>;
            interrupt-parent = <&gpio>;
            interrupts = <17 IRQ_TYPE_LEVEL_LOW>;
        };
    };
...
```

## Documentation/devicetree/bindings/interrupt-controller/adi,adsp-pint.yaml
```yaml
# SPDX-License-Identifier: (GPL-2.0 OR BSD-2-Clause)
%YAML 1.2
---
$id: http://devicetree.org/schemas/interrupt-controller/adi,adsp-pint.yaml#
$schema: http://devicetree.org/meta-schemas/core.yaml#

title: Analog Devices ADSP Pin Interrupt (PINT) controller

maintainers:
  - Alvin Šipraga <alvin.sipraga@analog.com>

description:
  Analog Devices Pin Interrupt (PINT) controller found on ADSP SoCs. Each PINT
  is connected to up to two PORT peripherals for sensing of GPIO interrupts. The
  PINT controller demultiplexes the parent interrupt to as many as 32 connected
  PORT pins.

allOf:
  - $ref: /schemas/interrupt-controller.yaml#

properties:
  compatible:
    const: adi,adsp-sc598-pint

  reg:
    maxItems: 1

  '#interrupt-cells':
    const: 2

  interrupt-controller: true

  interrupts:
    maxItems: 1
    description: Interrupt line connecting this controller to its parent

  adi,pint-assign:
    $ref: /schemas/types.yaml#/definitions/uint32
    description:
      The value of the PINT_ASSIGN register, which controls the four 1-bit muxes
      internal to the PINT controller. The muxes control which pins of a
      connected PORT can be sensed by the PINT controller. Each mux maps either
      the upper- or lower-half of a PORT's 16 pins to one contiguous byte within
      the PINT controller's hardware interrupt space. When the same PORT half is
      selected twice, the PINT controller can perform race-free detection of
      both rising and falling edges on the pins in that half.
    enum: [ 0x00000000, 0x00000001, 0x00000100, 0x00000101,
            0x00010000, 0x00010001, 0x00010100, 0x00010101,
            0x01000000, 0x01000001, 0x01000100, 0x01000101,
            0x01010000, 0x01010001, 0x01010100, 0x01010101 ]

unevaluatedProperties: false

required:
  - compatible
  - reg
  - interrupt-controller
  - '#interrupt-cells'
  - interrupts
  - adi,pint-assign

examples:
  - |
    #include <dt-bindings/interrupt-controller/arm-gic.h>
    #include <dt-bindings/interrupt-controller/irq.h>

    interrupt-controller@31005000 {
      compatible = "adi,adsp-sc598-pint";
      reg = <0x31005000 0x40>;
      interrupt-controller;
      #interrupt-cells = <2>;
      interrupt-parent = <&gic>;
      interrupts = <GIC_SPI 65 IRQ_TYPE_LEVEL_HIGH>;
      adi,pint-assign = <0x00000000>;
    };
```

## Documentation/devicetree/bindings/mfd/adi,max20355.yaml
```yaml
# SPDX-License-Identifier: (GPL-2.0-only OR BSD-2-Clause)
%YAML 1.2
---
$id: http://devicetree.org/schemas/mfd/adi,max20355.yaml#
$schema: http://devicetree.org/meta-schemas/core.yaml#

title: Analog Devices MAX20355/MAX20357 PMIC

maintainers:
  - Judy Na <judy.na@analog.com>

description: |
  The Analog Devices MAX20355 and MAX20357 are Power Management ICs that
  provide PLC (Power Line Communication) based power management for TWS
  headphones, AR glasses, and wearable devices.

  MAX20355 is the master PMIC (charging case side) with buck-boost regulator,
  fuel gauge, GPIO, and dual PLC channels. I2C address 0x28, fuel gauge at
  0x36, RAM at 0x50.

  MAX20357 is the slave PMIC (earbud side) with Li-ion charger, fuel gauge,
  GPIO, and a single PLC channel. I2C address 0x15, fuel gauge at 0x36,
  RAM at 0x55.

  The MAX20355 supports two PLC operating modes determined by board wiring:
  - Mono-slave mode: PLC1 and PLC2 pins tied together for a single slave
    with doubled current capacity (400 mA).
  - Dual-slave mode: PLC1 and PLC2 connected to separate slaves (200 mA each).

  Note on RAM address: The MAX20355 datasheet lists RAM at 7-bit address 0x40,
  but hardware I2C scans confirm the RAM block responds at 0x50. This is a
  known datasheet errata.

properties:
  compatible:
    enum:
      - adi,max20355
      - adi,max20357

  reg:
    items:
      - description: PLC registers
      - description: Fuel Gauge registers
      - description: RAM registers

  reg-names:
    items:
      - const: plc
      - const: fuel-gauge
      - const: ram

  interrupts:
    maxItems: 1

  adi,plc-channel:
    $ref: /schemas/types.yaml#/definitions/uint32
    enum: [1, 2]
    description:
      PLC channel number this slave is connected to on the master.
      Required for MAX20357. Channel 1 corresponds to master PLC1,
      channel 2 to master PLC2.

  adi,mono-slave:
    type: boolean
    description:
      Indicates the MAX20355 master operates in mono-slave mode where
      PLC1 and PLC2 pins are strapped together for a single slave with
      doubled output current. When absent, dual-slave mode is assumed.

required:
  - compatible
  - reg
  - reg-names

allOf:
  - if:
      properties:
        compatible:
          const: adi,max20357
    then:
      required:
        - adi,plc-channel

additionalProperties: false

examples:
  - |
    #include <dt-bindings/interrupt-controller/irq.h>

    /* Dual-slave master (charging case) */
    i2c {
        #address-cells = <1>;
        #size-cells = <0>;

        pmic@28 {
            compatible = "adi,max20355";
            reg = <0x28>, <0x36>, <0x50>;
            reg-names = "plc", "fuel-gauge", "ram";
            interrupt-parent = <&gpio>;
            interrupts = <27 IRQ_TYPE_LEVEL_LOW>;
        };
    };
  - |
    #include <dt-bindings/interrupt-controller/irq.h>

    /* Earbud (slave on PLC channel 1) */
    i2c {
        #address-cells = <1>;
        #size-cells = <0>;

        pmic@15 {
            compatible = "adi,max20357";
            reg = <0x15>, <0x36>, <0x55>;
            reg-names = "plc", "fuel-gauge", "ram";
            interrupt-parent = <&gpio>;
            interrupts = <22 IRQ_TYPE_LEVEL_LOW>;
            adi,plc-channel = <1>;
        };
    };
```

## Documentation/devicetree/bindings/net/adi,axis-net.yaml
```yaml
# SPDX-License-Identifier: (GPL-2.0-only OR BSD-2-Clause)
%YAML 1.2
---
$id: http://devicetree.org/schemas/net/adi,axis-net.yaml#
$schema: http://devicetree.org/meta-schemas/core.yaml#

title: Analog Devices AXI-Stream point-to-point Ethernet

maintainers:
  - Analog Devices Inc.

description: |
  A point-to-point Ethernet link carried over a pair of AXI-Stream DMA
  channels, used to connect two processors joined by FPGA fabric.

  Each side of the link needs two ADI AXI-DMAC instances configured in stream
  mode: one MEM_TO_DEV to drive the outbound stream, and one DEV_TO_MEM to
  receive the inbound stream. The two sides' DMACs are paired back to back in
  the fabric, ideally through an AXI4-Stream FIFO for elasticity and any
  required clock-domain crossing.

  The receiving DMAC must be configured to terminate its transfer on TLAST, so
  that a posted maximum-size descriptor closes at the end of each frame rather
  than coalescing consecutive frames.

  This binding is symmetric: an identical node is placed on each side of the
  link, referencing that side's own DMACs.

allOf:
  - $ref: ethernet-controller.yaml#

properties:
  compatible:
    const: adi,axis-net

  dmas:
    items:
      - description: outbound channel, must be MEM_TO_DEV
      - description: inbound channel, must be DEV_TO_MEM

  dma-names:
    items:
      - const: tx
      - const: rx

required:
  - compatible
  - dmas
  - dma-names

unevaluatedProperties: false

examples:
  - |
    ethernet {
        compatible = "adi,axis-net";
        dmas = <&net_tx_dma 0>, <&net_rx_dma 0>;
        dma-names = "tx", "rx";
        local-mac-address = [00 0a 35 00 00 01];
    };
```

## Documentation/devicetree/bindings/net/realtek,rtl8125.yaml
```yaml
# SPDX-License-Identifier: (GPL-2.0-only OR BSD-2-Clause)
%YAML 1.2
---
$id: http://devicetree.org/schemas/net/realtek,rtl8125.yaml#
$schema: http://devicetree.org/meta-schemas/core.yaml#

title: Realtek RTL8125 2.5 Gigabit PCIe Ethernet Controller

maintainers:
  - Heiner Kallweit <hkallweit1@gmail.com>

description:
  The Realtek RTL8125 is a 2.5GBASE-T Ethernet controller with a PCIe host
  interface.

allOf:
  - $ref: ethernet-controller.yaml#

properties:
  compatible:
    const: pci10ec,8125

  reg:
    maxItems: 1

required:
  - compatible
  - reg

unevaluatedProperties: false

examples:
  - |
    pcie {
        #address-cells = <3>;
        #size-cells = <2>;

        ethernet@0,0 {
            compatible = "pci10ec,8125";
            reg = <0x10000 0 0 0 0>;
            local-mac-address = [00 00 00 00 00 00];
        };
    };
```
