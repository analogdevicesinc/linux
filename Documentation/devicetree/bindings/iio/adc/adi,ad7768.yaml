## Documentation/devicetree/bindings/iio/adc/adi,ad7768.yaml
```yaml
# SPDX-License-Identifier: (GPL-2.0-only OR BSD-2-Clause)
%YAML 1.2
---
$id: http://devicetree.org/schemas/iio/adc/adi,ad7768.yaml#
$schema: http://devicetree.org/meta-schemas/core.yaml#

title: Analog Devices AD7768 and AD7768-4 ADC

maintainers:
  - Janani Sunil <janani.sunil@analog.com>

description: |
  The AD7768 is an 8-channel, 24-bit simultaneous sampling ADC with configurable
  power and performance modes. The AD7768-4 is a 4-channel version.

  This binding covers SPI mode only (register access via SPI). Pin control mode,
  where configuration is set via hardware pins rather than SPI registers, is not
  supported.

  The io-backend represents the high-speed data output interface, consuming the
  DOUTx data lines, DCLK (data clock), and DRDY (data ready) signals.

  Datasheet at:
    https://www.analog.com/media/en/technical-documentation/data-sheets/ad7768-ad7768-4.pdf

  HDL reference design:
    https://github.com/analogdevicesinc/hdl/tree/main/projects/ad7768evb

properties:
  compatible:
    enum:
      - adi,ad7768
      - adi,ad7768-4

  reg:
    maxItems: 1

  clocks:
    maxItems: 1
    description:
      Master clock (MCLK). Can be supplied as a CMOS clock on the XTAL2/MCLK
      pin, a crystal oscillator connected between the XTAL1 and XTAL2 pins, or
      an LVDS differential clock on the XTAL1/XTAL2 pin pair. CMOS and LVDS
      clocks must operate from 1.15 MHz to 34 MHz. Crystals must operate from
      8 MHz to 34 MHz.

  clock-names:
    description:
      Identifies the master clock source.
    enum:
      - mclk
      - xtal
      - lvds
    default: mclk

  avdd1-supply:
    description:
      Analog supply voltage for the AVDD1A and AVDD1B pins (5V ± 10% with
      respect to AVSS). Powers the analog front end, reference input, and
      common-mode output circuitry. Both pins must be tied to the same
      potential.

  avss-supply:
    description:
      Negative analog supply rail for the AVSS1A, AVSS1B, AVSS2A, AVSS2B,
      and AVSS pins. This rail is referenced to DGND and all AVSS pins must
      be tied to the same potential. In single-supply operation AVSS is
      nominally 0 V; in split-supply operation it can range from 0 V to
      -2.75 V with respect to DGND. If omitted, AVSS is assumed to be at
      system ground (0 V).

  avdd2-supply:
    description:
      Analog supply voltage for the AVDD2A and AVDD2B pins (2V to 5.5V with
      respect to AVSS). Connects to internal 1.8V analog LDO regulators that
      power the ADC core. Both pins must be tied to the same potential.

  iovdd-supply:
    description:
      Digital supply voltage IOVDD (2.25V to 3.6V with respect to DGND).
      Sets the logic levels for all interface pins and powers the digital
      processing core via an internal LDO. For 1.8V operation (1.72V to
      1.88V), IOVDD must be tied to the DREGCAP pin.

  ref1p-supply:
    description:
      Positive reference input supply for REF1+. The voltage range is from
      (AVSS + 1 V) to AVDD1. Together, REF1+ and REF1- must provide a
      differential reference voltage from 1 V to |AVDD1 - AVSS|. This
      reference is used by channels 0 to 3 on the AD7768 and channels 0 and 1
      on the AD7768-4.

  ref1n-supply:
    description:
      Negative reference input supply for REF1-. The voltage range is from
      AVSS to (AVDD1 - 1 V).

  ref2p-supply:
    description:
      Positive reference input supply for REF2+. The voltage range is from
      (AVSS + 1 V) to AVDD1. Together, REF2+ and REF2- must provide a
      differential reference voltage from 1 V to |AVDD1 - AVSS|. This
      reference is used by channels 4 to 7 on the AD7768 and channels 2 and 3
      on the AD7768-4.

  ref2n-supply:
    description:
      Negative reference input supply for REF2-. The voltage range is from
      AVSS to (AVDD1 - 1 V).

  reset-gpios:
    maxItems: 1
    description: GPIO connected to the active-low RESET pin

  start-gpios:
    maxItems: 1
    description:
      GPIO connected to the START pin. An active-low pulse on this pin
      synchronizes the device to other AD7768 devices. When not used, this
      pin must be tied to a logic high level through a pull-up resistor.
      When used, SYNC_OUT must be wired back to SYNC_IN on all devices in
      the synchronization chain.

  sync-in-gpios:
    maxItems: 1
    description:
      GPIO connected to the SYNC_IN pin. Receives the synchronization pulse
      generated on SYNC_OUT in response to a START pulse. Must be synchronous
      to the MCLK clock domain. In multi-device or daisy-chained systems,
      two successive synchronization pulses must be applied to guarantee all
      ADCs are synchronized.

  sync-out-gpios:
    maxItems: 1
    description:
      GPIO connected to the SYNC_OUT pin. Outputs a synchronization pulse
      synchronous to MCLK in response to a START pulse or SPI_SYNC command.
      In single-device configurations this pin must be wired back to SYNC_IN.
      In multi-device configurations it can be routed to the SYNC_IN pins of
      all devices in the chain.

  gpio-controller: true

  '#gpio-cells':
    const: 2

  adi,data-lines-number:
    $ref: /schemas/types.yaml#/definitions/uint32
    enum: [1, 2, 4, 8]
    description:
      Number of DOUTx lines used for the high-speed data output interface
      (distinct from the SPI control interface). AD7768 supports 1, 2, or 8
      lines; AD7768-4 supports 1 or 4 lines. Defaults to the maximum number
      of lines for the selected variant if omitted.

  regulators:
    type: object
    description: Container for the on-chip VCM regulator.
    additionalProperties: false

    properties:
      vcm-output:
        type: object
        description:
          The VCM pin provides a buffered common-mode voltage output used to
          bias the analog inputs. It supports three fixed output levels of
          1650000 uV, 2500000 uV, and 2140000 uV, as well as a
          supply-dependent (AVDD1 - AVSS) / 2 output derived from
          avdd1-supply. Select the voltage by setting regulator-min-microvolt
          and regulator-max-microvolt to the same value. Use
          regulator-always-on when no DT consumer node references the VCM
          output. The VCM circuitry is associated with channel 0. When VCM is
          used externally, channel@0 must be present and kept enabled because
          placing channel 0 in standby disables the VCM output.
        $ref: /schemas/regulator/regulator.yaml#
        unevaluatedProperties: false

  io-backends:
    maxItems: 1

  '#address-cells':
    const: 1

  '#size-cells':
    const: 0

patternProperties:
  "^channel@[0-7]$":
    type: object
    description:
      Represents the external channels which are connected to the device.
      AD7768 supports channels 0-7, AD7768-4 supports channels 0-3.

    properties:
      reg:
        minimum: 0
        maximum: 7
        description: The channel number

      adi,prechargebuf-pos-enable:
        type: boolean
        description: Enable positive input precharge buffer

      adi,prechargebuf-neg-enable:
        type: boolean
        description: Enable negative input precharge buffer

      adi,refbuf-pos-enable:
        type: boolean
        description: Enable positive reference buffer

      adi,refbuf-neg-enable:
        type: boolean
        description: Enable negative reference buffer

    required:
      - reg

    additionalProperties: false

required:
  - compatible
  - reg
  - clocks
  - avdd1-supply
  - avdd2-supply
  - iovdd-supply
  - ref1p-supply
  - ref1n-supply
  - ref2p-supply
  - ref2n-supply
  - io-backends

allOf:
  - $ref: /schemas/spi/spi-peripheral-props.yaml#
  - if:
      properties:
        compatible:
          contains:
            const: adi,ad7768-4
    then:
      properties:
        adi,data-lines-number:
          enum: [1, 4]
      patternProperties:
        "^channel@[0-3]$":
          properties:
            reg:
              maximum: 3
        "^channel@[4-7]$": false
    else:
      properties:
        adi,data-lines-number:
          enum: [1, 2, 8]

unevaluatedProperties: false

examples:
  - |
    #include <dt-bindings/gpio/gpio.h>

    spi {
        #address-cells = <1>;
        #size-cells = <0>;

        adc@0 {
            compatible = "adi,ad7768";
            reg = <0>;
            spi-max-frequency = <1000000>;

            avdd1-supply = <&avdd1_regulator>;
            avss-supply = <&avss_regulator>;
            avdd2-supply = <&avdd2_regulator>;
            iovdd-supply = <&iovdd_regulator>;
            ref1p-supply = <&ref1p_regulator>;
            ref1n-supply = <&ref1n_regulator>;
            ref2p-supply = <&ref2p_regulator>;
            ref2n-supply = <&ref2n_regulator>;
            reset-gpios = <&gpio0 86 GPIO_ACTIVE_LOW>;

            clocks = <&ad7768_mclk>;

            adi,data-lines-number = <8>;
            gpio-controller;
            #gpio-cells = <2>;

            io-backends = <&iio_backend>;

            #address-cells = <1>;
            #size-cells = <0>;

            channel@0 {
                reg = <0>;
                adi,prechargebuf-pos-enable;
                adi,refbuf-pos-enable;
            };

            channel@1 {
                reg = <1>;
                adi,prechargebuf-pos-enable;
                adi,prechargebuf-neg-enable;
                adi,refbuf-pos-enable;
                adi,refbuf-neg-enable;
            };

            channel@7 {
                reg = <7>;
                adi,prechargebuf-pos-enable;
                adi,refbuf-pos-enable;
            };
        };
    };

...
```

## Documentation/devicetree/bindings/iio/adc/adi,adema127.yaml
```yaml
# SPDX-License-Identifier: (GPL-2.0-only OR BSD-2-Clause)
%YAML 1.2
---
$id: http://devicetree.org/schemas/iio/adc/adi,adema127.yaml#
$schema: http://devicetree.org/meta-schemas/core.yaml#

title: Analog Devices ADEMA124 / ADEMA127 poly-phase energy metering ADCs

maintainers:
  - Michael Hennerich <michael.hennerich@analog.com>

description: |
  The ADEMA124 and ADEMA127 are 4- and 7-channel simultaneous-sampling
  24-bit sigma-delta ADCs targeted at energy metering. They share the same
  SPI command / long-frame response protocol, and are keyed at runtime by
  the PRODUCT_ID register (0x13 = ADEMA124, 0x16 = ADEMA127).

  Data conversions are announced on the DREADY pin. Two capture paths are
  supported:

  * A per-DREADY software-triggered IIO buffer that runs on any SPI
    controller. The DREADY interrupt must be described in the "interrupts"
    property (or via an "interrupt-names" entry named "dready").

  * An autonomous SPI Offload streaming path. When the underlying SPI
    controller advertises SPI_OFFLOAD_CAP_TRIGGER + SPI_OFFLOAD_CAP_RX_STREAM_DMA,
    the driver enables it automatically. Refer to the controller's binding
    for how to describe the offload channel and its trigger source.

  Datasheet:
  * https://www.analog.com/en/products/adema124.html
  * https://www.analog.com/en/products/adema127.html

$ref: /schemas/spi/spi-peripheral-props.yaml#

properties:
  compatible:
    enum:
      - adi,adema124
      - adi,adema127

  reg:
    maxItems: 1

  spi-max-frequency:
    maximum: 22000000

  # SPI mode 3 (CPOL=1, CPHA=1)
  spi-cpol: true
  spi-cpha: true

  interrupts:
    description:
      DREADY interrupt line. The interrupt fires on the falling edge each
      time a new sample set is latched into the SPI shift-out buffer.
    maxItems: 1

  interrupt-names:
    items:
      - const: dready

  dready-gpios:
    description: |
      Alternative description of the DREADY line as a GPIO. Preferred on
      SoCs whose pin interrupt blocks observe the pad behind an input
      buffer enable (e.g. ADI SC5xx PINT): the driver claims the GPIO as
      an input (which enables the pad's input buffer) and derives the
      interrupt via the GPIO controller's irq domain. Takes precedence
      over the "interrupts" property when both are present. Not used in
      SPI-offload streaming mode, where DREADY feeds a hardware trigger
      chain instead.
    maxItems: 1

  vdd-supply:
    description: 3.3 V ±10 % analog / digital supply.

  refio-supply:
    description:
      Optional external 1.25 V reference. When absent the internal
      band-gap reference is used.

  clocks:
    description: |
      Master clock feeding XTALIN / MCLKIN. Nominally 16.384 MHz; the driver
      reads clk_get_rate() to derive DATARATE register values for other
      supported crystal frequencies. Describe the crystal as a fixed-clock
      when there is no on-SoC gateable source.
    maxItems: 1

  clock-names:
    items:
      - const: xtal

  reset-gpios:
    description: |
      Optional GPIO wired to the RESET pin (active-low on the ADEMA124/127).
      The driver pulses RESET at probe: it asserts (drives the pin low), waits
      for the hardware to settle, then deasserts. When this property is absent
      the driver falls back to a software reset (write 0xD6 to SWRST).
      Describe the phandle with GPIO_ACTIVE_LOW so gpiod handles the polarity.
    maxItems: 1

  adi,offload-frames-per-interrupt:
    description: |
      SPI-offload streaming only. Default number of long-frames the RX
      DMA descriptor ring accumulates per completion interrupt (the
      interrupt rate is sample-rate divided by this number). Used when
      userspace has not expressed a preference through the standard IIO
      buffer watermark (watermark left at its kernel default of 1); a
      watermark of 2 or more set by userspace always takes precedence.
    $ref: /schemas/types.yaml#/definitions/uint32
    minimum: 1
    maximum: 4096
    default: 128

  "#address-cells":
    const: 1

  "#size-cells":
    const: 0

patternProperties:
  "^channel@[0-6]$":
    type: object
    additionalProperties: false
    description: Optional per-channel configuration node.

    properties:
      reg:
        description: Channel index (0..6 for ADEMA127; 0..3 for ADEMA124).
        minimum: 0
        maximum: 6

      adi,input-gain:
        description:
          Hardware analogue input gain applied at the channel front-end.
          Written to ADC_GAIN[channel].
        $ref: /schemas/types.yaml#/definitions/uint32
        enum: [1, 2]
        default: 1

      adi,input-invert:
        description:
          Invert the analogue-input polarity for this channel.
          Sets ADC_INV[channel].
        type: boolean

    required:
      - reg

required:
  - compatible
  - reg
  - clocks

oneOf:
  - required:
      - interrupts
  - required:
      - dready-gpios

allOf:
  - if:
      properties:
        compatible:
          contains:
            const: adi,adema124
    then:
      patternProperties:
        "^channel@[4-6]$": false

unevaluatedProperties: false

examples:
  - |
    #include <dt-bindings/gpio/gpio.h>
    #include <dt-bindings/interrupt-controller/irq.h>

    xtal_16m384: xtal-16m384 {
        compatible = "fixed-clock";
        #clock-cells = <0>;
        clock-frequency = <16384000>;
    };

    spi {
        #address-cells = <1>;
        #size-cells = <0>;

        adc@0 {
            compatible = "adi,adema127";
            reg = <0>;
            spi-max-frequency = <20000000>;
            spi-cpol;
            spi-cpha;

            interrupt-parent = <&gpio0>;
            interrupts = <17 IRQ_TYPE_EDGE_FALLING>;
            interrupt-names = "dready";

            vdd-supply = <&vdd_3v3>;
            clocks = <&xtal_16m384>;
            clock-names = "xtal";
            reset-gpios = <&gpio0 22 GPIO_ACTIVE_LOW>;

            #address-cells = <1>;
            #size-cells = <0>;

            channel@0 {
                reg = <0>;
                adi,input-gain = <2>;
            };
        };
    };
...
```
