## Documentation/devicetree/bindings/iio/adc/ingenic,x1600-adc.yaml
```yaml
# SPDX-License-Identifier: (GPL-2.0-only OR BSD-2-Clause)
%YAML 1.2
---
$id: http://devicetree.org/schemas/iio/adc/ingenic,x1600-adc.yaml#
$schema: http://devicetree.org/meta-schemas/core.yaml#

title: Ingenic X1600 ADC

maintainers:
  - Olivier Louvignes <olivier@mgcrea.io>

description:
  The SAR ADC of the Ingenic X1600 SoC, with four auxiliary input channels
  measured against an external SADC_VREFP reference (typically 3.3 V).

properties:
  compatible:
    const: ingenic,x1600-adc

  reg:
    maxItems: 1

  clocks:
    maxItems: 1

  interrupts:
    maxItems: 1

  '#io-channel-cells':
    const: 1

  vref-supply:
    description:
      The SADC_VREFP reference. If absent, the reference is taken as 3.3 V.

required:
  - compatible
  - reg
  - clocks
  - interrupts
  - '#io-channel-cells'

additionalProperties: false

examples:
  - |
    adc@10070000 {
        compatible = "ingenic,x1600-adc";
        reg = <0x10070000 0x1000>;

        clocks = <&cgu 28>;

        interrupt-parent = <&intc>;
        interrupts = <11>;

        vref-supply = <&vcc_3v3>;

        #io-channel-cells = <1>;
    };
```

## Documentation/devicetree/bindings/iio/adc/lltc,ltc2387.yaml
```yaml
# SPDX-License-Identifier: (GPL-2.0-only OR BSD-2-Clause)
# Copyright 2022 Analog Devices Inc.
%YAML 1.2
---
$id: http://devicetree.org/schemas/iio/adc/lltc,ltc2387.yaml#
$schema: http://devicetree.org/meta-schemas/core.yaml#

title: Linear Technology / Analog Devices LTC2387 ADC

maintainers:
  - Sergiu Cuciurean <sergiu.cuciurean@analog.com>
  - Nicolae-Daniel Deaconescu <Nicolae-Daniel.Deaconescu@analog.com>

description: |
  The LTC2387-18 is a low noise, high speed, 18-bit 15Msps
  successive approximation register (SAR) ADC ideally
  suited for a wide range of applications.

  https://www.analog.com/media/en/technical-documentation/data-sheets/238718fa.pdf
  https://www.analog.com/media/en/technical-documentation/data-sheets/238716f.pdf

properties:
  compatible:
    enum:
      - adi,adaq23875
      - adi,adaq23876
      - adi,adaq23878
      - lltc,ltc2387-16
      - lltc,ltc2387-16-x4
      - lltc,ltc2387-18
      - lltc,ltc2387-18-x4

  clocks:
    description: Sampling clock
    maxItems: 1

  pwms:
    maxItems: 2
    description:
      PWM signals used to synchronize the sampling procedure

  pwm-names:
    items:
      - const: cnv
      - const: clk_gate

  io-backends:
    description:
      The AXI ADC IP block (axi_ltc2387) that captures the LVDS data stream.
    maxItems: 1

  vref-supply:
    description:
      External voltage reference. When absent the device's internal 4.096 V
      reference is assumed.

  adi,use-two-lanes:
    description: The device uses two lanes for data transfer
    type: boolean

  adi,gain-milli:
    description:
      Gain of the fully-differential amplifier that the ADAQ2387x modules
      integrate ahead of the LTC2387 die, expressed as gain * 1000. It is
      fixed on the ADAQ23875 and set by pin strapping on the ADAQ23876 and
      ADAQ23878, so it must match the board. The bare ltc2387-* parts have
      no amplifier.
    $ref: /schemas/types.yaml#/definitions/uint32
    enum: [370, 730, 870, 1380, 2000, 2250]

required:
  - compatible
  - clocks
  - io-backends
  - pwms
  - pwm-names

allOf:
  - if:
      properties:
        compatible:
          contains:
            enum:
              - lltc,ltc2387-16
              - lltc,ltc2387-16-x4
              - lltc,ltc2387-18
              - lltc,ltc2387-18-x4
    then:
      properties:
        adi,gain-milli: false

  - if:
      properties:
        compatible:
          contains:
            const: adi,adaq23875
    then:
      properties:
        adi,gain-milli:
          const: 2000

  - if:
      properties:
        compatible:
          contains:
            enum:
              - adi,adaq23876
              - adi,adaq23878
    then:
      properties:
        adi,gain-milli:
          enum: [370, 730, 870, 1380, 2250]
      required:
        - adi,gain-milli

additionalProperties: false

examples:
  - |
    adc {
            compatible = "lltc,ltc2387-16";
            clocks = <&clk 0>;
            io-backends = <&axi_adc>;
            pwms = <&pwm 0 0>, <&pwm 1 0>;
            pwm-names = "cnv", "clk_gate";
            vref-supply = <&vref>;
    };
  - |
    adc {
            compatible = "adi,adaq23878";
            clocks = <&clk 0>;
            io-backends = <&axi_adc>;
            pwms = <&pwm 0 0>, <&pwm 1 0>;
            pwm-names = "cnv", "clk_gate";
            vref-supply = <&vref>;
            adi,use-two-lanes;
            adi,gain-milli = <870>;
    };
```

## Documentation/devicetree/bindings/iio/adc/maxim,max40080.yaml
```yaml
# SPDX-License-Identifier: (GPL-2.0 OR BSD-2-Clause)
%YAML 1.2
---
$id: http://devicetree.org/schemas/iio/adc/maxim,max40080.yaml#
$schema: http://devicetree.org/meta-schemas/core.yaml#

title: Maxim MAX40080 bidirectional current-sense amplifier

maintainers:
  - Ciprian Hegbeli <ciprian.hegbeli@analog.com>
  - Stefan Popa <stefan.popa@analog.com>

description: |
  The MAX40080 is a high-precision, bidirectional current-sense amplifier with
  an integrated 12-bit ADC and an I2C/SMBus interface. It measures the voltage
  across an external shunt resistor and the input bus voltage, and stores the
  results in an internal FIFO.

  Datasheet:
    https://www.analog.com/en/products/max40080.html

properties:
  compatible:
    const: maxim,max40080

  reg:
    maxItems: 1

  "#io-channel-cells":
    const: 1

  shunt-resistor-micro-ohms:
    description:
      Value of the current-sense shunt resistor connected between the IN+ and
      IN- inputs. Used to scale the reported current.

required:
  - compatible
  - reg

additionalProperties: false

examples:
  - |
    i2c {
        #address-cells = <1>;
        #size-cells = <0>;

        adc@20 {
            compatible = "maxim,max40080";
            reg = <0x20>;
            #io-channel-cells = <1>;
            shunt-resistor-micro-ohms = <100000>;
        };
    };
```
