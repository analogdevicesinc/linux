## Documentation/devicetree/bindings/iio/adc/ti,ads1262.yaml
```yaml
# SPDX-License-Identifier: (GPL-2.0-only OR BSD-2-Clause)
%YAML 1.2
---
$id: http://devicetree.org/schemas/iio/adc/ti,ads1262.yaml#
$schema: http://devicetree.org/meta-schemas/core.yaml#

title: TI ADS1262/ADS1263 analog to digital converter

maintainers:
  - Kurt Borja <kuurtb@gmail.com>

description: |
  The ADS1262 and ADS1263 are 38.4-kSPS, delta-sigma (ΔΣ) ADCs with an
  integrated PGA, reference, and internal fault monitors. The ADS1263 integrates
  an auxiliary, 24-bit, ΔΣ ADC intended for background measurements.

  Datasheets:
    - ADS126x: https://www.ti.com/lit/ds/symlink/ads1262.pdf

properties:
  compatible:
    oneOf:
      - const: ti,ads1262
      - items:
          - const: ti,ads1263
          - const: ti,ads1262

  reg:
    maxItems: 1

  '#address-cells':
    const: 1

  '#size-cells':
    const: 0

  spi-max-frequency:
    maximum: 8000000

  spi-cpha: true

  interrupts:
    minItems: 1
    maxItems: 2
    description: Data ready (DRDY) interrupt lines.

  interrupt-names:
    description:
      The data ready (DRDY) signal has two independent interrupt lines. A
      dedicated DRDY pin and a pin shared with the serial interface MISO pin,
      which is called DOUT/DRDY.
    minItems: 1
    maxItems: 2
    items:
      enum: [drdy, doutdrdy]

  start-gpios:
    description: Start conversion control.
    maxItems: 1

  reset-gpios:
    maxItems: 1

  dvdd-supply:
    description: Digital power supply.

  avdd-supply:
    description:
      Analog power supply. In bipolar supply configurations, the reported
      voltage should be in reference to DGND.

  avss-supply:
    description:
      Negative analog power supply for bipolar configurations. AVSS can only be
      at or below the ground reference (DGND). If not described, AVSS is assumed
      to be connected to ground (0V).

  clocks:
    description:
      External crystal or clock wired to the XTAL/CLKIN pins. The device
      automatically detects and switches to it. If not connected, the internal
      oscillator is used.
    maxItems: 1

  '#io-channel-cells':
    const: 3
    description: |
      The first cell selects between ADC1 (1) and ADC2 (2). The two following
      cells select the positive and negative inputs respectively:
        0-9: AIN0-AIN9
        10: AINCOM
        11: Temperature sensor monitor
        12: Analog power supply monitor
        13: Digital power supply monitor
        14: TDAC test signal
      Monitor inputs (11-14) must be selected as both the positive and negative
      input.

  '#gpio-cells':
    const: 2

  gpio-controller: true

  regulators:
    type: object
    description:
      List of regulators provided by this chip.

    properties:
      vbias:
        $ref: /schemas/regulator/regulator.yaml#
        type: object
        description:
          Level-shift voltage output on the AINCOM pin. Its output is the
          mid-voltage of the analog supply, (AVDD + AVSS) / 2, and is used to
          shift floating sensors to within the ADC input range.
        unevaluatedProperties: false

      refout:
        $ref: /schemas/regulator/regulator.yaml#
        type: object
        description:
          Buffered internal voltage reference output on the REFOUT pin.
        unevaluatedProperties: false

    additionalProperties: false

patternProperties:
  "^ain([0-9]|com)-supply$":
    description:
      Common-mode voltage supply connected to AIN<N> or AINCOM.

  "^refp[1-3]-supply$":
    description:
      Positive voltage reference connected to REFP1 (AIN0), REFP2 (AIN2) or
      REFP3 (AIN4). If this regulator is not described and a channel selects
      it as a reference source, then it's assumed to be connected to ground
      (0V).

  "^refn[1-3]-supply$":
    description:
      Negative voltage reference connected to REFN1 (AIN1), REFN2 (AIN3) or
      REFN3 (AIN5). If this regulator is not described and a channel selects
      it as a reference source, then it's assumed to be connected to ground
      (0V).

  "^ti,refp[1-3]-refn[1-3]-resistor-ohms$":
    description:
      Magnitude of the external reference resistor connected between REFP<N>
      and REFN<M>. In ratiometric configurations, such as RTD measurements, the
      IDAC excitation current returns through this resistor, generating the
      reference voltage for the conversion.

  "^channel@[0-9a-f]+$":
    $ref: /schemas/iio/adc/adc.yaml#
    unevaluatedProperties: false

    properties:
      reg:
        maxItems: 1

      single-channel:
        minimum: 0
        maximum: 10

      common-mode-channel:
        minimum: 0
        maximum: 10
        default: 10

      diff-channels:
        items:
          minimum: 0
          maximum: 10

      input-chopping: true

      reference-sources:
        minItems: 2
        description:
          Indicates the reference sources for this channel. The first and second
          items are the positive (REFP) and negative (REFN) sources of the main
          ADC (ADC1). The third item is the reference source of the secondary
          ADC (ADC2) and must always have a positive differential voltage.
        items:
          - enum: [internal-p, refp1, refp2, refp3, avdd]
          - enum: [internal-n, refn1, refn2, refn3, avss]
          - enum: [internal, refp1-refn1, refp2-refn2, refp3-refn3, avdd-avss]

      ti,reference-reversal:
        $ref: /schemas/types.yaml#/definitions/flag
        description:
          Indicates that the ADC1 (this has no effect on ADC2) reference voltage
          for this channel has negative polarity and thus should be internally
          reversed.

      excitation-channels:
        minItems: 1
        maxItems: 2
        description:
          Selects the pins for the IDAC sources from 0 (AIN0) to 10 (AINCOM).
          The first value corresponds to IDAC1 and the second to IDAC2.
        items:
          minimum: 0
          maximum: 10

      excitation-current-nanoamp:
        minItems: 1
        maxItems: 2
        description:
          The first value corresponds to IDAC1 and the second to IDAC2.
        items:
          enum: [50000, 100000, 250000, 500000, 750000, 1000000, 1500000,
                 2000000, 2500000, 3000000]

      excitation-current-chopping: true

      burn-out-current-nanoamp:
        description:
          Selects current magnitude for the sensor bias current source.
        enum: [500, 2000, 10000, 50000, 200000]

      ti,burn-out-resistor:
        $ref: /schemas/types.yaml#/definitions/flag
        description:
          Instead of a fixed current, the sensor bias (burn-out) current source
          can be pulled using an internal 10 MΩ resistor.

      ti,burn-out-polarity:
        $ref: /schemas/types.yaml#/definitions/string
        description:
          The sensor bias can be configured to either pull-up or pull-down mode.
          In pull-up mode, the current flows into the positive input and flows
          out of the negative input. In pull-down mode, the polarities are
          reversed.
        enum: [pull-up, pull-down]
        default: pull-up

    dependencies:
      excitation-channels: [excitation-current-nanoamp]
      excitation-current-nanoamp: [excitation-channels]
      burn-out-current-nanoamp:
        not:
          required:
            - ti,burn-out-resistor

    required:
      - reg

    allOf:
      - if:
          properties:
            excitation-channels:
              maxItems: 1
          required:
            - excitation-channels
        then:
          properties:
            excitation-current-nanoamp:
              maxItems: 1
        else:
          properties:
            excitation-current-nanoamp:
              minItems: 2

    oneOf:
      - required: [single-channel]
      - required: [diff-channels]

dependencies:
  interrupts: [interrupt-names]
  interrupts-extended: [interrupt-names]

required:
  - compatible
  - reg
  - spi-cpha
  - avdd-supply
  - dvdd-supply
  - '#address-cells'
  - '#size-cells'

allOf:
  - $ref: /schemas/spi/spi-peripheral-props.yaml#
  - if:
      properties:
        compatible:
          contains:
            const: ti,ads1263
    then:
      patternProperties:
        "^channel@[0-9a-f]+$":
          properties:
            reference-sources:
              minItems: 3
              maxItems: 3
              default: [internal-p, internal-n, internal]
    else:
      patternProperties:
        "^channel@[0-9a-f]+$":
          properties:
            reference-sources:
              minItems: 2
              maxItems: 2
              default: [internal-p, internal-n]

unevaluatedProperties: false

examples:
  - |
    #include <dt-bindings/gpio/gpio.h>
    #include <dt-bindings/interrupt-controller/irq.h>

    spi {
        #address-cells = <1>;
        #size-cells = <0>;

        adc@0 {
            compatible = "ti,ads1262";
            reg = <0>;
            spi-max-frequency = <8000000>;
            spi-cpha;
            avdd-supply = <&avdd>;
            dvdd-supply = <&dvdd>;
            refp3-supply = <&refp3>;
            refn3-supply = <&refn3>;
            #address-cells = <1>;
            #size-cells = <0>;

            interrupts-extended = <&gpio 0 IRQ_TYPE_EDGE_FALLING>;
            interrupt-names = "drdy";

            /* Typical common mode voltage configuration */
            aincom-supply = <&ads1262_vbias>;

            regulators {
                ads1262_vbias: vbias { };
            };

            channel@0 {
                reg = <0>;
                single-channel = <0>;
                /* The VBIAS is enabled on pin 10 (AINCOM) */
                common-mode-channel = <10>;
                reference-sources = "refp3", "refn3";
            };
        };
    };

  - |
    #include <dt-bindings/gpio/gpio.h>
    #include <dt-bindings/interrupt-controller/irq.h>

    spi {
        #address-cells = <1>;
        #size-cells = <0>;

        adc@0 {
            compatible = "ti,ads1263", "ti,ads1262";
            reg = <0>;
            spi-max-frequency = <8000000>;
            spi-cpha;
            avdd-supply = <&avdd>;
            dvdd-supply = <&dvdd>;
            #address-cells = <1>;
            #size-cells = <0>;

            interrupts-extended = <&gpio 0 IRQ_TYPE_EDGE_FALLING>;
            interrupt-names = "drdy";

            ti,refp2-refn2-resistor-ohms = <3520>;

            channel@0 {
                reg = <0>;
                diff-channels = <4 5>;
                reference-sources = "refp2", "refn2", "refp2-refn2";
                excitation-channels = <1 6>;
                excitation-current-nanoamp = <500000 500000>;
            };
        };
    };
```

## Documentation/devicetree/bindings/iio/beamformer/adi,adar2001.yaml
```yaml
# SPDX-License-Identifier: (GPL-2.0-only OR BSD-2-Clause)
%YAML 1.2
---
$id: http://devicetree.org/schemas/iio/beamformer/adi,adar2001.yaml#
$schema: http://devicetree.org/meta-schemas/core.yaml#

title: Analog Devices ADAR2001 Frequency Multiplier and Filter Transmitter

maintainers:
  - Kim Seer Paller <kimseer.paller@analog.com>

description: |
  Analog Devices ADAR2001 10GHz to 40GHz, 1:4 channel, 4x frequency multiplier
  and filter transmitter. A 2.5GHz to 10GHz input is multiplied by four, passed
  through a selectable bandpass and notch filter and a 5-bit step attenuator,
  then split into four outputs, each with its own power amplifier and RF power
  detector. A temperature diode and the four detectors share one 8-bit ADC.
  Two on-chip sequencers step the transmit and the multiplier and filter
  blocks through a programmed list of modes. Each has an advance and a reset
  pin, and each can also be driven over SPI. The pins are the faster path and
  are used whenever they are described here.
  Datasheet can be found here:
  https://www.analog.com/media/en/technical-documentation/data-sheets/ADAR2001.pdf

properties:
  compatible:
    const: adi,adar2001

  reg:
    maxItems: 1

  spi-max-frequency:
    maximum: 15000000

  vpos-supply:
    description:
      2.5V analog supply, feeding the VPOS1, VPOS3, VPOS4 and VPOS5 pins.

  vpos2-supply:
    description:
      1.8V digital supply feeding the VPOS2 pin. Optional, because the
      reference wiring straps VPOS2 to the on-chip regulator output VREG
      instead of to a board rail.

  tx-advance-gpios:
    description:
      TxADV pin. An active-high pulse advances the transmit sequencer to the
      next state, wrapping to state 1 at the end of the cycle.
    maxItems: 1

  tx-reset-gpios:
    description:
      TxRST pin. An active-high pulse returns the transmit sequencer to state
      0, which always applies mode 0.
    maxItems: 1

  multiplier-advance-gpios:
    description:
      MADV pin. An active-high pulse advances the multiplier and filter
      sequencer to the next state, wrapping to state 1 at the end of the
      cycle.
    maxItems: 1

  multiplier-reset-gpios:
    description:
      MRST pin. An active-high pulse returns the multiplier and filter
      sequencer to state 0, which always applies mode 0.
    maxItems: 1

required:
  - compatible
  - reg

allOf:
  - $ref: /schemas/spi/spi-peripheral-props.yaml#

unevaluatedProperties: false

examples:
  - |
    #include <dt-bindings/gpio/gpio.h>

    spi {
        #address-cells = <1>;
        #size-cells = <0>;

        transmitter@0 {
            compatible = "adi,adar2001";
            reg = <0>;
            spi-max-frequency = <15000000>;
            vpos-supply = <&vdd_2v5>;
            tx-advance-gpios = <&gpio 5 GPIO_ACTIVE_HIGH>;
            tx-reset-gpios = <&gpio 6 GPIO_ACTIVE_HIGH>;
            multiplier-advance-gpios = <&gpio 13 GPIO_ACTIVE_HIGH>;
            multiplier-reset-gpios = <&gpio 19 GPIO_ACTIVE_HIGH>;
        };
    };
...
```

## Documentation/devicetree/bindings/iio/frequency/adi,ad9910-axi-backend.yaml
```yaml
# SPDX-License-Identifier: (GPL-2.0-only OR BSD-2-Clause)
%YAML 1.2
---
$id: http://devicetree.org/schemas/iio/frequency/adi,ad9910-axi-backend.yaml#
$schema: http://devicetree.org/meta-schemas/core.yaml#

title: Analog Devices AD9910 AXI Backend IP core

maintainers:
  - Rodrigo Alencar <rodrigo.alencar@analog.com>

description: |
  FPGA IP core that interfaces with the data and control pins of the AD9910
  Direct Digital Synthesizer. The SPI bus is used as the control interface
  of the AD9910 device, while this IP core streams data from memory via DMA
  into the 18-bit parallel data port (F[1:0] and D[15:0] pins), which is
  clocked by the PDCLK output of the AD9910. The IP core also drives the
  PROFILE[2:0] pins for profile selection and provides a PWM generator that
  drives the DRCTL pin, controlling the digital ramp generator (DRG) slope
  direction.

  https://www.analog.com/en/products/ad9910.html

properties:
  compatible:
    const: adi,ad9910-axi-backend

  reg:
    maxItems: 1

  clocks:
    maxItems: 1
    description: AXI bus clock (s_axi_aclk).

  dmas:
    maxItems: 1

  dma-names:
    items:
      - const: tx

  '#io-backend-cells':
    const: 0

  '#pwm-cells':
    const: 3
    description:
      The first cell must be 0, as only the DRCTL PWM output is available.
      The second cell is the PWM period in nanoseconds and the third cell
      holds the PWM flags.

required:
  - compatible
  - reg
  - clocks
  - dmas
  - dma-names
  - '#io-backend-cells'
  - '#pwm-cells'

additionalProperties: false

examples:
  - |
    ad9910_backend: dds-backend@44a00000 {
        compatible = "adi,ad9910-axi-backend";
        reg = <0x44a00000 0x10000>;
        clocks = <&clkc 15>;
        dmas = <&tx_dma 0>;
        dma-names = "tx";
        #io-backend-cells = <0>;
        #pwm-cells = <3>;
    };
...
```
