## Documentation/devicetree/bindings/iio/motor/adi,tmc5222.yaml
```yaml
# SPDX-License-Identifier: (GPL-2.0-only OR BSD-2-Clause)
%YAML 1.2
---
$id: http://devicetree.org/schemas/iio/motor/adi,tmc5222.yaml#
$schema: http://devicetree.org/meta-schemas/core.yaml#

title: Analog Devices TMC5222/TMC5221 Stepper Motor Controller

maintainers:
  - Radu Sabau <radu.sabau@analog.com>

description: |
  The TMC5222 and TMC5221 are stepper motor controller/driver ICs with
  integrated motion controller, StealthChop2 silent motor operation,
  StallGuard2/StallGuard4 load detection, and CoolStep current control.

  TMC5222 uses I2C interface, TMC5221 uses SPI interface.
  Both share the same register set and functionality.

properties:
  compatible:
    enum:
      - adi,tmc5221
      - adi,tmc5222

  reg:
    maxItems: 1

  sleep-gpios:
    description:
      GPIO connected to the SLEEP pin. Used to wake up or put the device
      into sleep mode. Active low (low = sleep, high = awake).
    maxItems: 1

  drv-en-gpios:
    description:
      GPIO connected to the driver enable pin. Controls the motor driver
      output stage. Active high.
    maxItems: 1

  interrupts:
    minItems: 1
    maxItems: 2

  interrupt-names:
    minItems: 1
    maxItems: 2
    items:
      enum:
        - stallguard
        - pos_reached

  ext-clock:
    $ref: /schemas/types.yaml#/definitions/uint32
    description:
      External clock frequency in Hz. Required when using an external clock
      source. If not specified and the device detects external clock mode,
      probe will fail.

  current-run:
    $ref: /schemas/types.yaml#/definitions/uint32
    minimum: 0
    maximum: 31
    default: 31
    description:
      Motor run current (IRUN). 5-bit value (0-31) where 31 is maximum current.

  current-hold:
    $ref: /schemas/types.yaml#/definitions/uint32
    minimum: 0
    maximum: 31
    default: 8
    description:
      Motor hold current (IHOLD). 5-bit value (0-31) for standstill current.

  adi,irundelay:
    $ref: /schemas/types.yaml#/definitions/uint32
    minimum: 0
    maximum: 15
    default: 4
    description:
      Delay time for motor current power up (IRUNDELAY). 4-bit value.

  adi,iholddelay:
    $ref: /schemas/types.yaml#/definitions/uint32
    minimum: 0
    maximum: 15
    default: 1
    description:
      Delay time for motor current power down (IHOLDDELAY). 4-bit value.

  adi,fs-gain:
    $ref: /schemas/types.yaml#/definitions/uint32
    minimum: 0
    maximum: 3
    default: 1
    description:
      Full-scale current gain setting (FS_GAIN). 2-bit value.

  adi,fs-sense:
    $ref: /schemas/types.yaml#/definitions/uint32
    minimum: 0
    maximum: 3
    default: 1
    description:
      Full-scale sense resistor setting (FS_SENSE). 2-bit value.

  adi,global-scaler:
    $ref: /schemas/types.yaml#/definitions/uint32
    minimum: 0
    maximum: 255
    default: 0
    description:
      Global current scaler value applied to both motor phases A and B.
      8-bit value (0-255).

  adi,tpowerdown:
    $ref: /schemas/types.yaml#/definitions/uint32
    default: 10
    description:
      Delay before power down after standstill (TPOWERDOWN register value).

  adi,toff:
    $ref: /schemas/types.yaml#/definitions/uint32
    minimum: 0
    maximum: 15
    default: 2
    description:
      Chopper off time (TOFF). 4-bit value controlling the slow decay time.

  adi,tbl:
    $ref: /schemas/types.yaml#/definitions/uint32
    minimum: 0
    maximum: 3
    default: 2
    description:
      Chopper blank time (TBL). 2-bit value.

  microstep-res:
    $ref: /schemas/types.yaml#/definitions/uint32
    minimum: 0
    maximum: 8
    default: 0
    description: |
      Microstep resolution setting (MRES).
        0 = 256 microsteps (default)
        1 = 128 microsteps
        2 = 64 microsteps
        3 = 32 microsteps
        4 = 16 microsteps
        5 = 8 microsteps
        6 = 4 microsteps
        7 = 2 microsteps
        8 = full step

  step-angle-millidegrees:
    $ref: /schemas/types.yaml#/definitions/uint32
    default: 1800
    description:
      Motor step angle in millidegrees. Common values are 1800 (1.8 degrees)
      for standard steppers and 900 (0.9 degrees) for high-resolution motors.

  pwm-freewheel:
    $ref: /schemas/types.yaml#/definitions/uint32
    minimum: 0
    maximum: 3
    default: 0
    description: |
      PWM freewheel mode selection.
        0 = Normal operation
        1 = Freewheel
        2 = Coil short via low-side drivers
        3 = Coil short via high-side drivers

  pwm-freq:
    $ref: /schemas/types.yaml#/definitions/uint32
    minimum: 0
    maximum: 3
    default: 0
    description: |
      PWM frequency selection.
        0 = fPWM = 2/1024 fCLK
        1 = fPWM = 2/683 fCLK
        2 = fPWM = 2/512 fCLK
        3 = fPWM = 2/410 fCLK

  adi,sgt:
    $ref: /schemas/types.yaml#/definitions/uint32
    minimum: 0
    maximum: 127
    default: 0
    description:
      StallGuard2 threshold (SGT). 7-bit signed value for stall detection
      sensitivity.

  adi,sgt4:
    $ref: /schemas/types.yaml#/definitions/uint32
    minimum: 0
    maximum: 511
    default: 0
    description:
      StallGuard4 threshold (SG4_THRS). 9-bit value for enhanced stall
      detection.

  adi,vstart:
    $ref: /schemas/types.yaml#/definitions/uint32
    default: 0
    description:
      Ramp generator start velocity (VSTART register).

  adi,a1:
    $ref: /schemas/types.yaml#/definitions/uint32
    default: 10000
    description:
      First acceleration value (A1 register) for S-ramp.

  adi,v1:
    $ref: /schemas/types.yaml#/definitions/uint32
    default: 100000
    description:
      First velocity threshold (V1 register) for S-ramp.

  adi,a2:
    $ref: /schemas/types.yaml#/definitions/uint32
    default: 30000
    description:
      Second acceleration value (A2 register) for S-ramp.

  adi,v2:
    $ref: /schemas/types.yaml#/definitions/uint32
    default: 300000
    description:
      Second velocity threshold (V2 register) for S-ramp.

  adi,amax:
    $ref: /schemas/types.yaml#/definitions/uint32
    default: 100000
    description:
      Maximum acceleration (AMAX register).

  adi,vmax:
    $ref: /schemas/types.yaml#/definitions/uint32
    default: 500000
    description:
      Maximum velocity (VMAX register).

  adi,dmax:
    $ref: /schemas/types.yaml#/definitions/uint32
    default: 2000
    description:
      Maximum deceleration (DMAX register).

  adi,d2:
    $ref: /schemas/types.yaml#/definitions/uint32
    default: 1600
    description:
      Second deceleration value (D2 register) for S-ramp.

  adi,d1:
    $ref: /schemas/types.yaml#/definitions/uint32
    default: 1000
    description:
      First deceleration value (D1 register) for S-ramp.

  adi,vstop:
    $ref: /schemas/types.yaml#/definitions/uint32
    default: 10
    description:
      Stop velocity (VSTOP register). Motor stops when velocity falls
      below this value.

  adi,xtarget:
    $ref: /schemas/types.yaml#/definitions/uint32
    default: 0
    description:
      Initial target position (XTARGET register).

required:
  - compatible
  - reg
  - sleep-gpios
  - drv-en-gpios

allOf:
  - if:
      properties:
        compatible:
          contains:
            const: adi,tmc5221
    then:
      $ref: /schemas/spi/spi-peripheral-props.yaml#

unevaluatedProperties: false

examples:
  - |
    #include <dt-bindings/gpio/gpio.h>
    #include <dt-bindings/interrupt-controller/irq.h>

    i2c {
        #address-cells = <1>;
        #size-cells = <0>;

        motor-controller@50 {
            compatible = "adi,tmc5222";
            reg = <0x50>;
            sleep-gpios = <&gpio 5 GPIO_ACTIVE_LOW>;
            drv-en-gpios = <&gpio 6 GPIO_ACTIVE_HIGH>;

            interrupt-parent = <&gpio>;
            interrupts = <7 IRQ_TYPE_EDGE_FALLING>,
                         <8 IRQ_TYPE_EDGE_FALLING>;
            interrupt-names = "stallguard", "pos_reached";

            current-run = <31>;
            current-hold = <8>;
            microstep-res = <0>;
            step-angle-millidegrees = <1800>;
            adi,amax = <100000>;
            adi,vmax = <500000>;
        };
    };
  - |
    #include <dt-bindings/gpio/gpio.h>

    spi {
        #address-cells = <1>;
        #size-cells = <0>;

        motor-controller@0 {
            compatible = "adi,tmc5221";
            reg = <0>;
            spi-max-frequency = <4000000>;
            sleep-gpios = <&gpio 10 GPIO_ACTIVE_LOW>;
            drv-en-gpios = <&gpio 11 GPIO_ACTIVE_HIGH>;

            current-run = <24>;
            current-hold = <4>;
            step-angle-millidegrees = <900>;
        };
    };
```

## Documentation/devicetree/bindings/iio/opensensorfusion,osf.yaml
```yaml
# SPDX-License-Identifier: (GPL-2.0-only OR BSD-2-Clause)
%YAML 1.2
---
$id: http://devicetree.org/schemas/iio/opensensorfusion,osf.yaml#
$schema: http://devicetree.org/meta-schemas/core.yaml#

title: Open Sensor Fusion Sensor Aggregation Hub

maintainers:
  - Jinseob Kim <kimjinseob88@gmail.com>

description: |
  This binding documents the Open Sensor Fusion GREEN sensor hub and its
  generic host interface. Open Sensor Fusion is a sensor aggregation hub. The hub exposes an OSF protocol
  data stream over its host interface and reports capabilities and samples for
  multiple sensor classes. The actual sensor channels are discovered at runtime
  from OSF capability reports instead of describing them in Device Tree. The
  protocol version is discovered at runtime.

  Public project documentation is available at:

    https://github.com/opensensorfusion

  OSF0, protocol_major, and protocol_minor are wire-protocol details
  exchanged in OSF frames.

allOf:
  - $ref: /schemas/serial/serial-peripheral-props.yaml#

properties:
  compatible:
    items:
      - const: opensensorfusion,osf-green
      - const: opensensorfusion,osf

  vcc-supply:
    description:
      Regulator supplying power to the Open Sensor Fusion device.

required:
  - compatible
  - vcc-supply

unevaluatedProperties: false

examples:
  - |
    serial {
        sensor {
            compatible = "opensensorfusion,osf-green",
                         "opensensorfusion,osf";
            vcc-supply = <&vcc_sensor>;
        };
    };
...
```

## Documentation/devicetree/bindings/iio/pressure/sensirion,sdp31.yaml
```yaml
# SPDX-License-Identifier: (GPL-2.0-only OR BSD-2-Clause)
%YAML 1.2
---
$id: http://devicetree.org/schemas/iio/pressure/sensirion,sdp31.yaml#
$schema: http://devicetree.org/meta-schemas/core.yaml#

title: Sensirion SDP31, SDP32 and SDP33 differential pressure sensors

maintainers:
  - Muhammad Abu Bakar <m.abubakar365@yahoo.com>

description:
  Differential pressure sensors from Sensirion with an I2C interface.
  The SDP31, SDP32 and SDP33 differ only in their measurement range.

properties:
  compatible:
    oneOf:
      - items:
          - enum:
              - sensirion,sdp32
              - sensirion,sdp33
          - const: sensirion,sdp31
      - const: sensirion,sdp31

  reg:
    maxItems: 1

  interrupts:
    maxItems: 1

  vdd-supply: true

required:
  - compatible
  - reg
  - vdd-supply

additionalProperties: false

examples:
  - |
    i2c {
      #address-cells = <1>;
      #size-cells = <0>;
      pressure@21 {
        compatible = "sensirion,sdp31";
        reg = <0x21>;
        vdd-supply = <&vdd_3v3>;
      };
    };
```

## Documentation/devicetree/bindings/iio/proximity/benewake,tf-luna.yaml
```yaml
# SPDX-License-Identifier: (GPL-2.0-only OR BSD-2-Clause)
%YAML 1.2
---
$id: http://devicetree.org/schemas/iio/proximity/benewake,tf-luna.yaml#
$schema: http://devicetree.org/meta-schemas/core.yaml#

title: Benewake TF-Luna LiDAR distance sensor

maintainers:
  - Vidhu Sarwal <vidhu.linux@gmail.com>

description: |
  Single-point time-of-flight LiDAR ranging sensor with a range of 0.2 m to
  8 m. The sensor talks either UART or I2C, selected at power-up by the level
  of pin 5: tied to ground for I2C, unconnected or tied to 3.3 V for UART.

  Datasheet: https://en.benewake.com/uploadfiles/2025/04/20250430174501874.pdf

properties:
  compatible:
    const: benewake,tf-luna

  reg:
    maxItems: 1

  interrupts:
    description:
      Output on pin 6. In I2C mode it is a data ready signal that goes high
      when a new measurement is available and goes low again once any
      register has been read. In UART mode it can be configured as an on/off
      output.
    maxItems: 1

  vcc-supply:
    description: Power supply, 3.7 V to 5.2 V.

required:
  - compatible
  - vcc-supply

additionalProperties: false

examples:
  - |
    #include <dt-bindings/interrupt-controller/irq.h>

    i2c {
        #address-cells = <1>;
        #size-cells = <0>;

        proximity@10 {
            compatible = "benewake,tf-luna";
            reg = <0x10>;
            vcc-supply = <&reg_5v>;
            interrupt-parent = <&gpio>;
            interrupts = <17 IRQ_TYPE_EDGE_RISING>;
        };
    };
  - |
    serial {
        proximity {
            compatible = "benewake,tf-luna";
            vcc-supply = <&reg_5v>;
        };
    };
...
```

## Documentation/devicetree/bindings/iio/proximity/pulsedlight,lidar-lite-v2.yaml
```yaml
# SPDX-License-Identifier: (GPL-2.0-only OR BSD-2-Clause)
%YAML 1.2
---
$id: http://devicetree.org/schemas/iio/proximity/pulsedlight,lidar-lite-v2.yaml#
$schema: http://devicetree.org/meta-schemas/core.yaml#

title: Pulsedlight LIDAR-Lite v2 range-finding sensor

maintainers:
  - Matt Ranostay <matt@ranostay.sg>
  - Rodrigo Gobbi <rodrigo.gobbi.7@gmail.com>

description: |
  This binding covers the I2C interface of the Pulsedlight LIDAR-Lite v2
  laser rangefinder.

  Besides I2C, the mode control pin can also trigger acquisitions and
  report the measured distance through a PWM signal, without using I2C
  at all. That usage is bidirectional and non-cyclic, and is not
  described by this binding. The same pin can also be used, while I2C
  remains the active interface, as a plain status output signalling
  when an acquisition has completed.

  Datasheet:
    https://github.com/PulsedLight3D/LIDAR-Lite-Documentation/blob/master/Docs/LIDAR-Lite-v2-Docs.pdf

properties:
  compatible:
    const: pulsedlight,lidar-lite-v2

  reg:
    maxItems: 1

  powerdown-gpios:
    description: GPIO that can be driven low to shut off power to the device.
    maxItems: 1

  vdd-supply: true

  interrupts:
    description:
      Mode control pin used as a status output, driven while the device is
      busy performing an acquisition. Can be used to signal completion
      instead of polling over I2C.
    maxItems: 1

required:
  - compatible
  - reg
  - vdd-supply

additionalProperties: false

examples:
  - |
    i2c {
        #address-cells = <1>;
        #size-cells = <0>;
        lidar@62 {
            compatible = "pulsedlight,lidar-lite-v2";
            reg = <0x62>;
            vdd-supply = <&vdd_5v0>;
        };
    };
...
```
