## Documentation/devicetree/bindings/iio/adc/adi,adar1000.yaml
```yaml
# SPDX-License-Identifier: (GPL-2.0-only OR BSD-2-Clause)
# Copyright 2020 Analog Devices Inc.
%YAML 1.2
---
$id: http://devicetree.org/schemas/bindings/iio/adc/adi,adar1000.yaml#
$schema: http://devicetree.org/meta-schemas/core.yaml#

title: Analog Devices ADAR1000 X Band and KuBand Beamformer

maintainers:
  - Mircea Caprioru <mircea.caprioru@analog.com>

description: |
  Analog Devices ADAR1000 4-channel, X and Ku frequency band, beamformer.
  https://www.analog.com/media/en/technical-documentation/data-sheets/ADAR1000.pdf

properties:
  compatible:
    enum:
      - adi,adar1000

  reg:
    maxItems: 1

patternProperties:
  "dev@[0-3]":
    type: object

    properties:
      reg:
        description:
          The device address. On the same SPI lines there can connected up to 4
          devices, this is done by using the two address bits (ADDR0 and ADDR1).
          For mode details about this address look at page 27 of the datasheet
          at the Chip Addressing section.
        minimum: 0
        maximum: 3

      label:
        description:
          This label is used to recognize between the 4 ADAR1000 devices that
          can be supported on the same SPI lines. This is useful when trying to
          identify one device.

    required:
      - reg

required:
  - compatible
  - reg

examples:
  - |
    adar1000@0 {
      compatible = "adi,adar1000";
      reg = <0>;
      spi-max-frequency = <1000000>;

      #address-cells = <1>;
      #size-cells = <0>;

      dev@0 {
        reg = <0>;
        label = "BEAM0";
      };
      dev@1 {
        reg = <1>;
        label = "BEAM1";
      };
      dev@2 {
        reg = <2>;
        label = "BEAM2";
      };
      dev@3 {
        reg = <3>;
        label = "BEAM3";
      };
    };
```

## Documentation/devicetree/bindings/iio/adc/adi,ade9000.yaml
```yaml
# SPDX-License-Identifier: (GPL-2.0 OR BSD-2-Clause)
# Copyright 2025 Analog Devices Inc.
%YAML 1.2
---
$id: http://devicetree.org/schemas/bindings/iio/adc/adi,ade9000.yaml#
$schema: http://devicetree.org/meta-schemas/core.yaml#

title: Analog Devices ADE9000 High Performance, Polyphase Energy Metering driver

maintainers:
  - Antoniu Miclaus <antoniu.miclaus@analog.com>

description: |
  The ADE9000 s a highly accurate, fully integrated, multiphase energy and power
  quality monitoring device. Superior analog performance and a digital signal
  processing (DSP) core enable accurate energy monitoring over a wide dynamic
  range. An integrated high end reference ensures low drift over temperature
  with a combined drift of less than ±25 ppm/°C maximum for the entire channel
  including a programmable gain amplifier (PGA) and an analog-to- digital
  converter (ADC).

  https://www.analog.com/media/en/technical-documentation/data-sheets/ADE9000.pdf

$ref: /schemas/spi/spi-peripheral-props.yaml#

properties:
  compatible:
    enum:
      - adi,ade9000

  reg:
    maxItems: 1

  '#address-cells':
    const: 1

  '#size-cells':
    const: 0

  spi-max-frequency:
    maximum: 20000000

  interrupts:
    maxItems: 2

  interrupt-names:
    items:
      - const: irq0
      - const: irq1

  reset-gpios:
    description: |
      Must be the device tree identifier of the RESET pin. As the line is
      active low, it should be marked GPIO_ACTIVE_LOW.
    maxItems: 1

  vdd-supply: true

  vref-supply: true

patternProperties:
  "^channel@[0-2]$":
    $ref: /schemas/iio/adc/adc.yaml#
    type: object

    properties:
      reg:
        description: The channel number (0-2 for phases A, B, C)
        minimum: 0
        maximum: 2

    required:
      - reg

    additionalProperties: false

required:
  - compatible
  - reg
  - reset-gpios
  - interrupts
  - interrupt-names
  - vdd-supply

allOf:
  - $ref: /schemas/spi/spi-peripheral-props.yaml#

unevaluatedProperties: false

examples:
  - |
    #include <dt-bindings/gpio/gpio.h>
    #include <dt-bindings/interrupt-controller/irq.h>

    spi {
      #address-cells = <1>;
      #size-cells = <0>;

      adc@0 {
          compatible = "adi,ade9000";
          reg = <0>;
          spi-max-frequency = <7000000>;

          #address-cells = <1>;
          #size-cells = <0>;
          reset-gpios = <&gpio 4 GPIO_ACTIVE_LOW>;
          interrupts = <2 IRQ_TYPE_EDGE_FALLING>, <3 IRQ_TYPE_EDGE_FALLING>;
          interrupt-names = "irq0", "irq1";
          interrupt-parent = <&gpio>;
          vdd-supply = <&vdd_reg>;

          channel@0 {
            reg = <0>;
          };
          channel@1 {
            reg = <1>;
          };
          channel@2 {
            reg = <2>;
          };
      };
    };
```

## Documentation/devicetree/bindings/iio/adc/adi,adm1177.yaml
```yaml
# SPDX-License-Identifier: (GPL-2.0-only OR BSD-2-Clause)
%YAML 1.2
---
$id: http://devicetree.org/schemas/iio/adc/adi,adm1177.yaml#
$schema: http://devicetree.org/meta-schemas/core.yaml#

title: Analog Devices ADM1177 Hot Swap Controller and Digital Power Monitor

maintainers:
  - Michael Hennerich <michael.hennerich@analog.com>
  - Beniamin Bia <beniamin.bia@analog.com>

description: |
  Analog Devices ADM1177 Hot Swap Controller and Digital Power Monitor
  https://www.analog.com/media/en/technical-documentation/data-sheets/ADM1177.pdf

properties:
  compatible:
    enum:
      - adi,adm1177

  reg:
    maxItems: 1

  avcc-supply:
    description:
      Phandle to the Avcc power supply

  adi,r-sense-mohm:
    description:
      The value of curent sense resistor in milliohm. 

  adi,shutdown-threshold-ma:
    description:
      Specifies the current level at which an over current alert occurs.
      The value is stored on 8-bits. 

  adi,vrange-high-enable:
    description:
      Specifies which internal voltage divider to be used. A 1 selects
      a 7:2 voltage divider while a 0 selects a 14:1 voltage divider.
    type: boolean

required:
  - compatible
  - reg

additionalProperties: false

examples:
  - |
    #include <dt-bindings/gpio/gpio.h>
    #include <dt-bindings/interrupt-controller/irq.h>
    i2c {
        #address-cells = <1>;
        #size-cells = <0>;

        adc@2f {
                compatible = "adi,ad7091r5";
                reg = <0x2f>;
        };
    };
...
```

## Documentation/devicetree/bindings/iio/adc/adi,adrv903x.yaml
```yaml
# SPDX-License-Identifier: (GPL-2.0-only OR BSD-2-Clause)
# Copyright 2024 Analog Devices Inc.
%YAML 1.2
---
$id: http://devicetree.org/schemas/iio/adc/adi,adrv903x.yaml#
$schema: http://devicetree.org/meta-schemas/core.yaml#

title: Analog Devices ADRV9032/ADRV9032R RF Transceiver

maintainers:
  - Stefan Popa <stefan.popa@analog.com>

description: |
  The ADRV9032R is a highly integrated, RF agile transceiver offering two
  transmitters, two observation receivers for monitoring transmitter channels,
  two receivers, integrated local oscillator (LO) and clock synthesizers, and
  digital signal processing functions to provide a complete transceiver solution.

  The device provides high radio performance and low power consumption demanded
  by cellular infrastructure applications, software-defined radios, portable
  instruments, and military communications.

  The receiver and transmitter signal paths use a zero-IF (ZIF) architecture
  that provides wide bandwidth with dynamic range suitable for non-contiguous
  multicarrier applications.

  https://www.analog.com/en/products/adrv9032r.html
  https://analogdevicesinc.github.io/documentation/solutions/reference-designs/eval-adrv9032/index.html

properties:
  compatible:
    enum:
      - adi,adrv9032
      - adi,adrv9032r

  reg:
    maxItems: 1

  spi-max-frequency:
    maximum: 25000000

  interrupts:
    maxItems: 1
    description:
      GPIO interrupt pin (typically GPINT1)

  clocks:
    description:
      Device clock reference input
    maxItems: 1

  clock-names:
    const: dev_clk

  clock-output-names:
    description:
      Names for the clock outputs generated by the device
    items:
      - const: rx_sampl_clk
      - const: tx_sampl_clk
      - const: obs_sampl_clk

  '#clock-cells':
    const: 1

  jesd204-device:
    description:
      Indicates this device is part of JESD204 topology
    type: boolean

  '#jesd204-cells':
    const: 2

  jesd204-top-device:
    description:
      Indicates if this is the top device in JESD204 topology
    $ref: /schemas/types.yaml#/definitions/uint32
    enum: [0, 1]

  jesd204-inputs:
    description:
      JESD204 input connections from framers/deframers
    $ref: /schemas/types.yaml#/definitions/phandle-array

  adi,device-config-name:
    description:
      Firmware filename for device configuration profile binary
    $ref: /schemas/types.yaml#/definitions/string

  adi,arm-firmware-name:
    description:
      Firmware filename for ARM processor firmware
    $ref: /schemas/types.yaml#/definitions/string

  adi,stream-firmware-name:
    description:
      Firmware filename for stream processor image
    $ref: /schemas/types.yaml#/definitions/string

  adi,rx-gaintable-names:
    description:
      Filename for receiver gain table (CSV format)
    $ref: /schemas/types.yaml#/definitions/string

  adi,rx-gaintable-channel-masks:
    description:
      Bitmask indicating which RX channels use the gain table.
      Bit 0 = RX0, Bit 1 = RX1, etc.
    $ref: /schemas/types.yaml#/definitions/uint32

required:
  - compatible
  - reg
  - clocks
  - clock-names
  - adi,device-config-name
  - adi,arm-firmware-name
  - adi,stream-firmware-name

patternProperties:
  "^jesd204-":
    true

additionalProperties: false

examples:
  - |
    #include <dt-bindings/interrupt-controller/irq.h>

    spi {
        #address-cells = <1>;
        #size-cells = <0>;

        transceiver@0 {
            compatible = "adi,adrv9032r";
            reg = <0>;
            spi-max-frequency = <25000000>;

            interrupt-parent = <&gpio>;
            interrupts = <134 IRQ_TYPE_EDGE_RISING>;

            clocks = <&clk_generator 1>;
            clock-names = "dev_clk";

            clock-output-names = "rx_sampl_clk", "tx_sampl_clk", "obs_sampl_clk";
            #clock-cells = <1>;

            jesd204-device;
            #jesd204-cells = <2>;
            jesd204-top-device = <0>;
            jesd204-link-ids = <0 1 2>;

            jesd204-inputs = <&axi_rx_jesd 0 1>,
                           <&axi_rx_os_jesd 0 2>,
                           <&axi_tx_core 0 0>;

            adi,device-config-name = "ADRV9030_DeviceProfileTest_M4.bin";
            adi,arm-firmware-name = "ADRV9030_FW.bin";
            adi,stream-firmware-name = "ADRV9030_stream_image.bin";
            adi,rx-gaintable-names = "ADRV9030_RxGainTable.csv";
            adi,rx-gaintable-channel-masks = <0xFF>;
        };
    };
```
