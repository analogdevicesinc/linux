## Documentation/devicetree/bindings/iio/adc/adi,ltc2358.yaml
```yaml
# SPDX-License-Identifier: (GPL-2.0 OR BSD-2-Clause)
# Copyright 2023 Analog Devices Inc.
%YAML 1.2
---
$id: http://devicetree.org/schemas/iio/adc/adi,ltc2358.yaml#
$schema: http://devicetree.org/meta-schemas/core.yaml#

title: Analog Devices LTC235X Family

maintainers:
  - Kim Seer Paller <kimseer.paller@analog.com>

description: |
    The LTC235X family consist of buffered ADCs with differential ±10.24V inputs
    and 30VP-P common mode range.
    https://www.analog.com/media/en/technical-documentation/data-sheets/235316f.pdf
    https://www.analog.com/media/en/technical-documentation/data-sheets/235316f.pdf
    https://www.analog.com/media/en/technical-documentation/data-sheets/235716f.pdf
    https://www.analog.com/media/en/technical-documentation/data-sheets/235716f.pdf
    https://www.analog.com/media/en/technical-documentation/data-sheets/235816f.pdf
    https://www.analog.com/media/en/technical-documentation/data-sheets/235818f.pdf

properties:
  compatible:
    enum:
      - adi,ltc2353-16
      - adi,ltc2353-18
      - adi,ltc2357-16
      - adi,ltc2357-18
      - adi,ltc2358-16
      - adi,ltc2358-18

  reg:
    maxItems: 1

  spi-max-frequency:
    maximum: 100000000

  vref-supply:
    description: Voltage reference to establish input scaling.

  clocks:
    description: The clock for the ADC. This is the system clock.

  clock-names:
    items:
      - const: clkin

  pwms:
    maxItems: 1

  pwm-names:
    items:
      - const: cnv

  '#address-cells':
    const: 1

  '#size-cells':
    const: 0

patternProperties:
  "^channel@[0-7]$":
    type: object
    description: Represents the external channels which are connected to the ADC.

    properties:
      reg:
        description: Channel number.
        minimum: 0
        maximum: 7

      adi,softspan-code:
        $ref: /schemas/types.yaml#/definitions/uint32
        enum: [1, 2, 3, 4, 5, 6, 7]
        default: 7
        description: |
          The softspan code is used to set the input range of the ADC.
          The input range is set by the following formula:
          1: 0V to 1.25V * Vref
          2: ±1.25V *  Vref / 1.024
          3: ±1.25V * Vref
          4: 0V to 2.5V * Vref / 1.024
          5: 0V to 2.5V * Vref
          6: ±2.5V * Vref / 1.024
          7: ±2.5V * Vref

    required:
      - reg

required:
  - compatible
  - reg
  - clocks
  - clock-names
  - pwms
  - pwm-names

allOf:
  - $ref: /schemas/spi/spi-peripheral-props.yaml#

additionalProperties: false

examples:
  - |
    spi {
        #address-cells = <1>;
        #size-cells = <0>;

        adc@0 {
            compatible = "adi,ltc2358-18";
            reg = <0>;
            spi-max-frequency = <10000000>;

            #address-cells = <1>;
            #size-cells = <0>;

            clocks = <&sys_clk>;
            clock-names = "clkin";

            pwms = <&axi_pwm_gen 0 0>;
            pwm-names = "cnv";

            channel@0 {
                reg = <0>;
                adi,softspan-code = <1>;
            };

            channel@1 {
                reg = <1>;
                adi,softspan-code = <1>;
            };

            channel@2 {
                reg = <2>;
                adi,softspan-code = <2>;
            };

            channel@3 {
                reg = <3>;
                adi,softspan-code = <2>;
            };

            channel@4 {
                reg = <4>;
                adi,softspan-code = <3>;
            };

            channel@5 {
                reg = <5>;
                adi,softspan-code = <3>;
            };

            channel@6 {
                reg = <6>;
                adi,softspan-code = <4>;
            };

            channel@7 {
                reg = <7>;
                adi,softspan-code = <4>;
            };
        };
    };
...
```

## Documentation/devicetree/bindings/iio/adc/adi,ltc2376.yaml
```yaml
# SPDX-License-Identifier: (GPL-2.0-only OR BSD-2-Clause)
%YAML 1.2
---
title: Linear Technology LTC2376 SAR ADC

maintainers:
  - Meenal Parakh <meenalparakh18@gmail.com>

description: |
  Bindings for the Linear Technology LTC2376 16-bit SAR ADC device
  https://www.analog.com/media/en/technical-documentation/data-sheets/237616fa.pdf

properties:
  compatible:
    const: adi,ltc2376

  reg:
    maxItems: 1

  spi-max-frequency:
    maximum: 16000000

  vref-supply:
    description:
      Phandle to the vref power supply

  spi-cpol: true

  spi-cpha: true

  interrupts:
    maxItems: 1

required:
  - compatible
  - reg
  - spi-max-frequency
  - spi-cpol
  - spi-cpha
  - vref-supply
  - interrupts

additionalProperties: false

examples:
  - |
    #include <dt-bindings/interrupt-controller/irq.h>

    spi {
        #address-cells = <0x01>;
        #size-cells = <0x00>;

        adc@0{
              compatible = "adi,ltc2376";
              reg = <0>;
              spi-max-frequency = <16000000>;
              pwms = <&pwm 0 10000000>;
              vref-supply = <&adc_vref>;
              spi-cpha;
              spi-cpol;
              interrupt-parent = <&gpio>;
              interrupts = <25 IRQ_TYPE_EDGE_FALLING>;
        };
    };
...
```

## Documentation/devicetree/bindings/iio/adc/adi,ltc2471.yaml
```yaml
# SPDX-License-Identifier: (GPL-2.0-only OR BSD-2-Clause)
# Copyright 2020 Analog Devices Inc.
%YAML 1.2
---
$id: http://devicetree.org/schemas/bindings/iio/adc/adi,ltc2471.yaml#
$schema: http://devicetree.org/meta-schemas/core.yaml#

title: Analog Devices LTC2471 16-bit I2C Sigma-Delta ADC

maintainers:
  - Mike Looijmans <mike.looijmans@topic.nl>

description: |
  Analog Devices LTC2471 (single-ended) and LTC2473 (differential) 16-bit
  I2C Sigma-Delta ADC with selectable 208/833sps output rate.
  https://www.analog.com/media/en/technical-documentation/data-sheets/24713fb.pdf

  Analog Devices LTC2461 (single-ended) and LTC2463 (differential) 16-bit
  I2C Sigma-Delta ADC with 60sps output rate.
  https://www.analog.com/media/en/technical-documentation/data-sheets/24613fa.pdf

properties:
  compatible:
    enum:
      - adi,ltc2471
      - adi,ltc2473
      - adi,ltc2461
      - adi,ltc2463

  reg:
    maxItems: 1

required:
  - compatible
  - reg

examples:
  - |
    i2c0 {
      ltc2461@14 {
        compatible = "ltc2461";
        reg = <0x14>;
      };
    };
  - |
    i2c0 {
      ltc2473@54 {
        compatible = "ltc2473";
        reg = <0x54>;
      };
    };
```

## Documentation/devicetree/bindings/iio/adc/adi,max14001.yaml
```yaml
# SPDX-License-Identifier: (GPL-2.0-only OR BSD-2-Clause)
# Copyright 2025 Marilene Andrade Garcia
%YAML 1.2
---
$id: http://devicetree.org/schemas/iio/adc/adi,max14001.yaml#
$schema: http://devicetree.org/meta-schemas/core.yaml#

title: Analog Devices MAX14001-MAX14002 10-bit ADCs

maintainers:
  - Marilene Andrade Garcia <marilene.agarcia@gmail.com>

description:
  Bindings for the Analog Devices MAX14001-MAX14002 Configurable,
  Isolated 10-bit ADCs for Multi-Range Binary Inputs.

  Datasheet can be found here
    https://www.analog.com/media/en/technical-documentation/data-sheets/MAX14001-MAX14002.pdf

$ref: /schemas/spi/spi-peripheral-props.yaml#

properties:
  compatible:
    enum:
      - adi,max14001
      - adi,max14002

  reg:
    maxItems: 1

  vdd-supply:
    description:
      Isolated DC-DC power supply input voltage.

  vddl-supply:
    description:
      Logic power supply.

  vrefin-supply:
    description:
      ADC voltage reference supply.

  interrupts:
    items:
      - description: |
          Interrupt for signaling when conversion results exceed the configured
          upper threshold for ADC readings or fall below the lower threshold for
          them. Interrupt source must be attached to COUT pin.
      - description: |
          Alert output that asserts low during a number of different error
          conditions. The interrupt source must be attached to FAULT pin.

  spi-max-frequency:
    maximum: 5000000

required:
  - compatible
  - reg
  - vdd-supply
  - vddl-supply

unevaluatedProperties: false

examples:
  - |
    spi {
      #address-cells = <1>;
      #size-cells = <0>;

      max14001: adc@0 {
        compatible = "adi,max14001";
        reg = <0>;
        spi-max-frequency = <5000000>;
        vdd-supply = <&vdd>;
        vddl-supply = <&vddl>;
      };
    };
...
```

## Documentation/devicetree/bindings/iio/adc/adi,max22531.yaml
```yaml
# SPDX-License-Identifier: (GPL-2.0-only OR BSD-2-Clause)
# Copyright 2025 Abhinav Jain
%YAML 1.2
---
$id: http://devicetree.org/schemas/iio/adc/adi,max22531.yaml#
$schema: http://devicetree.org/meta-schemas/core.yaml#

title: Analog Devices MAX22530-MAX22532 12-bit Field Isolated ADCs

maintainers:
  - Abhinav Jain <jain.abhinav177@gmail.com>

description:
  Bindings for the Analog Devices Max22530-MAX22532 Field-Side Self-Powered,
  4-Channel, 12-bit, Isolated ADCs.

  Datasheet can be found here
    https://www.analog.com/media/en/technical-documentation/data-sheets/max22530-max22532.pdf

$ref: /schemas/spi/spi-peripheral-props.yaml#

properties:
  compatible:
    enum:
      - adi,max22530
      - adi,max22531
      - adi,max22532

  reg:
    maxItems: 1

  spi-max-frequency:
    maximum: 10000000
    description: Maximum SPI frequency (Hz)

  vddl-supply:
    description:
      Logic power supply.

  vddpl-supply:
    description:
      Isolated DC-DC converter power supply.

  interrupts:
    items:
      - description: |
          Interrupt for signaling when conversion results exceed the upper
          threshold for ADC readings or fall below the lower threshold. The
          interrupt source must be attached to one of COUT1 to COUT4 pins.
      - description: |
          Alert output that asserts low during a number of different error
          conditions. The interrupt source must be attached to INT pin.

required:
  - compatible
  - reg
  - vddl-supply
  - vddpl-supply

additionalProperties: false

examples:
  - |
    spi {
      #address-cells = <1>;
      #size-cells = <0>;

      max22531: adc@0 {
        compatible = "adi,max22531";
        reg = <0>;
        spi-max-frequency = <5000000>;
        vddl-supply = <&vddl>;
        vddpl-supply = <&vddpl>;
      };
    };
```

## Documentation/devicetree/bindings/iio/adc/adi,max77541-adc.yaml
```yaml
# SPDX-License-Identifier: GPL-2.0-only OR BSD-2-Clause
%YAML 1.2
---
$id: http://devicetree.org/schemas/iio/adc/adi,max77541-adc.yaml#
$schema: http://devicetree.org/meta-schemas/core.yaml#

title: ADC driver for MAX77541

maintainers:
  - Okan Sahin <okan.sahin@analog.com>

description: |
  This is a part of device tree bindings for Analog Devices MAX77541

  The adc is represented as a sub-node of the PMIC node on the device tree.

  The device has an adc. Family of ADCs with i2c inteface, internal references and threshold
  monitoring.

  See also Documentation/devicetree/bindings/mfd/adi,max77541.yaml for
  additional information and example.

properties:
  compatible:
    const: adi,max77541-adc

required:
  - compatible

additionalProperties: false
```
