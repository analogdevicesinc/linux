## Documentation/devicetree/bindings/iio/adc/adi,adrv9040.yaml
```yaml
# SPDX-License-Identifier: (GPL-2.0-only OR BSD-2-Clause)
%YAML 1.2
---
$id: http://devicetree.org/schemas/iio/adc/adi,adrv9040.yaml#
$schema: http://devicetree.org/meta-schemas/core.yaml#

title: Analog Devices ADRV904X RF Transceiver

maintainers:
  - Stefan Popa <stefan.popa@analog.com>
  - George Mois <george.mois@analog.com>

description: |
  The ADRV904X is a highly integrated RF transceiver supporting 8 transmitter
  and 8 receiver channels with observation receivers, designed for cellular
  infrastructure applications. It integrates digital front-end (DFE) processing,
  JESD204B/C interface, and advanced calibration features.

properties:
  compatible:
    enum:
      - adi,adrv9040

  reg:
    maxItems: 1

  spi-max-frequency:
    maximum: 25000000

  clocks:
    items:
      - description: Device clock input

  clock-names:
    items:
      - const: dev_clk

  clock-output-names:
    minItems: 1
    maxItems: 3
    description: |
      Names for the output clocks. Typically includes rx_sampl_clk,
      obs_sampl_clk, and tx_sampl_clk.

  '#clock-cells':
    const: 1

  reset-gpios:
    maxItems: 1
    description: GPIO for device reset control

  interrupts:
    maxItems: 1
    description: Interrupt from the device for events like JESD errors

  adi,device-config-name:
    $ref: /schemas/types.yaml#/definitions/string
    description: |
      Filename of the device profile binary configuration file. This file
      contains the device initialization configuration.

  adi,arm-firmware-name:
    $ref: /schemas/types.yaml#/definitions/string
    description: Filename of the ARM firmware binary for the main CPU.

  adi,arm-dfe-firmware-name:
    $ref: /schemas/types.yaml#/definitions/string
    description: Filename of the ARM firmware binary for the DFE (Digital Front End) CPU.

  adi,stream-firmware-name:
    $ref: /schemas/types.yaml#/definitions/string
    description: Filename of the stream processor firmware binary.

  adi,rx-gaintable-names:
    $ref: /schemas/types.yaml#/definitions/string-array
    description: |
      Array of filenames for RX gain table CSV files. Each entry corresponds
      to a gain table configuration.

  adi,rx-gaintable-channel-masks:
    $ref: /schemas/types.yaml#/definitions/uint32-array
    description: |
      Array of channel masks indicating which RX channels use the corresponding
      gain table from adi,rx-gaintable-names. Each mask is a bit field where
      bit N represents RX channel N.

  adi,tx-attntable-names:
    $ref: /schemas/types.yaml#/definitions/string-array
    description: |
      Array of filenames for TX attenuation table CSV files. Each entry
      corresponds to an attenuation table configuration.

  adi,tx-attntable-channel-masks:
    $ref: /schemas/types.yaml#/definitions/uint32-array
    description: |
      Array of channel masks indicating which TX channels use the corresponding
      attenuation table from adi,tx-attntable-names. Each mask is a bit field
      where bit N represents TX channel N.

  jesd204-device:
    type: boolean
    description: Indicates this device is a JESD204 device.

  '#jesd204-cells':
    const: 2

  jesd204-top-device:
    $ref: /schemas/types.yaml#/definitions/uint32
    description: |
      Indicates if this is the top device in the JESD204 topology.
      Set to 0 for the top device.

  jesd204-link-ids:
    minItems: 1
    maxItems: 5
    description: |
      Array of JESD204 link IDs used by this device. Typically includes
      deframer and framer link identifiers.

  jesd204-inputs:
    $ref: /schemas/types.yaml#/definitions/phandle-array
    description: |
      Phandle references to JESD204 input devices with their link IDs.
      Format: <&phandle port_id link_id>

required:
  - compatible
  - reg
  - clocks
  - clock-names
  - adi,device-config-name
  - adi,arm-firmware-name
  - adi,arm-dfe-firmware-name
  - adi,stream-firmware-name

additionalProperties: false

examples:
  - |
    #include <dt-bindings/interrupt-controller/irq.h>
    #include <dt-bindings/iio/adc/adi,adrv904x.h>
    #include <dt-bindings/gpio/gpio.h>

    spi {
        #address-cells = <1>;
        #size-cells = <0>;

        adrv904x@0 {
            compatible = "adi,adrv9040";
            reg = <0>;
            spi-max-frequency = <25000000>;

            interrupt-parent = <&gpio>;
            interrupts = <134 IRQ_TYPE_EDGE_RISING>;

            clocks = <&clk_ad9528 1>;
            clock-names = "dev_clk";

            clock-output-names = "rx_sampl_clk", "tx_sampl_clk", "obs_sampl_clk";
            #clock-cells = <1>;

            reset-gpios = <&gpio 134 GPIO_ACTIVE_LOW>;

            adi,device-config-name = "DeviceProfileTest.bin";
            adi,arm-firmware-name = "ADRV9040_FW.bin";
            adi,arm-dfe-firmware-name = "ADRV9040_DFE_CALS_FW.bin";
            adi,stream-firmware-name = "stream_image.bin";
            adi,rx-gaintable-names = "ADRV9040_RxGainTable.csv";
            adi,rx-gaintable-channel-masks = <0xFF>;

            jesd204-device;
            #jesd204-cells = <2>;
            jesd204-top-device = <0>;
            jesd204-link-ids = <DEFRAMER0_LINK_TX FRAMER0_LINK_RX>;
        };
    };
...
```

## Documentation/devicetree/bindings/iio/adc/adi,axi-ad7606.yaml
```yaml
# SPDX-License-Identifier: (GPL-2.0-only OR BSD-2-Clause)
%YAML 1.2
---
$id: http://devicetree.org/schemas/iio/adc/adi,axi-ad7606.yaml#
$schema: http://devicetree.org/meta-schemas/core.yaml#

title: Analog Devices AD7606 Simultaneous Sampling ADC - Parallel Interface

maintainers:
  - Alin-Tudor Sferle <alin-tudor.sferle@analog.com>
  - Marcelo Schmitt <marcelo.schmitt@analog.com>

description: |
  Analog Devices AD7606x Simultaneous Sampling ADC - Parallel Interface
  https://www.analog.com/media/en/technical-documentation/data-sheets/ad7606c-16.pdf
  https://www.analog.com/media/en/technical-documentation/data-sheets/ad7606c-18.pdf

properties:

  compatible:
    enum:
      - axi-ad7606c-16
      - axi-ad7606c-18

  clocks:
    maxItems: 1
    description:
      Sampling clock

  clock-names:
    maxItems: 1
    description:
      Names of used clock in tree

  pwms:
    maxItems: 1
    description:
      PWM signal used to start the sampling procedure

  pwm-names:
    items:
      - const: cnvst_n

  reset-gpios:
    maxItems: 1

required:
  - compatible
  - clocks
  - clock-names
  - pwms
  - pwm-names

unevaluatedProperties: false

examples:
  - |
    #include <dt-bindings/interrupt-controller/irq.h>
    #include <dt-bindings/gpio/gpio.h>
    #include <dt-bindings/pwm/pwm.h>

    axi_ad7606: axi-ad7606 {
        compatible = "axi-ad7606c-16";

        pwms = <&axi_pwm_gen 0 0>;
        pwm-names = "cnvst_n";

        clocks = <&ext_clk>;
        clock-names = "ad7606_conv_clk";

        reset-gpios = <&gpio0 95 GPIO_ACTIVE_HIGH>;
    };

    fpga_axi {
        #address-cells = <1>;
        #size-cells = <1>;

        rx_dma: dmac@44a30000 {
            compatible = "adi,axi-dmac-1.00.a";
            reg = <0x44a30000 0x1000>;
            #dma-cells = <1>;
            interrupts = <0 57 IRQ_TYPE_LEVEL_HIGH>;
            clocks = <&ext_clk>;

            adi,channels {
                #size-cells = <0>;
                #address-cells = <1>;

                dma-channel@0 {
                    reg = <0>;
                    adi,source-bus-width = <128>;
                    adi,source-bus-type = <2>;
                    adi,destination-bus-width = <64>;
                    adi,destination-bus-type = <0>;
                };
            };
        };

        cf_axi_adc@44a00000 {
            compatible = "adi,axi-ad7606-1.0";
            reg = <0x44a00000 0x20000>;
            dmas = <&rx_dma 0>;
            dma-names = "rx";
            platformbus-connected = <&axi_ad7606>;
        };
    };
...
```

## Documentation/devicetree/bindings/iio/adc/adi,axi-pulse-capture.txt
```
 Analog Device AXI Pulse and Laser driver controller

Required properties:
 - compatible: Must be "adi,axi-pulse-capture-1.00.a".
 - reg: Specification for the controllers memory mapped register map.
 - interrupts: Specification for the controllers interrupt.
 - clocks: Phandle and specifier to the controllers AXI interface clock.

Example:

axi_pulse_capture: axi-pulse-capture@7c700000 {
	compatible = "adi,axi-pulse-capture-1.00.a";
	reg = <0x7c700000 0x10000>;
	interrupts = <0 52 0>;
	clocks = <&clkc 17>;
};
```

## Documentation/devicetree/bindings/iio/adc/adi,axi-pulse-capture.yaml
```yaml
%YAML 1.2
---
$id: http://devicetree.org/schemas/bindings/iio/adc/adi,axi-pulse-capture.yaml#
$schema: http://devicetree.org/meta-schemas/core.yaml#

title: Analog Devices AXI Pulse Capture Device Tree Bindings

maintainers:
  - Nuno Sá <nuno.sa@analog.com>

description: |
  Analog Devices AXI Pulse Capture IP Core
  This core controls the state of a laser driver and a pulse generator signal.

properties:
  compatible:
    enum:
      - adi,axi-pulse-capture-1.00.a

  reg:
    maxItems: 1

  interrupts:
    maxItems: 1

  clocks:
    maxItems: 1

required:
- compatible
- reg
- interrupts
- clocks

examples:
  - |
    fpga_axi: fpga-axi@0 {
            #address-cells = <0x1>;
            #size-cells = <0x1>;

            axi_pulse_capture: axi-pulse-capture@7c700000 {
                    compatible = "adi,axi-pulse-capture-1.00.a";
                    reg = <0x7c700000 0x10000>;
                    clocks = <&clkc 17>;
                    interrupts = <0 52 0>;
            };
    };
...
```

## Documentation/devicetree/bindings/iio/adc/adi,hadc.yaml
```yaml
# SPDX-License-Identifier: (GPL-2.0-only OR BSD-2-Clause)
%YAML 1.2
---
$id: http://devicetree.org/schemas/thermal/adi,sc59x-thermal.yaml#
$schema: http://devicetree.org/meta-schemas/core.yaml#

title: Analog Devices Housekeeping ADC for SC59x 64-bit Family Processors

maintainers:
  - Nathan Barrett-Morrison <nathan.morrison@timesys.com>
  - Greg Malysa <greg.malysa@timesys.com>

description: |
  The HADC provides the analog to digital conversion capability
  for general-purpose housekeeping tasks, such as
  voltage and temperature monitoring. The core of HADC is a 12-bit
  SAR ADC, providing multiple analog input channels.

properties:
  compatible:
    enum:
      - adi,hadc

  reg:
    maxItems: 1

  "#iio-cells":
    const: 1

  interrupt-parent:
    maxItems: 1

  interrupts:
    maxItems: 1
    minItems: 1

required:
  - compatible
  - reg
  - "#iio-cells"
  - interrupt-parent
  - interrupts

additionalProperties: false

examples:
  - |
    hadc: hadc@0x31016000 {
      compatible = "adi,hadc";
      reg = <0x31016000 0x100>;
      interrupt-parent = <&gic>;
      interrupts = <GIC_SPI 186 IRQ_TYPE_EDGE_RISING>;
      #iio-cells = <1>;
      status = "okay";
    };
```

## Documentation/devicetree/bindings/iio/adc/adi,hmcad15xx.yaml
```yaml
# SPDX-License-Identifier: (GPL-2.0-only OR BSD-2-Clause)
# Copyright 2025 Analog Devices Inc.
%YAML 1.2
---
$id: http://devicetree.org/schemas/iio/adc/adi,hmcad15xx.yaml#
$schema: http://devicetree.org/meta-schemas/core.yaml#

title: Analog Devices HMCAD15xx High-Speed ADC

maintainers:
  - Paul Pop <paul.pop@analog.com>

description: |
  The HMCAD1511 and HMCAD1520 are high-speed analog-to-digital converters
  with LVDS outputs. The HMCAD1511 is a 12-bit ADC supporting up to 1 GSPS
  in single-channel mode. The HMCAD1520 is a 14-bit ADC supporting up to
  105 MSPS in quad-channel precision mode.

  Both devices support flexible channel configurations:
    - Single channel: highest sample rate
    - Dual channel: half sample rate per channel
    - Quad channel: quarter sample rate per channel

  The driver supports 8-bit, 12-bit, and 14-bit resolution modes with
  appropriate LVDS output configurations.

  https://www.ti.com/product/HMCAD1511
  https://www.ti.com/product/HMCAD1520

properties:
  compatible:
    const: adi,hmcad15xx

  reg:
    maxItems: 1

  clocks:
    maxItems: 1
    description:
      ADC input clock. Maximum frequency depends on resolution and channel
      configuration.

  clock-names:
    const: clk

  reset-gpios:
    maxItems: 1
    description:
      Active low GPIO for hardware reset.

  pd-gpios:
    maxItems: 1
    description:
      Active high GPIO for power down control.

  adi,num-channels:
    $ref: /schemas/types.yaml#/definitions/uint32
    enum: [1, 2, 4]
    default: 1
    description:
      Number of ADC channels to enable. Affects sample rate per channel.

  adi,resolution:
    $ref: /schemas/types.yaml#/definitions/uint32
    enum: [8, 12, 14]
    default: 8
    description: |
      ADC resolution in bits.
        8-bit:  High-speed mode, up to 1000/500/250 MSPS for 1/2/4 channels
        12-bit: Mid-speed mode, up to 660/330/165 MSPS for 1/2/4 channels
        14-bit: Precision mode, dual 8-bit LVDS, up to 105 MSPS

  adi,pol-mask:
    $ref: /schemas/types.yaml#/definitions/uint32
    default: 0
    description:
      8-bit polarity mask for LVDS data lanes. Each bit controls the
      polarity inversion of one LVDS lane. Used to compensate for PCB
      routing constraints.

allOf:
  - $ref: /schemas/spi/spi-peripheral-props.yaml#

required:
  - compatible
  - reg
  - clocks
  - clock-names

unevaluatedProperties: false

examples:
  - |
    #include <dt-bindings/gpio/gpio.h>

    spi {
        #address-cells = <1>;
        #size-cells = <0>;

        adc@0 {
            compatible = "adi,hmcad15xx";
            reg = <0>;
            clocks = <&adc_clk>;
            clock-names = "clk";
            reset-gpios = <&gpio0 87 GPIO_ACTIVE_LOW>;
            pd-gpios = <&gpio0 86 GPIO_ACTIVE_HIGH>;
            adi,num-channels = <1>;
            adi,resolution = <12>;
            adi,pol-mask = <239>;
        };
    };
...
```

## Documentation/devicetree/bindings/iio/adc/adi,ltc2308.yaml
```yaml
# SPDX-License-Identifier: (GPL-2.0-only OR BSD-2-Clause)
# Copyright 2020 Analog Devices Inc.
%YAML 1.2
---
$id: http://devicetree.org/schemas/bindings/iio/adc/adi,ltc2308.yaml#
$schema: http://devicetree.org/meta-schemas/core.yaml#

title: Linear Technology LTC2308 ADC device driver

maintainers:
  - Sergiu Cuciurean <sergiu.cuciurean@analog.com>

description: |
  The LTC ® 2308 is a low noise, 500ksps, 8-channel, 12-bit ADC

properties:
  compatible:
    enum:
      - adi,ltc2308

  reg:
    maxItems: 1

  cnv-gpios:
    description:
      Conversion start pin, used to trigger a transfer sequence

patternProperties:
  "^channel@([0-15])$":
    type: object
    description: Represents one input channel

    properties:
      reg:
        description: Represents the index of a single-ended channel
        minimum: 0
        maximum: 7

      diff-channels:
        description: see Documentation/devicetree/bindings/iio/adc/adc.txt
        items:
          minimum: 0
          maximum: 7

      bipolar:
        description: see Documentation/devicetree/bindings/iio/adc/adc.txt
        type: boolean

    required:
      - reg
      - diff-channels

required:
  - compatible
  - cnv-gpios

examples:
  - |
    ltc2308: adc@0 {
            compatible = "adi,ltc2308";
            reg = <0>;
            #address-cells = <1>;
            #size-cells = <0>;
            spi-max-frequency = <40000000>;
            cnv-gpios = <&gpio 1 GPIO_ACTIVE_HIGH>;
            channel@0 {
                    reg = <0>;
            };
            channel@1 {
                    reg = <1>;
                    bipolar;
            };
            channel@2 {
                    diff-channels = <2 3>;
            };
            channel@3 {
                    diff-channels = <5 4>;
                    bipolar;
            };
    };
```
