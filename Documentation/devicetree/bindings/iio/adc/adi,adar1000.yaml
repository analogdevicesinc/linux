## Documentation/devicetree/bindings/iio/adc/adi,pulsar.yaml
```yaml
# SPDX-License-Identifier: (GPL-2.0-only OR BSD-2-Clause)
%YAML 1.2
---
$id: http://devicetree.org/schemas/iio/adc/adi,pulsar.yaml#
$schema: http://devicetree.org/meta-schemas/core.yaml#

title: Analog Devices PulSAR Analog to Digital Converters

maintainers:
  - Ciprian Hegbeli <ciprian.hegbeli@analog.com>

description: |
  Analog Devices PulSAR family Analog to Digital Converters with SPI support
    https://www.analog.com/en/products/ad7988-5.html
    https://www.analog.com/en/products/ad7988-1.html
    https://www.analog.com/en/products/ad7986.html
    https://www.analog.com/en/products/ad7985.html
    https://www.analog.com/en/products/ad7984.html
    https://www.analog.com/en/products/ad7983.html
    https://www.analog.com/en/products/ad7982.html
    https://www.analog.com/en/products/ad7980.html
    https://www.analog.com/en/products/ad7949.html
    https://www.analog.com/en/products/ad7944.html
    https://www.analog.com/en/products/ad7946.html
    https://www.analog.com/en/products/ad7942.html
    https://www.analog.com/en/products/ad7699.html
    https://www.analog.com/en/products/ad7693.html
    https://www.analog.com/en/products/ad7691.html
    https://www.analog.com/en/products/ad7690.html
    https://www.analog.com/en/products/ad7689.html
    https://www.analog.com/en/products/ad7688.html
    https://www.analog.com/en/products/ad7687.html
    https://www.analog.com/en/products/ad7686.html
    https://www.analog.com/en/products/ad7685.html
    https://www.analog.com/en/products/ad7682.html
    https://www.analog.com/en/products/ad4022.html
    https://www.analog.com/en/products/ad4021.html
    https://www.analog.com/en/products/ad4020.html
    https://www.analog.com/en/products/ad4011.html
    https://www.analog.com/en/products/ad4007.html
    https://www.analog.com/en/products/ad4003.html
    https://www.analog.com/en/products/adaq4003.html

$ref: /schemas/spi/spi-peripheral-props.yaml#

properties:
  compatible:
    enum:
      - adi,pulsar,ad7988-5
      - adi,pulsar,ad7988-1
      - adi,pulsar,ad7986
      - adi,pulsar,ad7985
      - adi,pulsar,ad7984
      - adi,pulsar,ad7983
      - adi,pulsar,ad7982
      - adi,pulsar,ad7980
      - adi,pulsar,ad7949
      - adi,pulsar,ad7946
      - adi,pulsar,ad7944
      - adi,pulsar,ad7942
      - adi,pulsar,ad7699
      - adi,pulsar,ad7693
      - adi,pulsar,ad7691
      - adi,pulsar,ad7690
      - adi,pulsar,ad7689
      - adi,pulsar,ad7688
      - adi,pulsar,ad7687
      - adi,pulsar,ad7686
      - adi,pulsar,ad7685
      - adi,pulsar,ad7682
      - adi,pulsar,ad4022
      - adi,pulsar,ad4021
      - adi,pulsar,ad4020
      - adi,pulsar,ad4011
      - adi,pulsar,ad4007
      - adi,pulsar,ad4003
      - adi,pulsar,adaq4003

  '#address-cells':
    const: 1

  '#size-cells':
    const: 0

  reg: true
  spi-max-frequency: true

  clocks:
    maxItems: 1

  clock-names:
    const: ref_clk
    description: PulSAR reference clock name.

  dmas:
    maxItems: 1

  dma-names:
    const: rx

  pwms:
    description: |
      PWM used as trigger source for the SPI engine, also represents the
      acquisition rate for the samples.
    maxItems: 1

  pwm-names:
    const: cnv

  vref-supply:
    description: Voltage regulator for the reference voltage.

  turbo-gpios:
    maxItems: 1
    description:
      GPIO used to enable the turbo mode. This mode is used to increase the
      sampling rate of the ADC at the expense of power consumption.

patternProperties:
  "^channel@([0-8])$":
    type: object
    description: Configurations of the ADC Channels

    unevaluatedProperties: false

    properties:
      reg: true

      adi,temp-sensor:
        description: Sets the channel to be configured as a temperature sensor.
        type: boolean

      diff-channels:
        description: see Documentation/devicetree/bindings/iio/adc/adc.yaml
        maxItems: 1

      adi,single-channel:
        description: The channel number representing the ADC input channel.
        $ref: /schemas/types.yaml#/definitions/uint32

      bipolar:
        description: see Documentation/devicetree/bindings/iio/adc/adc.yaml
        type: boolean

    required:
      - reg

allOf:
  - if:
      properties:
        compatible:
          contains:
            enum:
              - adi,pulsar,ad7949
              - adi,pulsar,ad7699
              - adi,pulsar,ad7689
              - adi,pulsar,ad7682

    then:
      patternProperties:
        "^channel@([0-8])$":

          oneOf:
            # Only one property can be used at a time per channel
            - required:
                - adi,single-channel

            - required:
                - diff-channels

            - required:
                - adi,temp-sensor

    else:
      patternProperties:
        "^channel@([0-8])$":
          required:
            - adi,single-channel

  - if:
      properties:
        compatible:
          contains:
            enum:
              - adi,pulsar,ad7986
              - adi,pulsar,ad7985
              - adi,pulsar,ad7944
    then:
      required:
        - turbo-gpios

required:
  - compatible
  - reg
  - clocks
  - clock-names
  - dmas
  - dma-names
  - pwms
  - pwm-names
  - vref-supply

additionalProperties: false

examples:
  - |
    spi {
        #address-cells = <1>;
        #size-cells = <0>;
        adc@0 {
                #address-cells = <1>;
                #size-cells = <0>;
                compatible = "adi,pulsar,ad7689";
                reg = <0>;
                spi-max-frequency = <80000000>;
                clocks = <&spi_clk>;
                clock-names = "ref_clk";
                dmas = <&rx_dma 0>;
                dma-names = "rx";
                pwms = <&adc_trigger 0 0>;
                pwm-names = "cnv";
                vref-supply = <&vref>;
                channel@0 {
                        reg = <0>;
                        diff-channels = <0 1>;
                };
                channel@1 {
                        reg = <1>;
                        diff-channels = <2 3>;
                };
                channel@2 {
                        reg = <2>;
                        adi,single-channel = <4>;
                };
                channel@3 {
                        reg = <3>;
                        adi,single-channel = <5>;
                };
                channel@4 {
                        reg = <4>;
                        adi,single-channel = <6>;
                };
                channel@5 {
                        reg = <5>;
                        adi,single-channel = <7>;
                };
                channel@6 {
                        reg = <6>;
                        adi,temp-sensor;
                };
        };
    };
...
```

## Documentation/devicetree/bindings/iio/adc/adi,quad-ad7768-1.yaml
```yaml
# SPDX-License-Identifier: GPL-2.0
# Copyright 2024 Analog Devices Inc.
%YAML 1.2
---
$id: http://devicetree.org/schemas/iio/adc/adi,quad-ad7768-1.yaml#
$schema: http://devicetree.org/meta-schemas/core.yaml#

title: Analog Devices quad AD7768-1 ADC device driver

maintainers:
  - Marcelo Schmitt <marcelo.schmitt@analog.com>

description: |
  Analog Devices 4-device (quad) bundle of AD7768-1 ADCs

  https://www.analog.com/media/en/technical-documentation/data-sheets/ad7768-1.pdf
  https://www.analog.com/media/en/technical-documentation/data-sheets/adaq7767-1.pdf
  https://www.analog.com/media/en/technical-documentation/data-sheets/adaq7768-1.pdf
  https://www.analog.com/media/en/technical-documentation/data-sheets/adaq7769-1.pdf

properties:
  compatible:
    enum:
      - adi,quad-ad7768-1
      - adi,quad-adaq7767-1
      - adi,quad-adaq7768-1
      - adi,quad-adaq7769-1

  reg:
    maxItems: 1

  clocks:
    maxItems: 1

  clock-names:
    const: mclk

  interrupts:
    maxItems: 1

  '#address-cells':
    const: 1

  '#size-cells':
    const: 0

  vref-supply:
    description:
      ADC reference voltage supply

  adi,gain-milli:
    description: |
      Specifies the analog anti-aliasing filter (AAF) gain applied
      to the ADC input, in milli-units. Required for ADAQ7767-1 and
      ADAQ7769-1 devices, the gain is determined by the pin selection
      (IN1, IN2, IN3) on the ADAQ7767-1 or the connections of OUT_PGA
      with IN1_AAF, IN2_AAF, or IN3_AAF on the ADAQ7769-1.
    $ref: /schemas/types.yaml#/definitions/uint16
    enum: [143, 364, 1000]

  adi,sync-in-gpios:
    maxItems: 1
    description:
      Enables synchronization of multiple devices that require simultaneous
      sampling. A pulse is always required if the configuration is changed
      in any way, for example if the filter decimation rate changes.
      As the line is active low, it should be marked GPIO_ACTIVE_LOW.

  adi,sync-in-spi:
    description:
      Enables synchronization of multiple devices over SPI. This property is
      used when a signal synchronous to the base MCLK signal cannot be provided
      via GPIO. It requires the SYNC_OUT pin to be connected to the SYNC_IN pin
      on the ADC. In the case of multiple devices, the SYNC_OUT pin of one device
      should be routed to the SYNC_IN pins of the other devices.

  reset-gpios:
    maxItems: 1

  spi-cpol: true

  spi-cpha: true

  "#io-channel-cells":
    const: 1

required:
  - compatible
  - reg
  - clocks
  - clock-names
  - vref-supply
  - spi-cpol
  - spi-cpha

allOf:
  # adi,sync-in-gpios and adi,sync-in-spi are mutually exclusive (neither is also valid)
  - if:
      required:
        - adi,sync-in-gpios
    then:
      properties:
        adi,sync-in-spi: false
  - if:
      required:
        - adi,sync-in-spi
    then:
      properties:
        adi,sync-in-gpios: false
  # Gain property only applies to ADAQ7767-1 and ADAQ7769-1 devices
  - if:
      properties:
        compatible:
          not:
            contains:
              enum:
                - adi,adaq7767-1
                - adi,adaq7769-1
    then:
      properties:
        adi,gain-milli: false

patternProperties:
  "^channel@([0-9]|1[0-5])$":
    type: object
    description: |
      Represents the external channels which are connected to the device.

    properties:
      reg:
        maxItems: 1
        description: |
          The channel number.

      label:
        description: |
          Unique name to identify which channel this is.
    required:
      - reg
    additionalProperties: false

allOf:
  - $ref: /schemas/spi/spi-peripheral-props.yaml#

unevaluatedProperties: false

examples:
  - |
    #include <dt-bindings/interrupt-controller/irq.h>
    #include <dt-bindings/gpio/gpio.h>
    spi {
        #address-cells = <1>;
        #size-cells = <0>;
        adc@4 {
            compatible = "adi,quad-adaq7768-1";
            #reg = <0, 1, 2, 3>;
            reg = <4>;

            spi-max-frequency = <2000000>;
            spi-cpol;
            spi-cpha;
            vref-supply = <&adc_vref>;
            interrupts = <25 IRQ_TYPE_EDGE_RISING>;
            interrupt-parent = <&gpio>;
            adi,sync-in-gpios = <&gpio 22 GPIO_ACTIVE_LOW>;
            reset-gpios = <&gpio 27 GPIO_ACTIVE_LOW>;
            clocks = <&ad7768_mclk>;
            clock-names = "mclk";

            adc0 = <&adc0>;
            adc1 = <&adc1>;
            adc2 = <&adc2>;
            adc3 = <&adc3>;
        };

        adc0: adc@0 {
            compatible = "adi,ad7768-1";
            reg = <0>;
            spi-max-frequency = <2000000>;
            spi-cpol;
            spi-cpha;
            vref-supply = <&adc_vref>;
            interrupts = <25 IRQ_TYPE_EDGE_RISING>;
            interrupt-parent = <&gpio>;
            adi,sync-in-gpios = <&gpio 22 GPIO_ACTIVE_LOW>;
            reset-gpios = <&gpio 27 GPIO_ACTIVE_LOW>;
            clocks = <&ad7768_mclk>;
            clock-names = "mclk";

            #address-cells = <1>;
            #size-cells = <0>;

            channel@0 {
                reg = <0>;
                label = "channel_0";
            };
        };
        adc1: adc@1 {
            compatible = "adi,ad7768-1";
            reg = <1>;
            spi-max-frequency = <2000000>;
            spi-cpol;
            spi-cpha;
            vref-supply = <&adc_vref>;
            interrupts = <25 IRQ_TYPE_EDGE_RISING>;
            interrupt-parent = <&gpio>;
            adi,sync-in-gpios = <&gpio 22 GPIO_ACTIVE_LOW>;
            reset-gpios = <&gpio 27 GPIO_ACTIVE_LOW>;
            clocks = <&ad7768_mclk>;
            clock-names = "mclk";

            #address-cells = <1>;
            #size-cells = <0>;

            channel@0 {
                reg = <0>;
                label = "channel_0";
            };
        };
        adc2: adc@2 {
            compatible = "adi,ad7768-1";
            reg = <2>;
            spi-max-frequency = <2000000>;
            spi-cpol;
            spi-cpha;
            vref-supply = <&adc_vref>;
            interrupts = <25 IRQ_TYPE_EDGE_RISING>;
            interrupt-parent = <&gpio>;
            adi,sync-in-gpios = <&gpio 22 GPIO_ACTIVE_LOW>;
            reset-gpios = <&gpio 27 GPIO_ACTIVE_LOW>;
            clocks = <&ad7768_mclk>;
            clock-names = "mclk";

            #address-cells = <1>;
            #size-cells = <0>;

            channel@0 {
                reg = <0>;
                label = "channel_0";
            };
        };
        adc3: adc@3 {
            compatible = "adi,ad7768-1";
            reg = <3>;
            spi-max-frequency = <2000000>;
            spi-cpol;
            spi-cpha;
            vref-supply = <&adc_vref>;
            interrupts = <25 IRQ_TYPE_EDGE_RISING>;
            interrupt-parent = <&gpio>;
            adi,sync-in-gpios = <&gpio 22 GPIO_ACTIVE_LOW>;
            reset-gpios = <&gpio 27 GPIO_ACTIVE_LOW>;
            clocks = <&ad7768_mclk>;
            clock-names = "mclk";

            #address-cells = <1>;
            #size-cells = <0>;

            channel@0 {
                reg = <0>;
                label = "channel_0";
            };
        };
    };
...
```
