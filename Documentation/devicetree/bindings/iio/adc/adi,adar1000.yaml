## Documentation/devicetree/bindings/iio/addac/adi,ad7294.yaml
```yaml
# SPDX-License-Identifier: (GPL-2.0 OR BSD-2-Clause)
%YAML 1.2
---
$id: http://devicetree.org/schemas/iio/addac/adi,ad7294.yaml#
$schema: http://devicetree.org/meta-schemas/core.yaml#

title: Analog Device AD7294/AD7294-2 device

maintainers:
  - Anshul Dalal <anshulusr@gmail.com>

description: |
  The AD7294/AD7294-2 is a monitor and control system with multichannel
  ADC, DAC, temperature and current sensor. The device features a 12-bit ADC
  and DAC with an i2c interface.

  Datasheet:
    AD7294: https://www.analog.com/media/en/technical-documentation/data-sheets/AD7294.pdf
    AD7294-2: https://www.analog.com/media/en/technical-documentation/data-sheets/AD7294-2.pdf

properties:
  compatible:
    enum:
      - adi,ad7294
      - adi,ad7294-2

  reg:
    maxItems: 1

  interrupts:
    maxItems: 1
    description: Alert interrupt

  adc-vref-supply:
    description: The regulator supply for ADC reference voltage (0.1V to 4.1V).

  dac-vref-supply:
    description: |
      The regulator supply for DAC reference voltage (0V to AVDD - 2V).

  avdd-supply:
    description: Fixed regulator supply for analog circuitry (4.5V to 5.5V).

  vdrive-supply:
    description: Logic power supply (2.7V to 5.5V).

  shunt-resistor-ohms:
    $ref: /schemas/types.yaml#/definitions/int32-array
    maxItems: 2
    description: Resistance for RS1 and RS2 in ohms

required:
  - compatible
  - reg
  - avdd-supply
  - vdrive-supply

additionalProperties: false

examples:
  - |
    #include <dt-bindings/interrupt-controller/irq.h>

    i2c {
      #address-cells = <1>;
      #size-cells = <0>;

      ad7294: addac@7b {
        compatible = "adi,ad7294";
        reg = <0x7b>;
        interrupt-parent = <&gpio>;
        interrupts = <26 IRQ_TYPE_LEVEL_LOW>;
        adc-vref-supply = <&adc_vref>;
        dac-vref-supply = <&dac_vref>;
        avdd-supply = <&avdd>;
        vdrive-supply = <&vdrive>;
        shunt-resistor-ohms = <1000 1000>;
      };
    };
```

## Documentation/devicetree/bindings/iio/addac/adi,ad74416h.yaml
```yaml
# SPDX-License-Identifier: (GPL-2.0-only OR BSD-2-Clause)
%YAML 1.2
---
$id: http://devicetree.org/schemas/iio/addac/adi,ad74416h.yaml#
$schema: http://devicetree.org/meta-schemas/core.yaml#

title: Analog Devices AD74416H device

maintainers:
  - Antoniu Miclaus <antoniu.miclaus@analog.com>

description: |
  The AD74416H is a quad-channel, software-configurable, input and output
  device for industrial control applications. The AD74416H provides a wide
  range of use cases, integrated on a single chip. These use cases include
  analog output, analog input, digital output, digital input, resistance
  temperature detector (RTD), and thermocouple measurement capability.
  The AD74416H also has an integrated HART modem. The I/O communications and
  HART communications for all four channels are supported using a single serial
  peripheral interface (SPI).
    https://www.analog.com/en/products/ad74416h.html

properties:
  compatible:
    enum:
      - adi,ad74416h

  reg:
    maxItems: 1

  '#address-cells':
    const: 1

  '#size-cells':
    const: 0

  spi-max-frequency:
    maximum: 1000000

  spi-cpol: true

  interrupts:
    maxItems: 1

  refin-supply: true

  device-address:
    description:
      Set the SPI device address.
    $ref: /schemas/types.yaml#/definitions/uint32
    enum: [0, 1, 2, 3]

  shunt-resistor-micro-ohms:
    description:
      Shunt (sense) resistor value in micro-Ohms.
    default: 120000000

  reset-gpios:
    maxItems: 1

required:
  - compatible
  - reg
  - spi-max-frequency
  - spi-cpol
  - refin-supply

patternProperties:
  "^channel@[0-3]$":
    type: object
    additionalProperties: false
    description: Represents the external channels which are connected to the device.

    properties:
      reg:
        description: |
          The channel number. It can have up to 4 channels numbered from 0 to 3.
        minimum: 0
        maximum: 3

      adi,ch-func:
        $ref: /schemas/types.yaml#/definitions/uint32
        description: |
          Channel function.
          0 - CH_FUNC_HIGH_IMPEDANCE
          1 - CH_FUNC_VOLTAGE_OUTPUT
          2 - CH_FUNC_CURRENT_OUTPUT
          3 - CH_FUNC_VOLTAGE_INPUT
          4 - CH_FUNC_CURRENT_INPUT_EXT_POWER
          5 - CH_FUNC_CURRENT_INPUT_LOOP_POWER
          6 - CH_FUNC_RESISTANCE_INPUT
          7 - CH_FUNC_DIGITAL_INPUT_LOGIC
          8 - CH_FUNC_DIGITAL_INPUT_LOOP_POWER
          9 - CH_FUNC_CURRENT_INPUT_EXT_POWER_HART
          10 - CH_FUNC_CURRENT_INPUT_LOOP_POWER_HART
        minimum: 0
        maximum: 10
        default: 0

      adi,gpo-comparator:
        type: boolean
        description: |
          Whether to configure GPO as a comparator or not.
          When not configured as a comparator, the GPO will be treated as an
          output-only GPIO.

      drive-strength-microamp:
        description: |
          For channels configured as digital input, this configures the sink
          current.
        minimum: 0
        maximum: 1800
        default: 0
        multipleOf: 120

    required:
      - reg

allOf:
  - $ref: /schemas/spi/spi-peripheral-props.yaml#

unevaluatedProperties: false

examples:
  - |
    #include <dt-bindings/gpio/gpio.h>
    #include <dt-bindings/interrupt-controller/irq.h>
    #include <dt-bindings/iio/addac/adi,ad74416h.h>

    spi {
      #address-cells = <1>;
      #size-cells = <0>;

      addac@0 {
        compatible = "adi,ad74416h";
        reg = <0>;
        spi-max-frequency = <1000000>;
        spi-cpol;

        #address-cells = <1>;
        #size-cells = <0>;

        interrupt-parent = <&gpio>;
        interrupts = <26 IRQ_TYPE_EDGE_FALLING>;

        refin-supply = <&ad74416h_refin>;
        reset-gpios = <&gpio2 6 GPIO_ACTIVE_LOW>;

        channel@0 {
          reg = <0>;

          adi,ch-func = <CH_FUNC_VOLTAGE_OUTPUT>;
        };

        channel@1 {
          reg = <1>;

          adi,ch-func = <CH_FUNC_CURRENT_OUTPUT>;
        };

        channel@2 {
          reg = <2>;

          adi,ch-func = <CH_FUNC_DIGITAL_INPUT_LOGIC>;
          adi,gpo-comparator;
        };

        channel@3 {
          reg = <3>;

          adi,ch-func = <CH_FUNC_CURRENT_INPUT_EXT_POWER>;
        };
      };
    };
...
```

## Documentation/devicetree/bindings/iio/addac/one-bit-adc-dac.yaml
```yaml
# SPDX-License-Identifier: (GPL-2.0 OR BSD-2-Clause)
# Copyright 2020 Analog Devices Inc.
%YAML 1.2
---
$id: http://devicetree.org/schemas/bindings/iio/addac/adi,one-bit-adc-dac.yaml#
$schema: http://devicetree.org/meta-schemas/core.yaml#

title: Analog Devices one bit ADC DAC driver

maintainers:
  - Cristian Pop <cristian.pop@analog.com>

description: |
  One bit ADC DAC driver

properties:
  compatible:
    enum:
      - adi,one-bit-adc-dac

  '#address-cells':
    const: 1

  '#size-cells':
    const: 0

  in-gpios:
    description:
      - Input GPIO numbers

  out-gpios:
    description:
      - Output GPIO numbers
required:
  - compatible
  - in-gpios
  - out-gpios

patternProperties:
  "^channel@([0-9]|1[0-5])$":
    type: object
    description: |
      Represents the external channels which are connected to the ADDAC.

    properties:
      reg:
        description: |
          The channel number.

      label:
        description: |
          Unique name to identify which channel this is.
    required:
      - reg

examples:
  - |
    one-bit-adc-dac@0 {
        compatible = "adi,one-bit-adc-dac";

        #address-cells = <1>;
        #size-cells = <0>;

        in-gpios = <&gpio 17 0>, <&gpio 27 0>;
        out-gpios = <&gpio 23 0>, <&gpio 24 0>;

        channel@0 {
          reg = <0>;
          label = "i_17";
        };

        channel@1 {
          reg = <1>;
          label = "i_27";
        };

        channel@2 {
          reg = <2>;
          label = "o_23";
        };

        channel@3 {
          reg = <3>;
          label = "o_24";
        };
			};
		};
```

## Documentation/devicetree/bindings/iio/adf4350.txt
```
Analog Devices ADF4350/ADF4351 device driver

Required properties:
	- compatible: Should be one of
		* "adi,adf4350": When using the ADF4350 device
		* "adi,adf4351": When using the ADF4351 device
	- reg: SPI chip select numbert for the device
	- spi-max-frequency: Max SPI frequency to use (< 20000000)
	- clocks: From common clock binding. Clock is phandle to clock for
		ADF435x Reference Clock (CLKIN).

Optional properties:
	- adi,channel-spacing: Channel spacing in Hz (influences MODULUS).
	- adi,power-up-frequency:	If set in Hz the PLL tunes to
			the desired frequency on probe.
	- adi,ref-div-factor: If set the driver skips dynamic calculation
			and uses this default value instead.
	- adi,ref-doubler-en: Enables reference doubler.
	- adi,ref-div2-en: Enables reference divider.
	- adi,gpio-lock-detect:	If set with a valid GPIO number, pll lock state
			is tested upon read.
	- adi,reg2-pd-polarity-pos-en: Enables positive phase
			detector polarity. Default = negative.
	- adi,reg2-ldp-6ns-en: Enables 6ns lock detect precision.
			Default = 10ns.
	- adi,reg2-ldf-int-n-en: Enables lock detect for integer-N mode.
			Default = factional-N mode.
	- adi,reg2-charge-pump-curr-ua: Charge pump current in mA.
			Default = 2500mA.
	- adi,reg2-muxout: On chip multiplexer output selection.
			Valid values for the multiplexer output are:
			0: Three-State Output (default)
			1: DVDD
			2: DGND
			3: R-Counter output
			4: N-Divider output
			5: Analog lock detect
			6: Digital lock detect
	- adi,reg2-noise-mode: Enables low noise mode. Default = Low spur mode.
	- adi,reg3-csr-en: Enables cycle slip reduction.
	- adi,reg3-charge-cancellation-en: Enabled charge pump
			charge cancellation for integer-N modes.
	- adi,reg3-anti-backlash-3ns-en: Enables 3ns antibacklash pulse width
			 for integer-N modes.
	- adi,reg3-band-sel-clock-mode-high-en: Enables faster band selection logic.
	- adi,reg3-12bit-clkdiv: Clock divider value used when
			adi,reg3-12bit-clkdiv-mode != 0
	- adi,reg3-12bit-clkdiv-mode:
			Valid values for the clkdiv mode are:
			0: Clock divider off (default)
			1: Fast lock enable
			2: Phase resync enable
	- adi,reg4-aux-output-en: Enables auxiliary RF output.
	- adi,reg4-aux-output-fund-en: Selects fundamental VCO output on the
			auxiliary RF output. Default = Output of RF dividers.
	- adi,reg4-mute-till-lock-en: Enables Mute-Till-Lock-Detect function.
	- adi,reg4-output-pwr: Output power selection.
			Valid values for the power mode are:
			0: -4dBM (default)
			1: -1dBM
			2: +2dBM
			3: +5dBM
	- adi,reg4-aux-output-pwr: Auxiliary output power selection.
			Valid values for the power mode are:
			0: -4dBM (default)
			1: -1dBM
			2: +2dBM
			3: +5dBM


Example:
		lo_pll0_rx_adf4351: adf4351-rx-lpc@4 {
			compatible = "adi,adf4351";
			reg = <4>;
			spi-max-frequency = <10000000>;
			clocks = <&clk0_ad9523 9>;
			clock-names = "clkin";
			adi,channel-spacing = <10000>;
			adi,power-up-frequency = <2400000000>;
			adi,reg2-pd-polarity-pos-en;
			adi,reg2-charge-pump-curr-ua = <2500>;
			adi,reg4-output-pwr = <3>;
			adi,reg4-mute-till-lock-en;
		};
```

## Documentation/devicetree/bindings/iio/amplifiers/ad916x-amp.yaml
```yaml
# SPDX-License-Identifier: (GPL-2.0-only OR BSD-2-Clause)
# %YAML 1.2
---
$id: http://devicetree.org/schemas/iio/amplifier/ad916x-amp.yaml#
$schema: http://devicetree.org/meta-schemas/core.yaml#

title: Analog devices AD916x internal Amplifier.

maintainers:
  - Nuno Sá <nuno.sa@analog.com>

description: |
  Analog Devices AD916x Amplifier is an internal buffer which can be seen in some of the AD916x
  devices (eg. ad9166).

properties:
  compatible:
    enum:
      - adi,ad9166-amp

  reg:
    maxItems: 1

required:
  - compatible
  - reg

examples:
  - |
    spi0 {
        #address-cells = <1>;
        #size-cells = <0>;

        amplifier@0 {
            compatible = "adi,ad9166-amp";
            reg = <0>;
        };
    };
...
```

## Documentation/devicetree/bindings/iio/amplifiers/adi,ad8366.yaml
```yaml
# SPDX-License-Identifier: (GPL-2.0-only OR BSD-2-Clause)
%YAML 1.2
---
$id: http://devicetree.org/schemas/iio/amplifiers/adi,ad8366.yaml#
$schema: http://devicetree.org/meta-schemas/core.yaml#

title: AD8366, similar Gain Amplifiers and Digital Attenuators

maintainers:
  - Michael Hennerich <michael.hennerich@analog.com>
  - Rodrigo Alencar <rodrigo.alencar@analog.com>

description: |
  Digital Variable Gain Amplifiers (VGAs) and Digital Attenuators with
  SPI interface.

properties:
  compatible:
    enum:
      - adi,ad8366
      - adi,ada4961
      - adi,adl5240
      - adi,adrf5720
      - adi,adrf5730
      - adi,adrf5731
      - adi,hmc271a
      - adi,hmc792a
      - adi,hmc1018a
      - adi,hmc1019a
      - adi,hmc1119

  reg:
    maxItems: 1

  vcc-supply:
    description: Regulator that provides power to the device.

  reset-gpios:
    maxItems: 1
    description:
      GPIO pin used to reset the device.

  enable-gpios:
    maxItems: 1
    description:
      GPIO pin used to enable the device.

required:
  - compatible
  - reg
  - vcc-supply

allOf:
  - $ref: /schemas/spi/spi-peripheral-props.yaml#

unevaluatedProperties: false

examples:
  - |
    #include <dt-bindings/gpio/gpio.h>
    spi {
      #address-cells = <1>;
      #size-cells = <0>;

      amplifier@0 {
        compatible = "adi,ad8366";
        reg = <0>;
        spi-max-frequency = <1000000>;
        vcc-supply = <&vcc_3v3>;
      };
    };
  - |
    #include <dt-bindings/gpio/gpio.h>
    spi {
      #address-cells = <1>;
      #size-cells = <0>;

      attenuator@1 {
        compatible = "adi,adrf5730";
        reg = <1>;
        spi-max-frequency = <1000000>;
        vcc-supply = <&vcc_3v3>;
      };
    };
...
```
