## Documentation/devicetree/bindings/iio/dac/ad5758.txt
```
Analog Devices AD5758 DAC device driver

Required properties for the AD5758:
	- compatible: Must be "adi,ad5758"
	- reg: SPI chip select number for the device
	- spi-max-frequency: Max SPI frequency to use (< 50000000)
	- spi-cpha: is the only mode that is supported

Optional properties:

 - reset-gpios : GPIO spec for the RESET pin. If specified, it will be
 		 asserted during driver probe.

 - adi,dc-dc-mode: Mode of operation of the dc-to-dc converter
		   The following values are currently supported:
		   	* 0: DC-to-DC converter powered off
			* 1: DPC current mode
			* 2: DPC voltage mode
			* 3: PPC current mode

 - adi,dc-dc-ilim: The dc-to-dc converter current limit
		   The following values are currently supported [mA]:
		   	* 150
			* 200
			* 250
			* 300
			* 350
			* 400

 - adi,slew-time-us: The time it takes for the output to reach the full scale [uS]
 		     The supported range is between 133us up to 1023984375us

 - adi,range: The output range
	      The following values are currently supported:
	      	* 0: 0 V to 5 V voltage range
		* 1: 0 V to 10 V voltage range
		* 2: ±5 V voltage range
		* 3: ±10 V voltage range
		* 8: 0 mA to 20 mA current range
		* 9: 0 mA to 24 mA current range
		* 10: 4 mA to 20 mA current range
		* 11: ±20 mA current range
		* 12: ±24 mA current range
		* 13: −1 mA to +22 mA current range

AD5758 Example:

	ad5758@0 {
		compatible = "adi,ad5758";
		reg = <0>;
		spi-max-frequency = <1000000>;
		spi-cpha;

		reset-gpios = <&gpio 22 0>;

		adi,dc-dc-mode = <2>;
		adi,dc-dc-ilim = <200>;
		adi,slew-time-us = <125000>;
		adi,range = <1>;
	};
```

## Documentation/devicetree/bindings/iio/dac/ad5770r.txt
```
Analog Devices AD5770R DAC device driver

Required properties for the AD5770R:
	- compatible: Must be "adi,ad5770r"
	- reg: SPI chip select number for the device
	- spi-max-frequency: Max SPI frequency to use (< 10000000, as per
			Documentation/devicetree/bindings/spi/spi-bus.txt)
	- child nodes: Each child node represents one channel and has
		the following required properties:
		* num: This represents the channel num
		* adi,range-microamp: Output range of the channel
		The following ranges are supported:
		* Channel 0:
			* <0 300000> 0 mA to 300 mA
			* <(-60000) 0> -60 to 0 mA
			* <(-60000) 300000> -60 to 300 mA
		* Channel 1:
			* <0 140000> 0 to 140 mA
			* <0 250000> 0 to 250 mA
		* Channel 2:
			* <0 55000> 0 to 55 mA
			* <0 150000> 0 to 150 mA
		* Channel 3 to Channel 5:
			* <0 45000> 0 to 45 mA
			* <0 100000> 0 to 100 mA

Optional properties:

- vref: Specify the voltage of the external reference used.
		Available reference options are: 1.25 V or 2.5 V. If no
		external reference declared then the device will use the
		internal reference of 1.25 V.

- reset-gpios: GPIO spec for the RESET pin. If specified, it will be
		asserted during driver probe.

AD5770R Example:

	ad5770r@0 {
		compatible = "ad5770r";
		reg = <0>;
                spi-max-frequency = <1000000>;
		vref-supply = <&vref>;

		reset-gpios = <&gpio 22 0>;

		channel@0 {
			num = <0>;
			adi,range-microamp = <0 300000>;
		};

		channel@1 {
			num = <1>;
			adi,range-microamp = <0 140000>;
		};

		channel@2 {
			num = <2>;
			adi,range-microamp = <0 55000>;
		};

		channel@3 {
			num = <3>;
			adi,range-microamp = <0 45000>;
		};

		channel@4 {
			num = <4>;
			adi,range-microamp = <0 45000>;
		};

		channel@5 {
			num = <5>;
			adi,range-microamp = <0 45000>;
		};
       };

External reference example:

	vref: fixedregulator@0 {
		compatible = "regulator-fixed";
		regulator-name = "fixed-supply";
		regulator-min-microvolt = <1250000>;
		regulator-max-microvolt = <1250000>;
	};
```

## Documentation/devicetree/bindings/iio/dac/adi,ad3530r.yaml
```yaml
# SPDX-License-Identifier: (GPL-2.0-only OR BSD-2-Clause)
%YAML 1.2
---
$id: http://devicetree.org/schemas/iio/dac/adi,ad3530r.yaml#
$schema: http://devicetree.org/meta-schemas/core.yaml#

title: Analog Devices AD3530R DAC

maintainers:
  - Kim Seer Paller <kimseer.paller@analog.com>

description: |
  The AD3530R/AD3530 are low power, 8-channel, 16-bit, buffered voltage output,
  DACs that include a 2.5 V internal reference (disabled by default), and a
  gain bit field, resulting in a full-scale output span of 2.5 V (gain
  = 1) or 5 V (gain = 2) for a reference voltage of 2.5 V.
  Datasheet can be found here:
  https://www.analog.com/media/en/technical-documentation/data-sheets/2664fa.pdf

properties:
  compatible:
    enum:
      - adi,ad3530r

  reg:
    maxItems: 1

  spi-max-frequency:
    maximum: 50000000

  vcc-supply:
    description: Analog Supply Voltage Input.

  iovcc-supply:
    description: Digital Supply Voltage Input.

  ref-supply:
    description:
      Reference Input/Output. The voltage at the REF pin sets the full-scale
      range of all channels. If not provided the internal reference is used and
      also provided on the VREF pin.

  reset-gpios:
    description:
      Active low signal that is falling edge sensitive. When it is deasserted,
      the digital core initialization is performed and all DAC registers except
      the Interface Configuration A register are reset to their default values.
    maxItems: 1

  ldac-gpios:
    description:
      LDAC pin to be used as a hardware trigger to update the DAC channels. If
      not present, the DAC channels are updated by Software LDAC.
    maxItems: 1

  adi,double-output-range:
    description:
      Configure the output range for all channels. If the property is present,
      the output will range from 0V to 2Vref. If the property is not
      present, the output will range from 0V to Vref.
    type: boolean

  '#address-cells':
    const: 1

  '#size-cells':
    const: 0

required:
  - compatible
  - reg
  - spi-max-frequency
  - vcc-supply
  - iovcc-supply

allOf:
  - $ref: /schemas/spi/spi-peripheral-props.yaml#

additionalProperties: false

examples:
  - |
    spi {
        #address-cells = <1>;
        #size-cells = <0>;
        dac@0 {
            compatible = "adi,ad3530r";
            reg = <0>;
            spi-max-frequency = <1000000>;

            vcc-supply = <&vcc>;
            iovcc-supply = <&vcc>;
            ldac-gpios = <&gpio 17 0>;
        };
    };
...
```

## Documentation/devicetree/bindings/iio/dac/adi,ad3552r-axi.yaml
```yaml
# SPDX-License-Identifier: (GPL-2.0 OR BSD-2-Clause)
# Copyright 2024 Analog Devices Inc.
%YAML 1.2
---
$id: http://devicetree.org/schemas/iio/dac/adi,ad3552r-axi.yaml#
$schema: http://devicetree.org/meta-schemas/core.yaml#

title: Analog Devices AD2552R AXI DAC

maintainers:
  - Nuno Sá <nuno.sa@analog.com>

description: |
  Bindings for the Analog Devices AD3552R DAC device and similar.
  Datasheet can be found here:
    https://www.analog.com/media/en/technical-documentation/data-sheets/ad3541r.pdf
    https://www.analog.com/media/en/technical-documentation/data-sheets/ad3542r.pdf
    https://www.analog.com/media/en/technical-documentation/data-sheets/ad3551r.pdf
    https://www.analog.com/media/en/technical-documentation/data-sheets/ad3552r.pdf

properties:
  compatible:
    enum:
      - adi,ad3552r-axi

  reset-gpios:
    maxItems: 1
    description:: Active low gpio to be used for the hw reset.

  clocks:
    maxItems: 1
    description:
      The AXI clock reference.

  io-backends:
    maxItems: 1
      The iio backend reference.

required:
  - compatible
  - clocks
  - io-backends

additionalProperties: false

examples:
  - |
    backend: controller@44a70000 {
        compatible = "adi,axi-dac-9.1.b";
        reg = <0x44a70000 0x1000>;
        dmas = <&dac_tx_dma 0>;
        dma-names = "tx";
        #io-backend-cells = <0>;
        clocks = <&ref_clk>;
    };
    axi-ad3552r {
        compatible = "adi,ad3552r-axi";
        reset-gpios = <&gpio0 92 GPIO_ACTIVE_LOW>;
        clocks = <&ref_clk>;
        io-backends = <&backend>;
    };
...
```

## Documentation/devicetree/bindings/iio/dac/adi,ad3552r.yaml
```yaml
# SPDX-License-Identifier: (GPL-2.0 OR BSD-2-Clause)
# Copyright 2020 Analog Devices Inc.
%YAML 1.2
---
$id: http://devicetree.org/schemas/iio/dac/adi,ad3552r.yaml#
$schema: http://devicetree.org/meta-schemas/core.yaml#

title: Analog Devices AD2552R DAC device driver

maintainers:
  - Mihail Chindris <mihail.chindris@analog.com>

description: |
  Bindings for the Analog Devices AD3552R  DAC device. Datasheet can be
  found here:
    https://www.analog.com/media/en/technical-documentation/data-sheets/ad3552r.pdf

properties:
  compatible:
    enum:
      - adi,ad3552r

  reg:
    maxItems: 1

  spi-max-frequency:
    maximum: 30000000

  interrupts:
    maxItems: 1

  reset-gpios:
    maxItems: 1

  pwms:
    description: PWM used as LDAC signal and for generating interrupts for sampling
    maxItems: 1

  adi,vref-select:
    description: Selection of the voltage reference.
      The options are
       - 0 internal source with Vref I/O floating
       - 1 internal source with Vref I/O at 2.5V.
       - 2 external source with Vref I/O as input.
    $ref: /schemas/types.yaml#/definitions/uint32
    enum: [0, 1, 2]

  adi,spi-multi-io-mode:
    description:  |
      Select SPI operating mode:
        - 0: standard.
        - 1: dual.
        - 2: quad.
    $ref: /schemas/types.yaml#/definitions/uint32
    enum: [0, 1, 2]

  adi,ddr:
    description: Enable or disable double data rate SPI
    type: boolean

  adi,synchronous-mode:
    description: Enable or disable synchronous dual SPI mode
    type: boolean

  adi,sdo-drive-strength:
    description: |
      Configure SDIO0 and SDIO1 strength levels:
        - 0: low SDO drive strength.
        - 1: medium low SDO drive strength.
        - 2: medium high SDO drive strength.
        - 3: high SDO drive strength
    $ref: /schemas/types.yaml#/definitions/uint32
    enum: [0, 1, 2, 3]

patternProperties:
  "^channel@([0-1])$":
    type: object
    description: Configurations of the DAC Channels
    properties:
      reg:
          description: Channel number
          minimum: 0
          maximum: 1

      adi,output-range:
        description: |
          Output range of the channel
            0: 0 V to 2.5 V
            1: 0 V to 5 V
            2: 0 V to 10 V
            3: -5 V to 5 V
            4: -10 V to 10 V
        $ref: /schemas/types.yaml#/definitions/uint32
        enum: [0, 1, 2, 3, 4]

      custom-output-range-config:
        type: object
        description: Configuration of custom range when adi,output-range is set
                      to custom
        properties:
          adi,gain-offset:
            description: Gain offset
            $ref: /schemas/types.yaml#/definitions/int32
            maximum: 511
            minimum: -511
          adi,gain-scaling-p:
            description: |
              Scaling p:
               0: 1.0
               1: 0.5
               2: 0.25
               3: 0.125
            $ref: /schemas/types.yaml#/definitions/uint32
            enum: [0, 1, 2, 3]
          adi,gain-scaling-n:
            description: |
              Scaling p:
               0: 1.0
               1: 0.5
               2: 0.25
               3: 0.125
            $ref: /schemas/types.yaml#/definitions/uint32
            enum: [0, 1, 2, 3]
          adi,rfb-ohms:
            description: Feedback Resistor
        required:
          - adi,gain-offset
          - adi,gain-sacling-p
          - adi,gain-sacling-n
          - adi,rfb-ohms
    required:
      - reg

    oneOf:
      # If adi,output-range is missing, custom-output-range-config must be used
      - required:
        - adi,output-range
      - required:
        - custom-output-range-config

required:
  - compatible
  - reg
  - spi-max-frequency

additionalProperties: false

examples:
  - |
    ad3552r {
            compatible = "adi,ad3552r";
            reg = <0 0 0 0>;
            spi-max-frequency = <20000000>;
            interrupt-parent = <&gpio0>;
            interrupts = <87 0>;
            pwms = <&axi_pwm 0 50>;
            reset-gpios = <&gpio 86 0>;
            adi,vref-select = <0>;
            channel@0 {
                    reg = <0>;
                    adi,output-range = <0>;
            };
            channel@1 {
                    reg = <1>;
                    custom-output-range-config {
                            adi,gain-offset = <5>;
                            adi,gain-sacling-p = <1>;
                            adi,gain-sacling-n = <2>;
                            adi,rfb-ohms = <1>;
                    };
          };
      };
...
```

## Documentation/devicetree/bindings/iio/dac/adi,ad5413.yaml
```yaml
# SPDX-License-Identifier: (GPL-2.0 OR BSD-2-Clause)
%YAML 1.2
---
$id: http://devicetree.org/schemas/iio/dac/adi,ad5413.yaml#
$schema: http://devicetree.org/meta-schemas/core.yaml#

title: Analog Devices AD5413 DAC

description: |
  Analog Devices AD5413 is a single-channel precision DAC supporting voltage
  or current output modes with programmable slew-rate control.
  The output mode is selected via the adi,chan-current-mode property.
  Optional reset GPIO may be provided.

maintainers:
  - name: Bruce Tsao
    email: bruce.tsao@analog.com

properties:
  compatible:
    const: adi,ad5413

  spi-max-frequency:
    maximum: 50000000

  reset-gpios:
    maxItems: 1
    description: Optional reset GPIO (active low).

  avdd-supply:
    description: Analog positive supply (AVDD)

  dvdd-supply:
    description: Digital positive supply (DVDD)

  avss-supply:
    description: Analog negative supply (AVSS)

  adi,chan-current-mode:
    type: boolean
    description: Select current output mode. If absent, voltage mode is used.

  adi,slew-time-us:
    description: Output digital slew control time in microseconds
    minimum: 0
    maximum: 1000000
    default: 0

required:
  - compatible
  - avdd-supply
  - dvdd-supply
  - avss-supply

allOf:
  - $ref: /schemas/spi/spi-peripheral-props.yaml#

unevaluatedProperties: false

examples:
  - |
    #include <dt-bindings/gpio/gpio.h>

    spi {
        #address-cells = <1>;
        #size-cells = <0>;

        dac@0 {
            compatible = "adi,ad5413";
            reg = <0>;
            spi-max-frequency = <1000000>;
            reset-gpios = <&gpio 0 GPIO_ACTIVE_LOW>;
            avdd-supply = <&avdd>;
            dvdd-supply = <&dvdd>;
            avss-supply = <&avss>;
            adi,slew-time-us = <125>;
        };
    };

  - |
    spi {
        #address-cells = <1>;
        #size-cells = <0>;

        dac@0 {
            compatible = "adi,ad5413";
            reg = <0>;
            spi-max-frequency = <1000000>;
            avdd-supply = <&avdd>;
            dvdd-supply = <&dvdd>;
            avss-supply = <&avss>;

            adi,chan-current-mode;
        };
    };
```
