## Documentation/devicetree/bindings/iio/amplifiers/adi,ada4250.yaml
```yaml
# SPDX-License-Identifier: GPL-2.0
%YAML 1.2
---
$id: http://devicetree.org/schemas/iio/amplifiers/adi,ada4250.yaml#
$schema: http://devicetree.org/meta-schemas/core.yaml#

title: ADA4250 Programmable Gain Instrumentation Amplifier

maintainers:
- Antoniu Miclaus <antoniu.miclaus@analog.com>

description: |
  Precision Low Power, 110kHz, 26uA, Programmable Gain Instrumentation Amplifier

properties:
  compatible:
    enum:
      - adi,ada4250

  reg:
    maxItems: 1

  avdd-supply:
    description:
      analog voltage regulator (see regulator/regulator.txt)

  adi,refbuf-enable:
    description:
      Enable internal buffer to drive the reference pin.
    type: boolean

required:
- compatible
- reg
- avdd-supply

additionalProperties: false

examples:
- |
    spi {
      #address-cells = <1>;
      #size-cells = <0>;
      status = "okay";

      ada4250@0{
        compatible = "adi,ada4250";
        reg = <0>;
        avdd-supply = <&avdd>;
      };
    };
```

## Documentation/devicetree/bindings/iio/amplifiers/adi,ada4255.yaml
```yaml
# SPDX-License-Identifier: GPL-2.0
%YAML 1.2
---
$id: http://devicetree.org/schemas/iio/amplifiers/adi,ada4255.yaml#
$schema: http://devicetree.org/meta-schemas/core.yaml#

title: ADA4255 Programmable Gain Instrumentation Amplifier

maintainers:
- Cosmin Tanislav <cosmin.tanislav@analog.com>

description: |
  Zero Drift, High Voltage, Programmable Gain Instrumentation Amplifier
  with Charge Pump

properties:
  compatible:
    enum:
      - adi,ada4255

  reg:
    maxItems: 1

  clocks:
    maxItems: 1

  clock-names:
    const: mclk

  clock-output-names:
    maxItems: 1

  '#clock-cells':
    const: 1

  avdd-supply: true
  dvdd-supply: true
  vddcp-supply: true
  vocm-supply: true

  adi,excitation-current-microamp:
    description: Excitation current to apply to IOUT.
    enum: [0, 100, 200, 300, 400, 500, 600, 700, 800,
           900, 1000, 1100, 1200, 1300, 1400, 1500]
    default: 0

  adi,charge-pump-freq-hz:
    description: Frequency at which to run the charge pumps.
    enum: [8000000, 16000000]
    default: 16000000

required:
- compatible
- reg

allOf:
  - $ref: /schemas/spi/spi-peripheral-props.yaml#

unevaluatedProperties: false

examples:
- |
    spi {
      #address-cells = <1>;
      #size-cells = <0>;
      status = "okay";

      amplifier@0{
        compatible = "adi,ada4255";
        reg = <0>;
      };
    };
```

## Documentation/devicetree/bindings/iio/amplifiers/adi,adl5580.yaml
```yaml
# SPDX-License-Identifier: (GPL-2.0 OR BSD-2-Clause)
%YAML 1.2
---
$id: http://devicetree.org/schemas/iio/amplifier/adi,adl5580.yaml#
$schema: http://devicetree.org/meta-schemas/core.yaml#

$title: Analog Devices ADL5580 configurable Gain Amplifier device tree bindings
$maintainers:
  - Michael Hennerich <michael.hennerich@analog.com>

properties:
  compatible:
    enum:
      - adi,adl5580

  reg:
    maxItems: 1

  avcc-supply:
    description: Analog Supply Voltage Input.

  avee-supply:
    description: Analog Negative Supply Voltage.

  enable-gpios:
    description:
      If specified, can be used to enable/disable the amplifier. As the line is
      active high, it should be marked GPIO_ACTIVE_HIGH.
    maxItems: 1

  adi,prg-otrm:
    description: Enumerates programmable Output Common Mode Voltage
        0 - 0.41V
        1 - 0.51V
        2 - 0.60V
        3 - 0.70V
    $ref: /schemas/types.yaml#/definitions/uint32
    enum: [0, 1, 2, 3]

  adi,ms-otrm:
    description: Enumerates programmable Output Termination Mode.
        0 - Internal VCM disabled, VCMO pin disconnected.
        1 - Internal VCM enabled, VCMO pin disconnected.
        2 - Internal VCM enabled, VCMO export.
        3 - Internal VCM disabled, VCMO import. Default.
    $ref: /schemas/types.yaml#/definitions/uint32
    enum: [0, 1, 2, 3]

  adi,prg-itrm:
    description: Enumerates programmable Input Common Mode Voltage
        0 - 1.39V
        1 - 1.53V
        2 - 1.67V
        3 - 1.80V
    $ref: /schemas/types.yaml#/definitions/uint32
    enum: [0, 1, 2, 3]

  adi,ms-itrm:
    description: Enumerates programmable Input Termination Mode.
      0 - Internal VCM disabled, VCMI pin disconnected. Default.
      1 - Internal VCM enabled, VCMI pin disconnected.
      2 - Internal VCM enabled, VCMI export.
      3 - Internal VCM disabled, VCMI import.
    $ref: /schemas/types.yaml#/definitions/uint32
    enum: [0, 1, 2, 3]

  adi,prg-cpeak:
    description: Programmable flatness vs. operating bandwidth tuning option
    $ref: /schemas/types.yaml#/definitions/uint32
    enum: [0, 1, 2, 3, 4, 5, 6, 7]

required:
  - compatible
  - reg

examples:
  - |

    spi {
          #address-cells = <1>;
          #size-cells = <0>;
          adl5580: adl5580@0 {
                  compatible = "adi,adl5580";
                  reg = <0>;
                  spi-max-frequency = <1000000>;
                  enable-gpios = <&gpio 22 GPIO_ACTIVE_HIGH>;
                  avcc-supply = <&vcc>;
                  avee-supply = <&vee>;

                  adi,prg-otrm = <ADL5580_OUT_CM_0P5V>;
                  adi,ms-otrm = <ADL5580_OUT_TERM_MODE3>;
                  adi,prg-itrm = <ADL5580_IN_CM_1P75V>;
                  adi,ms-itrm = <ADL5580_IN_TERM_MODE0>;
                  adi,prg-cpeak = <4>;
          };
    };
```

## Documentation/devicetree/bindings/iio/amplifiers/adi,adl8113.yaml
```yaml
# SPDX-License-Identifier: (GPL-2.0-only OR BSD-2-Clause)
%YAML 1.2
---
$id: http://devicetree.org/schemas/iio/amplifiers/adi,adl8113.yaml#
$schema: http://devicetree.org/meta-schemas/core.yaml#

title: Analog Devices ADL8113 Low Noise Amplifier with integrated bypass switches

maintainers:
  - Antoniu Miclaus <antoniu.miclaus@analog.com>

description: |
  The ADL8113 is a 10MHz to 12GHz Low Noise Amplifier with integrated bypass
  switches controlled by two GPIO pins (VA and VB). The device supports four
  operation modes:
    - Internal Amplifier: VA=0, VB=0 - Signal passes through the internal LNA
    - Internal Bypass: VA=1, VB=1 - Signal bypasses through internal path
    - External Bypass A: VA=0, VB=1 - Signal routes through external bypass path A
    - External Bypass B: VA=1, VB=0 - Signal routes through external bypass path B

    https://www.analog.com/en/products/adl8113.html

properties:
  compatible:
    const: adi,adl8113

  vdd1-supply: true

  vdd2-supply: true

  vss2-supply: true

  va-gpios:
    description:
      GPIO connected to the VA control pin. Must be specified as GPIO_ACTIVE_HIGH.
    maxItems: 1

  vb-gpios:
    description:
      GPIO connected to the VB control pin. Must be specified as GPIO_ACTIVE_HIGH.
    maxItems: 1

  adi,initial-mode:
    description: |
      Initial operation mode after device initialization
        0 - Internal Amplifier (default)
        1 - Internal Bypass
        2 - External Bypass A
        3 - External Bypass B
    $ref: /schemas/types.yaml#/definitions/uint32
    enum: [0, 1, 2, 3]
    default: 0

required:
  - compatible
  - va-gpios
  - vb-gpios
  - vdd1-supply
  - vdd2-supply
  - vss2-supply

additionalProperties: false

examples:
  - |
    #include <dt-bindings/gpio/gpio.h>
    amplifier {
        compatible = "adi,adl8113";
        va-gpios = <&gpio 22 GPIO_ACTIVE_HIGH>;
        vb-gpios = <&gpio 23 GPIO_ACTIVE_HIGH>;
        vdd1-supply = <&vdd1_5v>;
        vdd2-supply = <&vdd2_3v3>;
        vss2-supply = <&vss2_neg>;
        adi,initial-mode = <0>;
    };
...
```

## Documentation/devicetree/bindings/iio/beamformer/adi,adar300x.yaml
```yaml
# SPDX-License-Identifier: (GPL-2.0-only OR BSD-2-Clause)
# Copyright 2020 Analog Devices Inc.
%YAML 1.2
---
$id: http://devicetree.org/schemas/bindings/iio/adc/adi,adar300x.yaml#
$schema: http://devicetree.org/meta-schemas/core.yaml#

title: Analog Devices ADAR300x Ka Band Beamformer

maintainers:
  - Cristian Pop <cristian.pop@analog.com>

description: |
  Analog Devices ADAR300x receive/transmit chip, 2-Beam & 4-dual polarized elements, beamforming
  chip for polarized phased arrays

properties:
  compatible:
    enum:
      - adi,adar3000
      - adi,adar3001
      - adi,adar3002
      - adi,adar3003

  reg:
    maxItems: 1

patternProperties:
  "dev@[0-3]":
    type: object

    properties:
      reg:
        description:
          The device address. On the same SPI lines there can connected up to 16
          devices, this is done by using the four address bits
          (ADDR0, ADDR1, ADDR2 and ADDR3).
          For mode details about this address look at the datasheet at the Chip
          Addressing section.
        minimum: 0
        maximum: 16

      label:
        description:
          This label is used to recognize between the 16 ADAR300x devices that
          can be supported on the same SPI lines. This is useful when trying to
          identify one device.

    required:
      - reg

required:
  - compatible
  - reg

additionalProperties: false

examples:
  - |
    adar3000@0 {
      compatible = "adi,adar3000";
      reg = <0>;
      spi-max-frequency = <1000000>;

      #address-cells = <1>;
      #size-cells = <0>;

      dev@0 {
        reg = <0>;
        label = "BEAM0";
      };
      dev@1 {
        reg = <1>;
        label = "BEAM1";
      };
      dev@2 {
        reg = <2>;
        label = "BEAM2";
      };
      dev@3 {
        reg = <3>;
        label = "BEAM3";
      };
    };
```

## Documentation/devicetree/bindings/iio/beamformer/adi,adar400x.yaml
```yaml
# SPDX-License-Identifier: (GPL-2.0-only OR BSD-2-Clause)
%YAML 1.2
---
$id: http://devicetree.org/schemas/iio/dac/adi,adar400x.yaml#
$schema: http://devicetree.org/meta-schemas/core.yaml#

title: Analog Devices ADAR400x Beamformer

maintainers:
  - Kim Seer Paller <kimseer.paller@analog.com>

description: |
  The ADAR4000 and ADAR4001 are wideband beamformer ICs operating from 2 GHz to
  18 GHz, designed for transmit and receive phased array applications,
  respectively. Both feature a true time delay core for beam-squint free
  operation, with configurable delays up to 508 ps and fine resolution down to
  2 ps. Each path includes a 31.5 dB digital step attenuator with 0.5 dB steps.
  They support SPI control for up to 16 devices and include on-chip RAM and
  FIFO for storing and sequencing beamstates.

properties:
  compatible:
    enum:
      - adi,adar4000
      - adi,adar4001

  reg:
    maxItems: 1

  spi-max-frequency:
    maximum: 50000000

  adi,num-devices:
    description:
      The number of devices connected to the SPI bus.
    minimum: 1
    default: 1
    maximum: 16

required:
  - compatible
  - reg

allOf:
  - $ref: /schemas/spi/spi-peripheral-props.yaml#

unevaluatedProperties: false

examples:
  - |
    spi {
        #address-cells = <1>;
        #size-cells = <0>;
        beamformer@0 {
            compatible = "adi,adar4000";
            reg = <0>;
            spi-max-frequency = <1000000>;
        };
    };
...
```

## Documentation/devicetree/bindings/iio/dac/ad5064.txt
```
Analog Devices AD5064 DAC device driver

Required properties:
	- compatible: Must be one of:
		* "adi,ad5024"
		* "adi,ad5025"
		* "adi,ad5044"
		* "adi,ad5045"
		* "adi,ad5064"
		* "adi,ad5064-1"
		* "adi,ad5065"
		* "adi,ad5628-1"
		* "adi,ad5628-2"
		* "adi,ad5648-1"
		* "adi,ad5648-2"
		* "adi,ad5666-1"
		* "adi,ad5666-2"
		* "adi,ad5668-1"
		* "adi,ad5668-2"
		* "adi,ad5668-3"
	- reg: SPI chip select number for the device
	- spi-max-frequency: Max SPI frequency to use (< 30000000)
	- vrefA-supply, vrefB-supply: phandles to external reference voltage
	  supplies for channels 0 and 1 respectively.
	  This property must be present for ad5024, ad5025, ad5044, ad5045,
	  ad5064, ad5065.
	- vrefC-supply, vrefD-supply: phandles to external reference voltage
	  supplies for channels 2 and 3 respectively.
	  This property must be present for ad5024, ad5044, ad5064.

Optional properties:
	- vref-supply: phandle to the external reference voltage supply.
	  This should only be set if there is an external reference voltage
	  connected to the vref or vref[A-D] pins.
	  If the property is not set, the internal reference voltage supply
	  is used if present.
	  This property can be used with ad5064-1, ad5628-1, ad5628-2, ad5648-1,
	  ad5648-2, ad5666-1, ad5666-2, ad5668-1, ad5668-2, ad5668-3.

Example:

		ad5668-2@4 {
			compatible = "adi,ad5668-2";
			reg = <4>;
			spi-max-frequency = <10000000>;
			adi,use-external-reference;
			vref-supply = <&vref_supply>;
		};
```

## Documentation/devicetree/bindings/iio/dac/ad5592r.txt
```
Analog Devices AD5592R/AD5593R DAC/ADC device driver

Required properties for the AD5592R:
	- compatible: Must be "adi,ad5592r"
	- reg: SPI chip select number for the device
	- spi-max-frequency: Max SPI frequency to use (< 30000000)
	- spi-cpol: The AD5592R requires inverse clock polarity (CPOL) mode

Required properties for the AD5593R:
	- compatible: Must be "adi,ad5593r"
	- reg: I2C address of the device

Required properties for all supported chips:
	- channel-modes: An array of eight 8-bit values (one per channel)
	  describing the mode of each channel. Macros specifying the valid values
	  can be found in <dt-bindings/iio/adi,ad5592r.h>.
	  The following values are currently supported:
		* CH_MODE_ADC			(the pin is ADC input)
		* CH_MODE_DAC			(the pin is DAC output)
		* CH_MODE_DAC_AND_ADC		(the pin is DAC output but can be
						 monitored by an ADC)
		* CH_MODE_UNUSED_PULL_DOWN  	(the pin is pulled down)
		* CH_MODE_UNUSED_OUT_LOW 	(the pin is output low)
		* CH_MODE_UNUSED_OUT_HIGH	(the pin is output high)
		* CH_MODE_UNUSED_OUT_TRISTATE	(the pin is tristated output)
		* CH_MODE_GPIO			(the pin is registered with GPIOLIB)
		* CH_MODE_GPIO_OPEN_DRAIN	(the pin is configured open drain and
						 registered with GPIOLIB)

Optional properties:
	- vref-supply: Phandle to the external reference voltage supply. This should
	  only be set if there is an external reference voltage connected to the VREF
	  pin. If the property is not set the internal 2.5V reference is used.
	- reset-gpios : GPIO spec for the RESET pin. If specified, it will be
	  asserted during driver probe.

AD5592R Example:

	#include <dt-bindings/iio/adi,ad5592r.h>

	vref: regulator-vref {
		compatible = "regulator-fixed";
		regulator-name = "vref-ad559x";
		regulator-min-microvolt = <3300000>;
		regulator-max-microvolt = <3300000>;
		regulator-always-on;
	};

	ad5592r@0 {
		compatible = "adi,ad5592r";
		reg = <0>;
		spi-max-frequency = <1000000>;
		spi-cpol;

		channel-modes = /bits/ 8 <
			CH_MODE_DAC
			CH_MODE_ADC
			CH_MODE_DAC_AND_ADC
			CH_MODE_DAC_AND_ADC
			CH_MODE_UNUSED_PULL_DOWN
			CH_MODE_GPIO
			CH_MODE_GPIO
			CH_MODE_GPIO
		>;

		vref-supply = <&vref>; /* optional */
		reset-gpios = <&gpio0 86 0>;  /* optional */
	};

AD5593R Example:

	#include <dt-bindings/iio/adi,ad5592r.h>

	ad5593r@10 {
		compatible = "adi,ad5593r";
		reg = <0x10>;
		channel-modes = /bits/ 8 <
			CH_MODE_DAC
			CH_MODE_ADC
			CH_MODE_DAC_AND_ADC
			CH_MODE_DAC_AND_ADC
			CH_MODE_UNUSED_PULL_DOWN
			CH_MODE_GPIO
			CH_MODE_GPIO
			CH_MODE_GPIO
		>;

	};
```
