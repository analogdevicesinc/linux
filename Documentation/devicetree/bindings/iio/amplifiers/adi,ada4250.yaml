## Documentation/devicetree/bindings/iio/dac/adi,ad5529r.yaml
```yaml
# SPDX-License-Identifier: (GPL-2.0 OR BSD-2-Clause)
%YAML 1.2
---
$id: http://devicetree.org/schemas/iio/dac/adi,ad5529r.yaml#
$schema: http://devicetree.org/meta-schemas/core.yaml#

title: Analog Devices AD5529R 16-Channel 12/16-bit High Voltage DAC

maintainers:
  - Janani Sunil <janani.sunil@analog.com>

description: |
  The AD5529R is a 16-channel, 12-bit or 16-bit, high voltage, buffered voltage output
  digital-to-analog converter (DAC) with an integrated precision reference.
  The device operates from unipolar and bipolar supplies. It is guaranteed
  monotonic and has built-in rail-to-rail output buffers that can source or
  sink up to 25mA.

  Specifications:
  * 16 independent 12-bit or 16-bit DAC channels
  * Independently programmable output ranges: 0V to 5V, 0V to 10V, 0V to 20V,
    0V to 40V, ±5V to ±15V, ±10V to ±20V
  * 4.096V precision reference, 12ppm/°C maximum
  * Built-in function generation: Toggle, Sinusoidal Dither, and Ramp waveforms
  * Multiplexer for output voltage, load current sense and die temperature

  Datasheet: https://www.analog.com/media/en/technical-documentation/data-sheets/ad5529r.pdf

properties:
  compatible:
    enum:
      - adi,ad5529r        # 16-bit variant (default)
      - adi,ad5529r-12bit  # 12-bit variant

  reg:
    maxItems: 1

  spi-max-frequency:
    maximum: 50000000

  spi-cpha:
    description: |
      SPI clock phase. The AD5529R can operate in SPI mode 1 or mode 3.
  spi-cpol:
    description: |
      SPI clock polarity. The AD5529R can operate in SPI mode 1 or mode 3.

  reset-gpios:
    maxItems: 1
    description: |
      GPIO connected to the RESET pin. Active low. When asserted low,
      performs a power-on reset and initializes the device to its default state.

  vdd-supply:
    description: Digital power supply (typically 3.3V)

  avdd-supply:
    description: Analog power supply (typically 5V)

  hvdd-supply:
    description: High voltage positive supply (up to 40V for output range)

  hvss-supply:
    description: High voltage negative supply (ground or negative voltage)

required:
  - compatible
  - reg
  - vdd-supply
  - avdd-supply
  - hvdd-supply
  - hvss-supply

allOf:
  - $ref: /schemas/spi/spi-peripheral-props.yaml#

unevaluatedProperties: false

examples:
  - |
    #include <dt-bindings/gpio/gpio.h>

    spi {
        #address-cells = <1>;
        #size-cells = <0>;

        dac@0 {
            compatible = "adi,ad5529r";
            reg = <0>;
            spi-max-frequency = <25000000>;

            vdd-supply = <&vdd_regulator>;
            avdd-supply = <&avdd_regulator>;
            hvdd-supply = <&hvdd_regulator>;
            hvss-supply = <&hvss_regulator>;

            reset-gpios = <&gpio 19 GPIO_ACTIVE_LOW>;
        };
    };
...
```

## Documentation/devicetree/bindings/iio/dac/adi,ad5686.yaml
```yaml
# SPDX-License-Identifier: (GPL-2.0 OR BSD-2-Clause)
%YAML 1.2
---
$id: http://devicetree.org/schemas/iio/dac/adi,ad5686.yaml#
$schema: http://devicetree.org/meta-schemas/core.yaml#

title: Analog Devices AD5360 and similar SPI DACs

maintainers:
  - Michael Hennerich <michael.hennerich@analog.com>
  - Jonathan Cameron <jic23@kernel.org>

properties:
  compatible:
    enum:
      - adi,ad5310r
      - adi,ad5672r
      - adi,ad5674r
      - adi,ad5676
      - adi,ad5676r
      - adi,ad5679r
      - adi,ad5681r
      - adi,ad5682r
      - adi,ad5683
      - adi,ad5683r
      - adi,ad5684
      - adi,ad5684r
      - adi,ad5685r
      - adi,ad5686
      - adi,ad5686r

  reg:
    maxItems: 1

  vcc-supply:
    description: If not supplied the internal reference is used.

  reset-gpios:
    description: Active-low RESET pin to reset the device.
    maxItems: 1

  ldac-gpios:
    description:
      Active-low LDAC pin used to asynchronously update the DAC channels.
    maxItems: 1

  gain-gpios:
    description:
      GAIN pin that sets a multiplier for the DAC output voltage. When high,
      the DAC output voltage is multiplied by 2, otherwise it is unchanged.
    maxItems: 1

required:
  - compatible
  - reg

allOf:
  - $ref: /schemas/spi/spi-peripheral-props.yaml#
  - if:
      properties:
        compatible:
          contains:
            anyOf:
              - const: adi,ad5310r
              - const: adi,ad5681r
              - const: adi,ad5682r
              - const: adi,ad5683
              - const: adi,ad5683r
    then:
      properties:
        gain-gpios: false

unevaluatedProperties: false

examples:
  - |
    #include <dt-bindings/gpio/gpio.h>
    spi {
        #address-cells = <1>;
        #size-cells = <0>;
        dac@0 {
            reg = <0>;
            compatible = "adi,ad5310r";
            vcc-supply = <&dac_vref0>;
            reset-gpios = <&gpio0 0 GPIO_ACTIVE_LOW>;
            ldac-gpios = <&gpio0 1 GPIO_ACTIVE_LOW>;
        };
    };
...
```

## Documentation/devicetree/bindings/iio/dac/adi,ad5706r.yaml
```yaml
# SPDX-License-Identifier: (GPL-2.0-only OR BSD-2-Clause)
%YAML 1.2
---
$id: http://devicetree.org/schemas/iio/dac/adi,ad5706r.yaml#
$schema: http://devicetree.org/meta-schemas/core.yaml#

title: Analog Devices AD5706R 4-Channel Current Output DAC

maintainers:
  - Alexis Czezar Torreno <alexisczezar.torreno@analog.com>

description: |
  The AD5706R is a 4-channel, 16-bit current output DAC with SPI interface.

properties:
  compatible:
    const: adi,ad5706r

  reg:
    maxItems: 1

  spi-max-frequency:
    maximum: 100000000

  clocks:
    items:
      - description: SPI clock generator

  clock-names:
    items:
      - const: spi_clk

  pwms:
    items:
      - description: SPI engine PWM generator
      - description: LDACB PWM control

  pwm-names:
    items:
      - const: spi_engine_pwm_gen
      - const: ad5706r_ldacb

  dac-resetb-gpios:
    maxItems: 1
    description: GPIO for DAC reset

  dac-shdn-gpios:
    maxItems: 1
    description: GPIO for DAC shutdown

required:
  - compatible
  - reg

additionalProperties: false

examples:
  - |
    spi {
        #address-cells = <1>;
        #size-cells = <0>;

        dac@0 {
            compatible = "adi,ad5706r";
            reg = <0>;
            spi-max-frequency = <10000000>;
            clocks = <&clkgen 0>;
            clock-names = "spi_clk";
            pwms = <&pwm0 0 1000>, <&pwm1 0 1000>;
            pwm-names = "spi_engine_pwm_gen", "ad5706r_ldacb";
            dac-resetb-gpios = <&gpio0 10 0>;
            dac-shdn-gpios = <&gpio0 11 0>;
        };
    };
...
```

## Documentation/devicetree/bindings/iio/dac/adi,ad5754.yaml
```yaml
# SPDX-License-Identifier: (GPL-2.0 OR BSD-2-Clause)
%YAML 1.2
---
$id: http://devicetree.org/schemas/iio/dac/adi,ad5754.yaml#
$schema: http://devicetree.org/meta-schemas/core.yaml#

title: Analog Devices AD5754 DAC device driver

maintainers:
  - Ciprian Regus <ciprian.regus@analog.com>

description: |
  The AD5754 and the other chip variants are dual/quad, 12-/14-/16-bit serial input,
  voltage output, digital-to-analog converters (DACs).

  https://www.analog.com/media/en/technical-documentation/data-sheets/AD5724_5734_5754.pdf
  https://www.analog.com/media/en/technical-documentation/data-sheets/ad5722_5732_5752.pdf
  https://www.analog.com/media/en/technical-documentation/data-sheets/ad5724r_5734r_5754r.pdf
  https://www.analog.com/media/en/technical-documentation/data-sheets/AD5722R_5732R_5752R.pdf

allOf:
  - $ref: /schemas/spi/spi-peripheral-props.yaml#

properties:
  compatible:
    enum:
      - adi,ad5754
      - adi,ad5734
      - adi,ad5724
      - adi,ad5752
      - adi,ad5732
      - adi,ad5722
      - adi,ad5754r
      - adi,ad5734r
      - adi,ad5724r
      - adi,ad5752r
      - adi,ad5732r
      - adi,ad5722r

  reg:
    maxItems: 1

  spi-max-frequency:
    maximum: 30000000

  spi-cpol: true

  vref-supply:
    description:
      The regulator to use as an external reference. If this is not provided,
      the internal reference will be used for chips that have this feature.
      The external reference must be 2.5V.

  '#address-cells':
    const: 1

  '#size-cells':
    const: 0

patternProperties:
  "^channel@([0-3])$":
    type: object
    description: Configurations for the DAC channels

    additionalProperties: false

    properties:
      reg:
        description: Channel number
        enum: [0, 1, 2, 3]

      output-range-microvolts:
        description: |
          Voltage range of a channel as <minimum, maximum>.

        oneOf:
          - items:
              - const: 0
              - enum: [5000000, 10000000, 10800000]
          - items:
              - const: -5000000
              - const: 5000000
          - items:
              - const: -10000000
              - const: 10000000
          - items:
              - const: -10800000
              - const: 10800000

required:
  - compatible
  - reg
  - spi-max-frequency
  - spi-cpol
  - output-range-microvolts

additionalProperties: false

examples:
  - |
    spi {
          status = "okay";

          #address-cells = <1>;
          #size-cells = <0>;

          dac@0 {
              compatible = "adi,ad5754r";
              reg = <0>;
              spi-max-frequency = <1000000>;
              spi-cpol;

              #address-cells = <1>;
              #size-cells = <0>;

              channel@0 {
                  reg = <0>;
                  output-range-microvolts = <(-5000000) 5000000>;
              };
              channel@1 {
                  reg = <1>;
                  output-range-microvolts = <(-5000000) 5000000>;
              };
              channel@2 {
                  reg = <2>;
                  output-range-microvolts = <(-5000000) 5000000>;
              };
              channel@3 {
                  reg = <3>;
                  output-range-microvolts = <(-5000000) 5000000>;
              };
          };
      };
```

## Documentation/devicetree/bindings/iio/dac/adi,ad5766.yaml
```yaml
# SPDX-License-Identifier: GPL-2.0-only
# Copyright 2019 Analog Devices Inc.
%YAML 1.2
---
$id: http://devicetree.org/schemas/bindings/iio/dac/adi,ad5766.yaml
$schema: $schema: http://devicetree.org/meta-schemas/core.yaml#

title: Analog Devices AD5766 DAC Device Driver

maintainers:
  - Denis Gheorghescu <denis.gheorghescu@analog.com>

description: |
  Bindings for the Analog Devices AD5766 DAC device. Datasheet can be
  found here:
    https://www.analog.com/media/en/technical-documentation/data-sheets/ad5766-5767.pdf
properties:
  compatible:
    enum:
      - adi,ad5766
      - adi,ad5767

required:
  - compatible
  - reg:
	maxItems: 1
  - interupts

examples:
  - |
    ad5766: ad5766@0 {
      compatible = "adi,ad5766";
      reg = <0>;
      spi-cpol: true
      spi-max-frequency:
	maximum: 25000000
    };
```

## Documentation/devicetree/bindings/iio/dac/adi,ad8460.yaml
```yaml
# SPDX-License-Identifier: (GPL-2.0 OR BSD-2-Clause)
# Copyright 2024 Analog Devices Inc.
%YAML 1.2
---
$id: http://devicetree.org/schemas/iio/dac/adi,ad8460.yaml#
$schema: http://devicetree.org/meta-schemas/core.yaml#

title: Analog Devices AD8460 DAC

maintainers:
  - Mariel Tinaco <mariel.tinaco@analog.com>

description: |
  Analog Devices AD8460 110 V High Voltage, 1 A High Current,
  Arbitrary Waveform Generator with Integrated 14-Bit High Speed DAC
  https://www.analog.com/media/en/technical-documentation/data-sheets/ad8460.pdf

properties:
  compatible:
    enum:
      - adi,ad8460

  reg:
    maxItems: 1

  spi-max-frequency:
    maximum: 20000000

  vref-supply:
    description: Drive voltage in the range of 1.2V maximum to as low as
      low as 0.12V through the REF_IO pin to adjust full scale output span

  clocks:
    description: The clock for the DAC. This is the sync clock

  adi,rset-ohms:
    description: Specify value of external resistor connected to FS_ADJ pin
      to establish internal HVDAC's reference current I_REF
    minimum: 2000
    maximum: 20000

required:
  - compatible
  - reg
  - clocks

allOf:
  - $ref: /schemas/spi/spi-peripheral-props.yaml#

additionalProperties: false

examples:
  - |

    spi {
        dac@0 {
            compatible = "adi,ad8460";
            reg = <0>;
            spi-max-frequency = <8000000>;
            adi,rset-ohms = <2000>;

            vref-supply = <&vrefio>;
            clocks = <&sync_ext_clk>;
        };
    };

...
```

## Documentation/devicetree/bindings/iio/dac/adi,ad9739a.yaml
```yaml
# SPDX-License-Identifier: (GPL-2.0-only OR BSD-2-Clause)
%YAML 1.2
---
$id: http://devicetree.org/schemas/iio/dac/adi,ad9739a.yaml#
$schema: http://devicetree.org/meta-schemas/core.yaml#

title: Analog Devices AD9737A/AD9739A High-Speed DACs

maintainers:
  - Michael Hennerich <michael.hennerich@analog.com>
  - Dragos Bogdan <dragos.bogdan@analog.com>

description: |
  The AD9737A/AD9739A are 11-bit and 14-bit, 2.5 GSPS high performance RF DACs
  that are capable of synthesizing wideband signals from dc up to 3 GHz. 
 
  https://www.analog.com/media/en/technical-documentation/data-sheets/AD9737A_9739A.pdf

properties:
  compatible:
    enum:
      - adi,ad9737a
      - adi,ad9739a

  reg:
    maxItems: 1

  clocks:
    maxItems: 1

  clock-names:
    items:
      - const: dac-clk

  reset-gpios:
    description:
      Reset pin for the device.
    maxItems: 1

required:
  - compatible
  - reg
  - clocks
  - clock-names

additionalProperties: false

examples:
  - |
    spi {
        #address-cells = <1>;
        #size-cells = <0>;

        dac@0 {
          compatible = "adi,ad9739a";
          reg = <0>;
          clocks = <&dac_clk>;
          clock-names = "dac-clk";
        };
    };
...
```

## Documentation/devicetree/bindings/iio/dac/adi,axi-ad3552r.yaml
```yaml
# SPDX-License-Identifier: (GPL-2.0 OR BSD-2-Clause)
# Copyright 2023 Analog Devices Inc.
%YAML 1.2
---
$id: http://devicetree.org/schemas/iio/dac/adi,axi-ad3552r.yaml#
$schema: http://devicetree.org/meta-schemas/core.yaml#

title: Analog Devices AXI-AD3552R DAC device driver

maintainers:
  - Marcelo Schmitt <marcelo.schmitt@analog.com>


description: |
  Bindings for the Analog Devices AXI-AD3552R DAC device and similar.
  Datasheet can be found here:
    https://www.analog.com/media/en/technical-documentation/data-sheets/ad3552r.pdf

properties:
  compatible:
    enum:
      - adi,axi-ad3552r

  reg:
    maxItems: 1

  spi-max-frequency:
    maximum: 30000000

  reset-gpios:
    maxItems: 1

  dmas:
    maxItems: 1

  dma-names:
    const: tx

required:
  - compatible
  - reg
  - spi-max-frequency

additionalProperties: false

examples:
  - |
    #include <dt-bindings/gpio/gpio.h>
    fpga_axi {
        #address-cells = <1>;
        #size-cells = <1>;
        axi-ad3552r@0 {
            compatible = "adi,axi-ad3552r";
            reg = <0x44a74000 0x1000>;
            spi-max-frequency = <20000000>;
            reset-gpios = <&gpio0 92 GPIO_ACTIVE_LOW>;
            dmas = <&dac_tx_dma 0>;
            dma-names = "tx";
        };
    };
...
```
