## Documentation/devicetree/bindings/iio/dac/adi,axi-dac.yaml
```yaml
# SPDX-License-Identifier: (GPL-2.0-only OR BSD-2-Clause)
%YAML 1.2
---
$id: http://devicetree.org/schemas/iio/dac/adi,axi-dac.yaml#
$schema: http://devicetree.org/meta-schemas/core.yaml#

title: Analog Devices AXI DAC IP core

maintainers:
  - Michael Hennerich <michael.hennerich@analog.com>

description: |
  Analog Devices Generic AXI DAC IP core for interfacing an DAC device
  with a high speed serial (JESD204B/C) or source synchronous parallel
  interface (LVDS/CMOS).
  Usually, some other interface type (i.e SPI) is used as a control
  interface for the actual DAC, while this IP core will interface
  to the data-lines of the DAC and handle the streaming of data from
  memory via DMA.

  https://wiki.analog.com/resources/fpga/docs/axi_dac_ip

properties:
  compatible:
    enum:
      - adi,axi-dac-9.0.a

  reg:
    maxItems: 1

  dmas:
    maxItems: 1

  dma-names:
    items:
      - const: rx

  adi,dac-dev:
    $ref: /schemas/types.yaml#/definitions/phandle
    description:
      A reference to a the actual DAC to which this FPGA DAC interfaces to.

required:
  - compatible
  - dmas
  - reg
  - adi,dac-dev

additionalProperties: false

examples:
  - |
    axi-dac@44a00000 {
          compatible = "adi,axi-dac-9.0.a";
          reg = <0x44a00000 0x10000>;
          dmas = <&tx_dma 0>;
          dma-names = "tx";

          adi,dac-dev = <&spi_dac>;
    };
...
```

## Documentation/devicetree/bindings/iio/dac/adi,ltc2664.yaml
```yaml
# SPDX-License-Identifier: (GPL-2.0-only OR BSD-2-Clause)
%YAML 1.2
---
$id: http://devicetree.org/schemas/iio/dac/adi,ltc2664.yaml#
$schema: http://devicetree.org/meta-schemas/core.yaml#

title: Analog Devices LTC2664 and LTC2672 DAC

maintainers:
  - Michael Hennerich <michael.hennerich@analog.com>
  - Kim Seer Paller <kimseer.paller@analog.com>

description: |
  Analog Devices LTC2664 4 channel, 16 bit, +-10V DAC
  Analog Devices LTC2672 5 channel, 16 bit, 300mA DAC
  https://www.analog.com/media/en/technical-documentation/data-sheets/ltc2664.pdf
  https://www.analog.com/media/en/technical-documentation/data-sheets/ltc2672.pdf

properties:
  compatible:
    enum:
      - adi,ltc2664
      - adi,ltc2672

  reg:
    maxItems: 1

  spi-max-frequency:
    maximum: 50000000

  vcc-supply:
    description: Analog Supply Voltage Input.

  iovcc-supply:
    description: Digital Input/Output Supply Voltage.

  vref-supply:
    description:
      Reference Input/Output. The voltage at the REF pin sets the full-scale
      range of all channels. If not provided the internal reference is used and
      also provided on the VREF pin.

  clr-gpios:
    description:
      If specified, it will be asserted during driver probe. As the line is
      active low, it should be marked GPIO_ACTIVE_LOW.
    maxItems: 1

  '#address-cells':
    const: 1

  '#size-cells':
    const: 0

allOf:
  - if:
      properties:
        compatible:
          contains:
            const: adi,ltc2664
    then:
      properties:
        adi,manual-span-operation-config:
          description:
            This property must mimic the MSPAN pin configurations.
            By tying the MSPAN pins (MSP2, MSP1 and MSP0) to GND
            and/or VCC, any output range can be hardware-configured
            with different mid-scale or zero-scale reset options.
            The hardware configuration is latched during power on reset
            for proper operation.
              0 - MPS2=GND, MPS1=GND, MSP0=GND
              1 - MPS2=GND, MPS1=GND, MSP0=VCC
              2 - MPS2=GND, MPS1=VCC, MSP0=GND
              3 - MPS2=GND, MPS1=VCC, MSP0=VCC
              4 - MPS2=VCC, MPS1=GND, MSP0=GND
              5 - MPS2=VCC, MPS1=GND, MSP0=VCC
              6 - MPS2=VCC, MPS1=VCC, MSP0=GND
              7 - MPS2=VCC, MPS1=VCC, MSP0=VCC (enables SoftSpan feature)
          $ref: /schemas/types.yaml#/definitions/uint32
          enum: [0, 1, 2, 3, 4, 5, 6, 7]
          default: 7

      patternProperties:
        "^channel@([0-3])$":
          type: object
          properties:
            adi-toggle-mode:
              description:
                Set the channel as a toggle enabled channel. Toggle operation
                enables fast switching of a DAC output between two different DAC
                codes without any SPI transaction.
              type: boolean

            adi,output-range-microvolt:
              description: Specify the channel output full scale range.
              oneOf:
                - items:
                    - const: 0
                    - enum: [5000000, 10000000]
                - items:
                    - const: -5000000
                    - const: 5000000
                - items:
                    - const: -10000000
                    - const: 10000000
                - items:
                    - const: -2500000
                    - const: 2500000

          required:
            - adi,output-range-microvolt

  - if:
      properties:
        compatible:
          contains:
            const: adi,ltc2672
    then:
      properties:
        adi,rfsadj-ohms:
          description: If FSADJ is tied to VCC, an internal RFSADJ (20 kΩ) is
            selected, which results in nominal output ranges. When an external
            resistor of 19 kΩ to 41 kΩ can be used instead by connecting the
            resistor between FSADJ and GND it controls the scaling of the
            ranges, and the internal resistor is automatically disconnected.
          minimum: 19000
          maximum: 41000
          default: 20000

      patternProperties:
        "^channel@([0-4])$":
          type: object
          properties:
            adi,toggle-mode:
              description:
                Set the channel as a toggle enabled channel. Toggle operation
                enables fast switching of a DAC output between two different DAC
                codes without any SPI transaction.
              type: boolean

            adi,output-range-microamp:
              description: Specify the channel output full scale range.
              $ref: /schemas/types.yaml#/definitions/uint32
              enum: [3125000, 6250000, 12500000, 25000000, 50000000, 100000000,
                     200000000, 300000000]

          required:
            - adi,output-range-microamp

patternProperties:
  "^channel@[0-4]$":
    type: object

required:
  - compatible
  - reg
  - spi-max-frequency
  - vcc-supply
  - iovcc-supply

additionalProperties: false

examples:
  - |
    spi {
          #address-cells = <1>;
          #size-cells = <0>;
          dac@0 {
                  compatible = "adi,ltc2664";
                  reg = <0>;
                  spi-max-frequency = <10000000>;

                  vcc-supply = <&vcc>;
                  iovcc-supply = <&vcc>;
                  vref-supply = <&vref>;

                  #address-cells = <1>;
                  #size-cells = <0>;
                  channel@0 {
                          reg = <0>;
                          adi,toggle-mode;
                          adi,output-range-microvolt = <(-10000000) 10000000>;
                  };

                  channel@1 {
                          reg = <1>;
                          adi,output-range-microvolt = <0 10000000>;
                  };
          };
    };
  - |
    spi {
          #address-cells = <1>;
          #size-cells = <0>;
          dac@0 {
                  compatible = "adi,ltc2672";
                  reg = <0>;
                  spi-max-frequency = <10000000>;

                  vcc-supply = <&vcc>;
                  iovcc-supply = <&vcc>;
                  vref-supply = <&vref>;

                  #address-cells = <1>;
                  #size-cells = <0>;
                  channel@0 {
                          reg = <0>;
                          adi,toggle-mode;
                          adi,output-range-microamp = <3125000>;
                  };

                  channel@1 {
                          reg = <1>;
                          adi,output-range-microamp = <6250000>;
                  };
          };
    };
...
```

## Documentation/devicetree/bindings/iio/dac/adi,max22007.yaml
```yaml
# SPDX-License-Identifier: (GPL-2.0 OR BSD-2-Clause)
%YAML 1.2
---
$id: http://devicetree.org/schemas/iio/dac/adi,max22007.yaml#
$schema: http://devicetree.org/meta-schemas/core.yaml#

title: Analog Devices MAX22007 DAC device driver

maintainers:
  - Janani Sunil <janani.sunil@analog.com>

description:
  The MAX22007 is a quad-channel, 12-bit digital-to-analog converter (DAC)
  with integrated precision output amplifiers and current output capability.
  Each channel can be independently configured for voltage or current output.
  Datasheet available at https://www.analog.com/en/products/max22007.html

$ref: /schemas/spi/spi-peripheral-props.yaml#

properties:
  compatible:
    const: adi,max22007

  reg:
    maxItems: 1

  spi-max-frequency:
    maximum: 500000

  '#address-cells':
    const: 1

  '#size-cells':
    const: 0

  vdd-supply:
    description: Low-Voltage Power Supply from +2.7V to +5.5V.

  hvdd-supply:
    description:
      Positive High-Voltage Power Supply from +8V to (HVSS +24V) for
      the Output Channels.

  hvss-supply:
    description:
      Negative High-Voltage Power Supply from -2V to 0V for the Output Channels.

  reset-gpios:
    maxItems: 1
    description:
      GPIO used for hardware reset of the device.

patternProperties:
  "^channel@[0-3]$":
    allOf:
      - $ref: /schemas/iio/dac/dac.yaml#
      - type: object
        description:
          Represents the external channels which are connected to the DAC.
          Channels not specified in the device tree will be powered off.

        properties:
          reg:
            description: Channel number
            maxItems: 1

          adi,type:
            description: Channel output type.
            $ref: /schemas/types.yaml#/definitions/string
            enum: [voltage, current]

        required:
          - reg
          - adi,type

        unevaluatedProperties: false

required:
  - compatible
  - reg

anyOf:
  - required: [channel@0]
  - required: [channel@1]
  - required: [channel@2]
  - required: [channel@3]

unevaluatedProperties: false

examples:
  - |
    #include <dt-bindings/gpio/gpio.h>
    spi {
        #address-cells = <1>;
        #size-cells = <0>;

        dac@0 {
            compatible = "adi,max22007";
            reg = <0>;
            spi-max-frequency = <500000>;
            reset-gpios = <&gpio 19 GPIO_ACTIVE_LOW>;
            #address-cells = <1>;
            #size-cells = <0>;

            channel@0 {
                reg = <0>;
                adi,type = "voltage";
            };

            channel@1 {
                reg = <1>;
                adi,type = "current";
            };
        };
    };
...
```
