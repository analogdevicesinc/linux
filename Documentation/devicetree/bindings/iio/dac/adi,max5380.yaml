## Documentation/devicetree/bindings/iio/frequency/adi,adf41513.yaml
```yaml
# SPDX-License-Identifier: (GPL-2.0-only OR BSD-2-Clause)
%YAML 1.2
---
$id: http://devicetree.org/schemas/iio/frequency/adi,adf41513.yaml#
$schema: http://devicetree.org/meta-schemas/core.yaml#

title: Analog Devices ADF41513 PLL Frequency Synthesizer

maintainers:
  - Rodrigo Alencar <rodrigo.alencar@analog.com>

description:
  The ADF41513 is an ultralow noise frequency synthesizer that can be used to
  implement local oscillators (LOs) as high as 26.5 GHz in the upconversion and
  downconversion sections of wireless receivers and transmitters. The ADF41510
  supports frequencies up to 10 GHz.

  https://www.analog.com/en/products/adf41513.html
  https://www.analog.com/en/products/adf41510.html

$ref: /schemas/spi/spi-peripheral-props.yaml#

properties:
  compatible:
    enum:
      - adi,adf41510
      - adi,adf41513

  reg:
    maxItems: 1

  spi-max-frequency:
    maximum: 25000000

  clocks:
    maxItems: 1
    description: Clock that provides the reference input frequency.

  avdd1-supply:
    description: PFD and Up and Down Digital Driver Power Supply (3.3 V)

  avdd2-supply:
    description: RF Buffer and Prescaler Power Supply (3.3 V)

  avdd3-supply:
    description: N Divider Power Supply (3.3 V)

  avdd4-supply:
    description: R Divider and Lock Detector Power Supply (3.3 V)

  avdd5-supply:
    description: Sigma-Delta Modulator and SPI Power Supply (3.3 V)

  vp-supply:
    description: Charge Pump Power Supply (3.3 V)

  enable-gpios:
    description:
      GPIO that controls the chip enable pin. A logic low on this pin
      powers down the device and puts the charge pump output into
      three-state mode.
    maxItems: 1

  lock-detect-gpios:
    description:
      GPIO for lock detect functionality. When configured for digital lock
      detect, this pin will output a logic high when the PLL is locked.
    maxItems: 1

  adi,power-up-frequency:
    $ref: /schemas/types.yaml#/definitions/uint64
    minimum: 1000000000
    maximum: 26500000000
    default: 10000000000
    description:
      The PLL tunes to this frequency (in Hz) during the initialization
      sequence. This property should be set to a frequency supported by the
      loop filter and VCO used in the design. Range is 1 GHz to 26.5 GHz for
      ADF41513, and 1 GHz to 10 GHz for ADF41510.

  adi,reference-div-factor:
    $ref: /schemas/types.yaml#/definitions/uint32
    minimum: 1
    maximum: 32
    default: 1
    description:
      Value for the reference division factor (R Counter). The driver will
      increment R Counter as needed to achieve a PFD frequency within the
      allowed range. High R counter values will reduce the PFD frequency, which
      lowers the frequency resolution, and affects phase noise performance.

  adi,reference-doubler-enable:
    description:
      Enables the reference doubler. The maximum reference frequency when
      the doubler is enabled is 225 MHz.
    type: boolean

  adi,reference-div2-enable:
    description:
      Enables the reference divide-by-2 function. This provides a 50%
      duty cycle signal to the PFD.
    type: boolean

  adi,charge-pump-resistor-ohms:
    minimum: 1800
    maximum: 10000
    default: 2700
    description:
      External charge pump resistor (R_SET) value in ohms. This sets the maximum
      charge pump current along with the charge pump current setting.

  adi,charge-pump-current-microamp:
    description:
      Charge pump current (I_CP) in microamps. The value will be rounded to the
      nearest supported value. Range of acceptable values depends on the
      charge pump resistor value, such that 810 mV <= I_CP * R_SET <= 12960 mV.
      This value depends on the loop filter design.

  adi,muxout-select:
    description:
      On chip multiplexer output selection.
      high_z - MUXOUT Pin set to high-Z. (default)
      muxout_high - MUXOUT Pin set to high.
      muxout_low - MUXOUT Pin set to low.
      f_div_rclk - MUXOUT Pin set to R divider output
      f_div_nclk - MUXOUT Pin set to N divider output
      lock_detect - MUXOUT Pin set to Digital lock detect
      serial_data - MUXOUT Pin set to Serial data output
      readback - MUXOUT Pin set to Readback mode
      f_div_clk1 - MUXOUT Pin set to CLK1 divider output
      f_div_rclk_2 - MUXOUT Pin set to R divider/2 output
      f_div_nclk_2 - MUXOUT Pin set to N divider/2 output
    enum: [high_z, muxout_high, muxout_low, f_div_rclk, f_div_nclk, lock_detect,
           serial_data, readback, f_div_clk1, f_div_rclk_2, f_div_nclk_2]

  adi,muxout-level-1v8-enable:
    description:
      Set MUXOUT and DLD logic levels to 1.8V. Default is 3.3V.
    type: boolean

  adi,phase-detector-polarity-positive-enable:
    description:
      Set phase detector polarity to positive. Default is negative.
      Use positive polarity with non-inverting loop filter and VCO with
      positive tuning slope, or with inverting loop filter and VCO with
      negative tuning slope.
    type: boolean

  adi,lock-detector-count:
    $ref: /schemas/types.yaml#/definitions/uint32
    default: 64
    description:
      Sets the value for Lock Detector count of the PLL, which determines the
      number of consecutive phase detector cycles that must be within the lock
      detector window before lock is declared. Lower values increase the lock
      detection sensitivity.
    enum: [2, 4, 8, 16, 32, 64, 128, 256, 512, 1024, 2048, 4096, 8192]

  adi,phase-resync-period-ns:
    default: 0
    description:
      When this value is non-zero, enable phase resync functionality, which
      produces a consistent output phase offset with respect to the input
      reference. The value specifies the resync period in nanoseconds, used
      to configure clock dividers with respect to the PFD frequency. This value
      should be set to a value that is at least as long as the worst case lock
      time, i.e., it depends mostly on the loop filter design.

  adi,le-sync-enable:
    description:
      Synchronizes Load Enable (LE) transitions with the reference signal to
      avoid asynchronous glitches in the output. This is recommended when using
      the PLL as a frequency synthesizer, where reference signal will always be
      present while the device is being configured. When using the PLL as a
      frequency tracker, where the reference signal may be absent for long
      periods of time, LE sync should be disabled.
    type: boolean

required:
  - compatible
  - reg
  - clocks
  - avdd1-supply
  - avdd2-supply
  - avdd3-supply
  - avdd4-supply
  - avdd5-supply
  - vp-supply

unevaluatedProperties: false

examples:
  - |
    spi {
        #address-cells = <1>;
        #size-cells = <0>;

        pll@0 {
            compatible = "adi,adf41513";
            reg = <0>;
            spi-max-frequency = <10000000>;
            clocks = <&ref_clk>;
            avdd1-supply = <&vdd_3v3>;
            avdd2-supply = <&vdd_3v3>;
            avdd3-supply = <&vdd_3v3>;
            avdd4-supply = <&vdd_3v3>;
            avdd5-supply = <&vdd_3v3>;
            vp-supply = <&vdd_3v3>;

            adi,power-up-frequency = /bits/ 64 <12000000000>;
            adi,charge-pump-current-microamp = <2400>;
            adi,phase-detector-polarity-positive-enable;
        };
    };
  - |
    #include <dt-bindings/gpio/gpio.h>
    spi {
        #address-cells = <1>;
        #size-cells = <0>;

        pll@0 {
            compatible = "adi,adf41513";
            reg = <0>;
            spi-max-frequency = <25000000>;
            clocks = <&ref_clk>;
            avdd1-supply = <&avdd1_3v3>;
            avdd2-supply = <&avdd2_3v3>;
            avdd3-supply = <&avdd3_3v3>;
            avdd4-supply = <&avdd4_3v3>;
            avdd5-supply = <&avdd5_3v3>;
            vp-supply = <&vp_3v3>;
            enable-gpios = <&gpio0 10 GPIO_ACTIVE_HIGH>;
            lock-detect-gpios = <&gpio0 11 GPIO_ACTIVE_HIGH>;

            adi,power-up-frequency = /bits/ 64 <15500000000>;
            adi,charge-pump-current-microamp = <3600>;
            adi,charge-pump-resistor-ohms = <2700>;
            adi,reference-doubler-enable;
            adi,muxout-select = "lock_detect";
            adi,lock-detector-count = <64>;
            adi,phase-resync-period-ns = <0>;
            adi,phase-detector-polarity-positive-enable;
            adi,le-sync-enable;
        };
    };
...
```

## Documentation/devicetree/bindings/iio/frequency/adi,adf4360.yaml
```yaml
# SPDX-License-Identifier: GPL-2.0
# Copyright 2019 Analog Devices Inc.
%YAML 1.2
---
$id: http://devicetree.org/schemas/iio/frequency/adi,adf4360.yaml#
$schema: http://devicetree.org/meta-schemas/core.yaml#

title: Analog Devices ADF4360 PLL device driver

maintainers:
  - Lars-Peter Clausen <lars@metafoo.de>
  - Edward Kigwana <ekigwana@gmail.com>

description: |
  Bindings for the Analog Devices ADF4360 family of clock generator phase-locked
  loop (PLL) devices with an integrated voltage-controlled oscillator (VCO).
  Each of the parts in the family supports a specific frequency range.
  Datasheets can be found here:
  https://www.analog.com/media/en/technical-documentation/data-sheets/ADF4360-0.pdf
  https://www.analog.com/media/en/technical-documentation/data-sheets/ADF4360-1.pdf
  https://www.analog.com/media/en/technical-documentation/data-sheets/ADF4360-2.pdf
  https://www.analog.com/media/en/technical-documentation/data-sheets/ADF4360-3.pdf
  https://www.analog.com/media/en/technical-documentation/data-sheets/ADF4360-4.pdf
  https://www.analog.com/media/en/technical-documentation/data-sheets/ADF4360-5.pdf
  https://www.analog.com/media/en/technical-documentation/data-sheets/ADF4360-6.pdf
  https://www.analog.com/media/en/technical-documentation/data-sheets/ADF4360-7.pdf
  https://www.analog.com/media/en/technical-documentation/data-sheets/ADF4360-8.pdf
  https://www.analog.com/media/en/technical-documentation/data-sheets/ADF4360-9.pdf

properties:
  compatible:
    enum:
      - adi,adf4360-0
      - adi,adf4360-1
      - adi,adf4360-2
      - adi,adf4360-3
      - adi,adf4360-4
      - adi,adf4360-5
      - adi,adf4360-6
      - adi,adf4360-7
      - adi,adf4360-8
      - adi,adf4360-9

  reg:
    maxItems: 1

  clocks:
    description: phandle to external reference clock.
    maxItems: 1

  clock-names:
    items:
      - const: clkin

  '#clock-cells':
    const: 0

  adi,loop-filter-pfd-frequency-hz:
    description: |
      The phase-frequency-detector frequency that the external loop filter was
      designed for.
    allOf:
      - $ref: /schemas/types.yaml#/definitions/uint32
    maxItems: 1

  adi,loop-filter-charger-pump-current-microamp:
    description: |
      The charge pump current that the external loop filter was designed for.
      The provided value is clamped to the closest enumerated value.
    allOf:
      - $ref: /schemas/types.yaml#/definitions/uint32
      - enum: [310, 620, 930, 1250, 1560, 1870, 2180, 2500]
    maxItems: 1

  adi,vco-minimum-frequency-hz:
    description: |
      Required for ADF4360-7, ADF4360-8 and ADF4360-9. Minimum VCO frequency
      that can be supported by the tuning range set by the external inductor.
    allOf:
      - $ref: /schemas/types.yaml#/definitions/uint32
    maxItems: 1

  adi,vco-maximum-frequency-hz:
    description: |
      Required for ADF4360-7, ADF4360-8 and ADF4360-9. Maximum VCO frequency
      that can be supported by the tuning range set by the external inductor.
    allOf:
      - $ref: /schemas/types.yaml#/definitions/uint32
    maxItems: 1

  adi,loop-filter-inverting:
    description: Indicates that the external loop filter is an inverting filter.
    type: boolean
    maxItems: 1

  adi,power-up-frequency-hz:
    description: |
    PLL tunes to the set frequency on probe or defaults to either the minimum
    for the part or value set using adi,vco-minimum-frequency-hz.
    allOf:
      - $ref: /schemas/types.yaml#/definitions/uint32
    maxItems: 1

  adi,vdd-supply:
    description: |
      vdd supply is used to enable or disable chip when regulator power down
      mode is set. Other power down modes are used to mitigate the case of a
      shared regulator.
    maxItems: 1

  adi,enable-gpios:
    description: |
      Chip enable gpio is used to enable or disable chip when chip enable power
      down mode is set.
    maxItems: 1

  adi,muxout-gpios:
    description: |
      MUX out gpio is used to detect chip and test pll lock state on read when
      muxout control is set to lock detect.
    maxItems: 1

  adi,power-out-level-microamp:
    description: |
      Chip support setting of output power level. This property is optional.
      If it is not provided by default 11000 uA will be set.
    allOf:
      - enum: [3500, 5000, 7500, 11000]

required:
  - compatible
  - reg
  - clocks
  - clock-names
  - adi,loop-filter-charge-pump-current
  - adi,loop-filter-pfd-frequency-hz

examples:
  - |
    spi0 {
      #address-cells = <1>;
      #size-cells = <0>;

      pll@0 {
        compatible = "adi,adf4360-7";
        reg = <0>;
        spi-max-frequency = <2000000>;
        clocks = <&ref_clock>;
        #clock-cells = <0>;
        clock-output-names = "adf4360-7";

        adi,loop-filter-charge-pump-current = <5>;
        adi,loop-filter-pfd-frequency-hz = <2500000>;
        adi,vco-minimum-frequency-hz = <700000000>;
        adi,vco-maximum-frequency-hz = <840000000>;
      };
   };
...
```

## Documentation/devicetree/bindings/iio/frequency/adi,adf4377.yaml
```yaml
# SPDX-License-Identifier: (GPL-2.0-only OR BSD-2-Clause)
%YAML 1.2
---
$id: http://devicetree.org/schemas/iio/frequency/adi,adf4377.yaml#
$schema: http://devicetree.org/meta-schemas/core.yaml#

title: ADF4377 Microwave Wideband Synthesizer with Integrated VCO

maintainers:
  - Antoniu Miclaus <antoniu.miclaus@analog.com>
  - Dragos Bogdan <dragos.bogdan@analog.com>

description: |
   The ADF4377 is a high performance, ultralow jitter, dual output integer-N
   phased locked loop (PLL) with integrated voltage controlled oscillator (VCO)
   ideally suited for data converter and mixed signal front end (MxFE) clock
   applications.

   https://www.analog.com/en/products/adf4377.html

properties:
  compatible:
    enum:
      - adi,adf4377
      - adi,adf4378

  reg:
    maxItems: 1

  spi-max-frequency:
    maximum: 10000000

  clocks:
    maxItems: 1

  clock-names:
    description:
      External clock that provides reference input frequency.
    items:
      - const: ref_in

  ce-en-gpios:
    description:
      Gpio that controls the Chip Enable Pin.
    maxItems: 1

  enclk1-gpios:
    description:
      Gpio that controls the Enable Clock 1 Output Buffer Pin.
    maxItems: 1

  enclk2-gpios:
    description:
      Gpio that controls the Enable Clock 2 Output Buffer Pin.
    maxItems: 1

required:
  - compatible
  - reg
  - clocks
  - clock-names

additionalProperties: false

examples:
  - |
    spi {
        #address-cells = <1>;
        #size-cells = <0>;
        frequency@0 {
            compatible = "adi,adf4377";
            reg = <0>;
            spi-max-frequency = <10000000>;
            clocks = <&adf4377_ref_in>;
            clock-names = "ref_in";
        };
    };
...
```
