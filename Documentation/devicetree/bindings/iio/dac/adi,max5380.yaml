## Documentation/devicetree/bindings/iio/frequency/adi,adf4382.yaml
```yaml
# SPDX-License-Identifier: (GPL-2.0-only OR BSD-2-Clause)
%YAML 1.2
---
$id: http://devicetree.org/schemas/iio/frequency/adi,adf4382.yaml#
$schema: http://devicetree.org/meta-schemas/core.yaml#

title: ADF4382 Microwave Wideband Synthesizer with Integrated VCO

maintainers:
  - Antoniu Miclaus <antoniu.miclaus@analog.com>
  - Ciprian Hegbeli <ciprian.hegbeli@analog.com>

description: The ADF4382 is a high performance, ultralow jitter, Frac-N PLL with
   integrated VCO ideally suited for LO generation for 5G applications
   or data converter clock applications.

   https://www.analog.com/en/products/adf4382a.html

properties:
  compatible:
    enum:
      - adi,adf4382
      - adi,adf4382a

  reg:
    maxItems: 1

  spi-max-frequency:
    maximum: 75000000

  clocks:
    description: Clock to provide CLKIN reference clock signal.
    maxItems: 1

  clock-names:
    description:
      External clock that provides reference input frequency.
    items:
      - const: ref_clk

  '#clock-cells':
    const: 0

  clock-output-names:
    maxItems: 1

  adi,charge-pump-microamp:
    description:
      The charge pump current that the external loop filter was designed for.
      If this property is not specified, then the charge pump current is set to the
      default 11100uA. The valid values are listed below. However, if the set value is
      not supported, the driver will look for the closest valid charge pump current.
    anyOf:
      - enum: [790, 990, 1190, 1380, 1590, 1980, 2390, 2790, 3180, 3970, 4770, 5570, 6330, 7910, 9510, 11100]

  adi,ref-divider:
    description:
      Input divider of the reference frequency, cannot be lower then 1 or
      higher then 63.
    allOf:
      - $ref: /schemas/types.yaml#/definitions/uint32
      - minimum: 1
      - maximum: 63
      - default: 1
    maxItems: 1
  
  adi,ref-doubler-enable:
    description:
      Enables the doubling of the reference clock.
    type: boolean
    maxItems: 1

  adi,bleed-word:
    description:
      A small programmable constant charge pump current, known as bleed current,
      can be used to optimize the phase noise and fractional spurious signals
      in fractional mode.
    allOf:
      - $ref: /schemas/types.yaml#/definitions/uint32
      - minimum: 0
      - maximum: 4095
      - default: 0
    maxItems: 1

  adi,power-up-frequency:
    description:
      PLL tunes to the set frequency on probe or defaults to 2,305 GHz.
    allOf:
      - $ref: /schemas/types.yaml#/definitions/uint64
      - minimum: 687500000
      - maximum: 22000000000
      - default: 2305000000
    maxItems: 1

  adi,output-power-value:
    description:
      The output power amplitude level which will be applied for both channels
      at startup.
    allOf:
      - $ref: /schemas/types.yaml#/definitions/uint32
      - minimum: 0
      - maximum: 15
      - default: 11
    maxItems: 1
  
  adi,spi-3wire-enable:
    description:
      Uses SPI in 3 wire mode, by default is uses 4 wire mode.
    type: boolean
    maxItems: 1
  
  adi,cmos-3v3:
    description:
      Sets the SPI logic to 3.3V, by defautl it uses 1,8V.
    type: boolean
    maxItems: 1

required:
  - compatible
  - reg
  - clocks
  - clock-names

additionalProperties: false

examples:
  - |
    spi {
        #address-cells = <1>;
        #size-cells = <0>;
        frequency@0 {
          compatible = "adi,adf4382";
          reg = <0>;
          spi-max-frequency = <1000000>;
          clocks = <&adf4382_clkin>;
          clock-names = "ref_clk";
          adi,charge-pump-current = <15>;
          adi,ref-divider = <1>;
        };
    };
...
```

## Documentation/devicetree/bindings/iio/frequency/adi,adf5610.yaml
```yaml
# SPDX-License-Identifier: (GPL-2.0-only OR BSD-2-Clause)
%YAML 1.2
---
$id: http://devicetree.org/schemas/iio/frequency/adi,adl5960.yaml#
$schema: http://devicetree.org/meta-schemas/core.yaml#

title: Analog Devices ADF5610 device driver

maintainers:
- Dragos Bogdan <dragos.bogdan@analog.com>

description: |
  The ADF5610 allows implementation of fractional-N or Integer N
  phase-locked loop (PLL) frequency synthesizers when used
  with an external loop filter and an external reference source.
  The wideband microwave voltage controlled oscillator (VCO)
  design permits frequency operation from 7300 MHz to
  14600 MHz at a single radio frequency (RF) output. A series of
  frequency dividers with a differential frequency output allows
  operation from 57 MHz to 14600 MHz.

properties:
  compatible:
    enum:
      - adi,adf5610

  reg:
    maxItems: 1

  spi-cs-high:
    description:
      In Legacy Mode, ADF5610 requires the chip select active high.

  spi-max-frequency:
    maximum: 50000000

  clocks:
    description:
      Definition of the external reference clock (see
      clock/clock-bindings.txt)
    minItems: 1

  clock-names:
    description:
      Must be "xref"
    maxItems: 1

  clock-scales:
    description:
      The Common Clock Framework max rate is limited by MAX
      of unsigned long. For ADF5610, this is a deficiency.
      If specified, this property allows arbitrary scales.
      The first element in the array should be the multiplier
      and the second element should be the divider.
    allOf:
      $ref: /schemas/types.yaml#/definitions/uint32-array
      minimum: 1

  adi,legacy-serial-port-mode:
    description:
      Enables Legacy Mode instead of Open Mode.

  adi,power-up-div-out-frequency-hz:
    description:
      Specifies the power-up DIV_OUT (PDIV_OUT, NDIV_OUT)
      frequency.

  adi,charge-pump-down-gain-ua:
    description:
      Charge pump down gain control. Affects fractional phase
      noise and lock detect settings.

  adi,charge-pump-up-gain-ua:
    description:
      Charge pump up gain control. Affects fractional phase
      noise and lock detect settings.

  adi,charge-pump-offset-ua:
    description:
      Charge pump offset control. Affects fractional phase
      noise and lock detect settings.

  adi,charge-pump-offset-down-enable:
    description:
      Charge pump up offset enable. Recommended setting
      in fractional mode using a passive loop equals 1
      decimal. Do not enable in integer mode.

  adi,charge-pump-offset-up-enable:
    description:
      Charge pump up offset enable. Recommended setting
      in fractional mode using a passive loop equals 0
      decimal. Do not enable in integer mode.

  adi,charge-pump-high-current-enable:
    description:
      High current charge pump enable. Low noise, narrow
      compliance range. Requires an op amp.

required:
  - compatible
  - reg
  - spi-max-frequency
  - clocks
  - clock-names
  - clock-scales

additionalProperties: false

examples:
  - |
    spi0 {
        #address-cells = <1>;
        #size-cells = <0>;
        frequency@0 {
                compatible = "adi,adf5610";
                reg = <0>;
                spi-cs-high;
                spi-max-frequency = <10000000>;

                clocks = <&adf5610_xref>;
                clock-names = "xref";
                clock-scales = <1 10>;

                adi,legacy-serial-port-mode;

                adi,power-up-div-out-frequency-hz = /bits/ 64 <10000600000>;

                adi,charge-pump-down-gain-ua =  /bits/ 16 <2540>;
                adi,charge-pump-up-gain-ua =  /bits/ 16 <2540>;
                adi,charge-pump-offset-ua =   /bits/ 16  <520>;
                adi,charge-pump-offset-down-enable;
       };
    };
...
```

## Documentation/devicetree/bindings/iio/frequency/adi,adl5960.yaml
```yaml
# SPDX-License-Identifier: GPL-2.0
%YAML 1.2
---
$id: http://devicetree.org/schemas/iio/frequency/adi,adl5960.yaml#
$schema: http://devicetree.org/meta-schemas/core.yaml#

title: Analog Devices ADL5960 Vector Network Analyzer Front-End

maintainers:
- Michael Hennerich <michael.hennerich@analog.com>

description: |
   The ADL5960 is a wideband, front-end vector network analyzer
   that consists of a bidirectional bridge, downconverters,
   programmable IF amplifiers, and a configurable
   local oscillator (LO) interface.

properties:
  compatible:
    enum:
      - adi,adl5960

  reg:
    maxItems: 1

  spi-max-frequency:
    maximum: 50000000

  clocks:
    description:
      Definition of the external clock (see clock/clock-bindings.txt)
    minItems: 2

  clock-names:
    items:
      - const: lo_in
      - const: offs_in
    maxItems: 2

  lo_in-clock-scales:
    description:
      The Common Clock Framework max rate is limited by MAX of unsigned long.
      For ADL5960 device this is a deficiency. If specified, this
      property allows arbitrary scales. The first element in the array should
      be the multiplier and the second element should be the divider.
    $ref: /schemas/types.yaml#/definitions/uint32-array
    minimum: 1

  avcc-supply:
    description:
      analog voltage regulator (see regulator/regulator.txt)

  '#clock-cells':
    const: 0

required:
- compatible
- reg
- clocks
- clock-names

additionalProperties: false

examples:
- |
  spi {
    adl5960-1@0 {
      compatible = "adi,adl5960";
      reg = <0>;
      spi-max-frequency = <12500000>;

      /* Clocks */
      clocks = <&adf5610>, <&ad9528 4>;
      clock-names = "lo_in", "offs_in";
      lo_in-clock-scales = <1 10>;
      label = "adl5960-1";
    };
  };
...
```

## Documentation/devicetree/bindings/iio/frequency/adi,admfm2000.yaml
```yaml
# SPDX-License-Identifier: (GPL-2.0-only OR BSD-2-Clause)
# Copyright 2023 Analog Devices Inc.
%YAML 1.2
---
$id: http://devicetree.org/schemas/iio/frequency/adi,admfm2000.yaml#
$schema: http://devicetree.org/meta-schemas/core.yaml#

title: ADMFM2000 Dual Microwave Down Converter

maintainers:
  - Kim Seer Paller <kimseer.paller@analog.com>

description: |
    Dual microwave down converter module with input RF and LO frequency ranges
    from 0.5 to 32 GHz and an output IF frequency range from 0.1 to 8 GHz.
    It consists of a LNA, mixer, IF filter, DSA, and IF amplifier for each down
    conversion path.

properties:
  compatible:
    enum:
      - adi,admfm2000

  vcc-supply: true

  switch1-gpios:
    description:
      Must contain an array of 2 GPIO specifiers, referring to the GPIO pins
      connected to the channel 1 switch controls.
    minItems: 2
    maxItems: 2

  switch2-gpios:
    description:
      Must contain an array of 2 GPIO specifiers, referring to the GPIO pins
      connected to the channel 2 switch controls.
    minItems: 2
    maxItems: 2

  attenuation1-gpios:
    description:
      Must contain an array of 5 GPIO specifiers, referring to the GPIO pins
      connected to the channel 1 DSA attenuation controls.
    minItems: 5
    maxItems: 5

  attenuation2-gpios:
    description:
      Must contain an array of 5 GPIO specifiers, referring to the GPIO pins
      connected to the channel 2 DSA attenuation controls.
    minItems: 5
    maxItems: 5

  '#address-cells':
    const: 1

  '#size-cells':
    const: 0

patternProperties:
  "^channel@[0-1]$":
    type: object
    description: Represents a channel of the device.

    properties:
      reg:
        description:
          The channel number.
        minimum: 0
        maximum: 1

      adi,direct-if-mode:
        description:
          Bypass mixer mode.
        type: boolean

    required:
      - reg

required:
  - compatible
  - switch1-gpios
  - switch2-gpios
  - attenuation1-gpios
  - attenuation2-gpios

additionalProperties: false

examples:
  - |
    #include <dt-bindings/gpio/gpio.h>
    admfm2000 {
      compatible = "adi,admfm2000";

      switch1-gpios = <&gpio 1 GPIO_ACTIVE_LOW>,
        <&gpio 2 GPIO_ACTIVE_HIGH>;

      switch2-gpios = <&gpio 3 GPIO_ACTIVE_LOW>,
        <&gpio 4 GPIO_ACTIVE_HIGH>;

      attenuation1-gpios = <&gpio 17 GPIO_ACTIVE_LOW>,
        <&gpio 22 GPIO_ACTIVE_LOW>,
        <&gpio 23 GPIO_ACTIVE_LOW>,
        <&gpio 24 GPIO_ACTIVE_LOW>,
        <&gpio 25 GPIO_ACTIVE_LOW>;

      attenuation2-gpios = <&gpio 0 GPIO_ACTIVE_LOW>,
        <&gpio 5 GPIO_ACTIVE_LOW>,
        <&gpio 6 GPIO_ACTIVE_LOW>,
        <&gpio 16 GPIO_ACTIVE_LOW>,
        <&gpio 26 GPIO_ACTIVE_LOW>;

      #address-cells = <1>;
      #size-cells = <0>;

      channel@0 {
        reg = <0>;
        adi,direct-if-mode;
      };

      channel@1 {
        reg = <1>;
      };
    };
...
```

## Documentation/devicetree/bindings/iio/frequency/adi,admv1013.yaml
```yaml
# SPDX-License-Identifier: GPL-2.0
%YAML 1.2
---
$id: http://devicetree.org/schemas/iio/frequency/adi,admv1013.yaml#
$schema: http://devicetree.org/meta-schemas/core.yaml#

title: ADMV1013 Microwave Upconverter

maintainers:
- Antoniu Miclaus <antoniu.miclaus@analog.com>

description: |
   wideband, microwave upconverter optimized for point to point microwave
   radio designs operating in the 24 GHz to 44 GHz frequency range.
properties:
  compatible:
    enum:
      - adi,admv1013

  reg:
    maxItems: 1

  spi-max-frequency:
    maximum: 1000000

  clocks:
    description:
      Definition of the external clock (see clock/clock-bindings.txt)
    minItems: 1

  clock-names:
    description:
      Must be "lo_in"
    maxItems: 1

  clock-output-names:
    maxItems: 1

  clock-scales:
    description:
      The Common Clock Framework max rate is limited by MAX of unsigned long.
      For ADMV1013 device this is a deficiency. If specified, this
      property allows arbitrary scales. The first element in the array should
      be the multiplier and the second element should be the divider.
    $ref: /schemas/types.yaml#/definitions/uint32-array
    minimum: 1

  vcm-supply:
    description:
      analog voltage regulator (see regulator/regulator.txt)

  adi,parity-en:
    description:
      Enable Parity for Write execution.
    type: boolean

  adi,vga-pd:
    description:
      Power Down the VGA Circuit.
    type: boolean

  adi,mixer-pd:
    description:
      Power Down the Mixer Circuit.
    type: boolean

  adi,quad-pd:
    description:
      Power Down the Quad.
    type: boolean

  adi,bg-pd:
    description:
      Power Down the Transmitter Band Gap.
    type: boolean

  adi,mixer-if-en:
    description:
      Enable the IF Mode.
    type: boolean

  adi,det-en:
    description:
      Enable the Envelope Detector.
    type: boolean

  adi,quad-se-mode:
    description:
      Switch Differential/SE Modes.
    $ref: /schemas/types.yaml#/definitions/uint32
    enum: [6, 9, 12]

  '#address-cells':
    const: 1

  '#size-cells':
    const: 0

  '#clock-cells':
    const: 0

required:
- compatible
- reg
- clocks
- clock-names
- vcm-supply

additionalProperties: false

examples:
- |
    spi {
      #address-cells = <1>;
      #size-cells = <0>;
      admv1013@0{
        compatible = "adi,admv1013";
        reg = <0>;
        spi-max-frequency = <1000000>;
        clocks = <&admv1013_lo>;
        clock-scales = <1 5>;
        clock-names = "lo_in";
        vcm-supply = <&vcm>;
        adi,quad-se-mode = <12>;
        adi,parity-en;
        adi,mixer-if-en;
        adi,det-en;
      };
    };
...
```
