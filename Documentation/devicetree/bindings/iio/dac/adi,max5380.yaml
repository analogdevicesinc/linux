## Documentation/devicetree/bindings/iio/frequency/adi,admv1014.yaml
```yaml
# SPDX-License-Identifier: GPL-2.0
%YAML 1.2
---
$id: http://devicetree.org/schemas/iio/frequency/adi,admv1014.yaml#
$schema: http://devicetree.org/meta-schemas/core.yaml#

title: ADMV1014 Microwave Downconverter

maintainers:
- Antoniu Miclaus <antoniu.miclaus@analog.com>

description: |
   wideband, microwave downconverter optimized for point to point microwave
   radio designs operating in the 24 GHz to 44 GHz frequency range.

properties:
  compatible:
    enum:
      - adi,admv1014

  reg:
    maxItems: 1

  spi-max-frequency:
    maximum: 1000000

  clocks:
    description:
      Definition of the external clock (see clock/clock-bindings.txt)
    minItems: 1

  clock-names:
    description:
      Must be "lo_in"
    maxItems: 1

  clock-output-names:
    maxItems: 1

  clock-scales:
    description:
      The Common Clock Framework max rate is limited by MAX of unsigned long.
      For ADMV1014 device this is a deficiency. If specified, this
      property allows arbitrary scales. The first element in the array should
      be the multiplier and the second element should be the divider.
    $ref: /schemas/types.yaml#/definitions/uint32-array
    minimum: 1

  vcm-supply:
    description:
      analog voltage regulator (see regulator/regulator.txt)

  adi,parity-en:
    description:
      Enable Parity for Write execution.
    type: boolean

  adi,ibias-pd:
    description:
      Power Down the Rx IBIAS.
    type: boolean

  adi,if-amp-pd:
    description:
      Power Down the IF Amp.
    type: boolean

  adi,quad-bg-pd:
    description:
      Power Down the Quadrupler Band Gap.
    type: boolean

  adi,bb-amp-pd:
    description:
      Power Down the Baseband Amp.
    type: boolean

  adi,quad-ibias-pd:
    description:
      Power Down the Quadrupler Bias Current.
    type: boolean

  adi,det-en:
    description:
      Digital Rx Detector Enable.
    type: boolean

  adi,bg-pd:
    description:
      Power Down the Rx BG.
    type: boolean

  adi,p1db-comp:
    description:
      Turn on bits to optimize P1dB.
    $ref: /schemas/types.yaml#/definitions/uint32
    enum: [0, 3]

  adi,quad-se-mode:
    description:
      Switch Differential/SE Modes.
    $ref: /schemas/types.yaml#/definitions/uint32
    enum: [6, 9, 12]

  adi,det-prog:
    description:
      Digital Rx Detector Program.
    $ref: /schemas/types.yaml#/definitions/uint32
    enum: [0, 1, 2, 4, 8, 16, 32, 64]

  adi,bb-amp-gain-ctrl:
    description:
      Baseband Amp Gain control.
    $ref: /schemas/types.yaml#/definitions/uint32
    enum: [0, 1, 2, 3]

  '#address-cells':
    const: 1

  '#size-cells':
    const: 0

  '#clock-cells':
    const: 0

required:
- compatible
- reg
- clocks
- clock-names
- vcm-supply

additionalProperties: false

examples:
- |
    spi {
      #address-cells = <1>;
      #size-cells = <0>;
      admv1014@0{
        compatible = "adi,admv1014";
        reg = <0>;
        spi-max-frequency = <1000000>;
        clocks = <&admv1014_lo>;
        clock-names = "lo_in";
        clock-scales = <1 5>;
        vcm-supply = <&vcm>;
        adi,quad-se-mode = <12>;
        adi,parity-en;
        adi,det-en;
        adi,p1db-comp = <3>;
        adi,det-prog = <0>;
        adi,bb-amp-gain-ctrl = <0>;
      };
    };
...
```

## Documentation/devicetree/bindings/iio/frequency/adi,adrf6780.yaml
```yaml
# SPDX-License-Identifier: GPL-2.0
%YAML 1.2
---
$id: http://devicetree.org/schemas/iio/frequency/adi,adrf6780.yaml#
$schema: http://devicetree.org/meta-schemas/core.yaml#

title: ADRF6780 Microwave Upconverter

maintainers:
- Antoniu Miclaus <antoniu.miclaus@analog.com>

description: |
   wideband, microwave upconverter optimized for point to point microwave
   radio designs operating in the 5.9 GHz to 23.6 GHz frequency range.
properties:
  compatible:
    enum:
      - adi,adrf6780

  reg:
    maxItems: 1

  spi-max-frequency:
    maximum: 1000000

  clocks:
    description:
      Definition of the external clock (see clock/clock-bindings.txt)
    minItems: 1

  clock-names:
    description:
      Must be "lo_in"
    maxItems: 1

  clock-output-names:
    maxItems: 1

  adi,parity-en:
    description:
      Enable Parity for Write execution.
    type: boolean

  adi,vga-buff-en:
    description:
      VGA Buffer Enable.
    type: boolean

  adi,det-en:
    description:
      Detector Enable.
    type: boolean

  adi,lo-buff-en:
    description:
      LO Buffer Enable.
    type: boolean

  adi,if-mode-en:
    description:
      IF Mode Enable.
    type: boolean

  adi,iq-mode-en:
    description:
      IQ Mode Enable.
    type: boolean

  adi,lo-x2-en:
    description:
      LO x2 Enable.
    type: boolean

  adi,lo-ppf-en:
    description:
      LO x1 Enable.
    type: boolean

  adi,lo-en:
    description:
      LO Enable.
    type: boolean

  adi,uc-bias-en:
    description:
      UC Bias Enable.
    type: boolean

  adi,lo-sideband:
    description:
      Switch to the Other LO Sideband.
    type: boolean

  adi,vdet-out-en:
    description:
      VDET Output Select Enable.
    type: boolean

  '#address-cells':
    const: 1

  '#size-cells':
    const: 0

  '#clock-cells':
    const: 0

required:
- compatible
- reg
- clocks
- clock-names

additionalProperties: false

examples:
- |
    spi {
      #address-cells = <1>;
      #size-cells = <0>;
      adrf6780@0{
        compatible = "adi,adrf6780";
        reg = <0>;
        spi-max-frequency = <1000000>;
        clocks = <&adrf6780_lo>;
        clock-names = "lo_in";
        adi,parity-en;
      };
    };
...
```

## Documentation/devicetree/bindings/iio/frequency/adi,ltc6952.yaml
```yaml
# SPDX-License-Identifier: (GPL-2.0-only OR BSD-2-Clause)
# Copyright 2019-2023 Analog Devices Inc.
%YAML 1.2
---
$id: http://devicetree.org/schemas/bindings/iio/frequency/adi,ltc6952.yaml#
$schema: http://devicetree.org/meta-schemas/core.yaml#

title: Analog Devices LTC6952/LTC6953 ultralow jitter, JESD204B/C clock generation IC.

maintainers:
  - Mircea Caprioru <mircea.caprioru@analog.com>

description: |
  Analog Devices LTC6952 ultralow jitter, JESD204B/C clock generation IC.
  https://www.analog.com/media/en/technical-documentation/data-sheets/ltc6952.pdf
  https://www.analog.com/media/en/technical-documentation/data-sheets/ltc6953.pdf

properties:
  compatible:
    enum:
      - adi,ltc6952
      - adi,ltc6953

  reg:
    maxItems: 1

  clocks:
    description:
      Definition of the external clock (see clock/clock-bindings.txt)
    maxItems: 1

  clock-names:
    description:
      Must be "clkin"
    maxItems: 1

  clock-output-names:
    description: |
      Clock output signal names indexed by the first cell in the clock
      specifier (see clock/clock-bindings.txt)


  adi,vco-frequency-hz:
    description: |
      VCO input frequency. This is fed to the internal distribution path and
      feedback dividers.

  adi,ref-frequency-hz:
    description: |
      Reference input frequency. This is fed in the reference divider.

  adi,pulse-generator-mode:
    description: |
      Select the pulse generator mode. Valid values are:
      0: One Pulse
      1: Two Pulses
      2: Four Pulses
      3: Eight Pulses
      If this field is left empty, One Pulse is selected.
    allOf:
      - $ref: /schemas/types.yaml#/definitions/uint32
      - enum: [0, 1, 2, 3]

  adi,follower-mode-enable:
    type: boolean
    description:
      If this property is present, LTC6952 will be in follower mode
      similar to LTC6953.

  adi,sync-via-ezs-srq-enable:
    type: boolean
    description:
      If this property is present, the device will use EZS_SRQ Synchronization
      or SYSREF Request Input.

  adi,input-buffer-filt-enable:
    type: boolean
    description:
      If this property is present, the reference input buffer’s low-pass filter
      will be enabled. Enabling this LPF is recommended for
      sine wave signals < 20 MHz.

  '#clock-cells':
    const: 1

required:
  - compatible
  - reg
  - clock-output-names
  - "#clock-cells"

patternProperties:
  "^channel@[0-9]$":
    type: object
    description: Represents the external channels which are connected to the device.

    properties:
      reg:
        description: |
          The channel number. It can have up to 11 channels numbered from 0 to 10.
        maxItems: 1

      adi,extended-name:
        description: Descriptive channel name.
        $ref: /schemas/types.yaml#/definitions/string

      adi,divider:
        description: |
          Channel divider. This divides the incoming VCO frequency.
        allOf:
          - $ref: /schemas/types.yaml#/definitions/uint32
          - minimum: 1
          - maximum: 4095
        maxItems: 1

      adi,digital-delay:
        description: |
          Each output divider can have the start time of the output delayed by
          integer multiples of half of the VCO period after a synchronization
          event.
        allOf:
          - $ref: /schemas/types.yaml#/definitions/uint32
          - minimum: 0
          - maximum: 4095
        maxItems: 1

      adi,analog-delay:
        description: |
          Each output has a fine analog delay feature to further adjust its
          output delay time (tADELx) in small steps.
        allOf:
          - $ref: /schemas/types.yaml#/definitions/uint32
          - minimum: 0
          - maximum: 63
        maxItems: 1

      adi,sysref-mode:
        description: |
          Select the sysref mode. Valid values are:
          0: Free Run
          1: Gated Pulses
          2: Request Passthrough
          3: Pulses (adi,pulse-generator-mode)
          If this field is left empty, free run is selected.
        allOf:
          - $ref: /schemas/types.yaml#/definitions/uint32
          - enum: [0, 1, 2, 3]

      adi,sync-disable:
        type: boolean
        description:
          If this property is present, SYNC and SYSREF on this channel will
          be disabled, this means SYNC and SYSREF requests will be ignored,
          and digital delays won't take affect.

    required:
      - reg

additionalProperties: false

examples:
  - |
    spi {
      #address-cells = <1>;
      #size-cells = <0>;

      frequency@0 {
        compatible = "adi,ltc6952";
        reg = <0>;

        #address-cells = <1>;
        #size-cells = <0>;

        spi-max-frequency = <10000000>;

        clock-output-names = "ltc6952_out0", "ltc6952_out1";
        #clock-cells = <1>;

        adi,vco-frequency-hz = <4000000000>;
        adi,ref-frequency-hz = <100000000>;

        ltc6952_c0: channel@0 {
          reg = <0>;
          adi,extended-name = "REF_CLK";
          adi,divider = <10>;
          adi,digital-delay = <100>;
          adi,analog-delay = <0>;
        };

        ltc6952_c1: channel@1 {
          reg = <1>;
          adi,extended-name = "TEST_CLK";
          adi,divider = <10>;
        };
      };
    };
```
