## Documentation/devicetree/bindings/iio/frequency/ad916x.yaml
```yaml
# SPDX-License-Identifier: GPL-2.0
%YAML 1.2
---
$id: http://devicetree.org/schemas/iio/frequency/ad916x.yaml#
$schema: http://devicetree.org/meta-schemas/core.yaml#

title: Analog Devices AD916x Wideband, Transmit (Tx)

maintainers:
  - Michael Hennerich <michael.hennerich@analog.com
  - Nuno Sá <nuno.sa@analog.com>

description: |
  Analog Devices AD916x high performance and direct digital synthesizer (DDS).
  https://www.analog.com/media/en/technical-documentation/data-sheets/AD9161-9162.pdf

properties:
  compatible:
    enum:
      - adi,ad9161
      - adi,ad9162
      - adi,ad9163
      - adi,ad9164
      - adi,ad9166

  reg:
    maxItems: 1

  clocks:
    description:
      Definition of the external clock (see clock/clock-bindings.txt)
    minItems: 1
    maxItems: 3

  clock-name:
    description:
      Must be at least "dac_clk".
    items:
      - const: dac_clk
      - const: jesd_dac_clk
      - const: dac_sysref
    minItems: 1
    maxItems: 3

  jesd204-device:
    description: Device is added to the jesd204-fsm framework
    type: boolean

  '#jesd204-cells':
    const: 2

  jesd204-top-device:
    const: 0

  jesd204-link-ids:
    const: 0

  jesd204-inputs:
    description: JESD204-fsm devices phandles and specifiers (used to build the link topology)
    $ref: "/schemas/types.yaml#/definitions/phandle"

  adi,dc-test-en:
    description:
      Enables the DC test enable mode which allows the device to act as local
      oscillator. Only supported on ad9162 and ad9166.
    type: boolean
    maxItems: 1

  adi,interpolation:
    description: Digital datapath interpolation config
      1 - Bypass (AD9162 only)
      2 - Interpolation by 2
      3 - Interpolation by 3
      4 - Interpolation by 4
      6 - Interpolation by 6
      8 - Interpolation by 8
      12 - Interpolation by 12
      16 - Interpolation by 16
      24 - Interpolation by 24
    $ref: /schemas/types.yaml#/definitions/uint32
    enum: [1, 2, 3, 4, 6, 8, 12, 16, 24]

  adi,octets-per-frame:
    description: Number of octets per frame (F)
    $ref: /schemas/types.yaml#/definitions/uint32
    enum: [1, 2, 4]

  adi,frames-per-multiframe:
    description: Number of frames per multi-frame (K)
    $ref: /schemas/types.yaml#/definitions/uint32
    const: 32

  adi,converter-resolution:
    description: Converter resolution (N)
    $ref: /schemas/types.yaml#/definitions/uint32
    const: 16

  adi,bits-per-sample:
    description: Number of bits per sample (N')
    $ref: /schemas/types.yaml#/definitions/uint32
    const: 16

  adi,converters-per-device:
    description: Number of converter per device (M)
    $ref: /schemas/types.yaml#/definitions/uint32
    enum: [1, 2]

  adi,control-bits-per-sample:
    description: Number of control bits per conversion sample (CS)
    $ref: /schemas/types.yaml#/definitions/uint32
    const: 0

  adi,lanes-per-device:
    description: Number of lanes per link (L)
    $ref: /schemas/types.yaml#/definitions/uint32
    enum: [1, 2, 3, 4, 6, 8]

  adi,samples-per-converter-per-frame:
    description: Number of lsamples per converter per frame (S)
    $ref: /schemas/types.yaml#/definitions/uint32
    enum: [1, 2, 3, 4]

  adi,subclass:
    description: The JESD204B sublcass
    $ref: /schemas/types.yaml#/definitions/uint32
    enum: [0, 1]

  adi,version:
    description: The JESD204 version
    $ref: /schemas/types.yaml#/definitions/uint32
    enum: [0, 1]

  adi,standalone-probe:
    description:
      Enables the driver standalone mode. In this mode, all the device handling
      is done on the device driver. In the normal mode the device driver handles
      the device together with the cf_axi_dds platform driver.
    type: boolean
    maxItems: 1

  adi,full-scale-current-microamp:
    description:
      Specifies the device output full scale current.
    allOf:
      - $ref: /schemas/types.yaml#/definitions/uint32-array
      - minimum: 8000
      - maximum: 40000
    maxItems: 1

  adi,temperature-single-point-calibration:
    description:
      Single point calibration tuple for the temperature sensor. It should be
      a pair of temperature (in degrees celsius) and a raw value correspondent
      to the sensor reading for the given temperature.
    allOf:
      - $ref: /schemas/types.yaml#/definitions/int32-array
      - minItems: 2
        maxItems: 2

patternProperties:
  "^($clock-names-)?clock-scales":
    description:
      The Common Clock Framework max rate is limited by MAX of unsigned long.
      For AD916x devices this is a deficiency. If specified, this
      property allows arbitrary scales. The first element in the array should
      be the multiplier and the second element should be the divider. If there
      are more than one clock, with different scales, the correspondent
      $clock-names can be prepended to clock-scales.
    allOf:
      - $ref: /schemas/types.yaml#/definitions/uint32-array
      - minimum: 1
    maxItems: 3

required:
  - compatible
  - reg
  - clocks
  - clock-names

examples:
  - |
    spi0 {
        #address-cells = <1>;
        #size-cells = <0>;

        ad9162@0 {
                compatible = "adi,ad9162";
                reg = <0>;
                spi-max-frequency = <1000000>;
                clocks = <&adf4372_clk 0>;
                clock-names = "dac_clk";

                adi,full-scale-current-mircoamp = <40000>;
                dac_clk-clock-scales = <1 10>;

                jesd204-device;
                #jesd204-cells = <2>;
                jesd204-top-device = <0>; /* This is the TOP device */
                jesd204-link-ids = <0>;
                jesd204-inputs = <&axi_ad9162_core 0 0>;

                adi,subclass = <0>;			/* JESD SUBCLASS 0,1,2 */
                adi,version = <1>;			/* JESD VERSION 0=204A,1=204B,2=204C */
                adi,converters-per-device = <2>;	/* JESD M */
                adi,octets-per-frame = <1>;		/* JESD F */
                adi,frames-per-multiframe = <32>;	/* JESD K */
                adi,converter-resolution = <16>;	/* JESD N */
                adi,bits-per-sample = <16>;		/* JESD NP' */
                adi,control-bits-per-sample = <0>;	/* JESD CS */
                adi,lanes-per-device = <8>;		/* JESD L */
                adi,samples-per-converter-per-frame = <2>; /* JESD S */

                adi,interpolation = <2>;
        };
    };
...
```

## Documentation/devicetree/bindings/iio/frequency/adf4371.yaml
```yaml
# SPDX-License-Identifier: GPL-2.0
%YAML 1.2
---
$id: http://devicetree.org/schemas/iio/frequency/adf4371.yaml#
$schema: http://devicetree.org/meta-schemas/core.yaml#

title: Analog Devices ADF4371/ADF4372 Wideband Synthesizers

maintainers:
  - Popa Stefan <stefan.popa@analog.com>

description: |
  Analog Devices ADF4371/ADF4372 SPI Wideband Synthesizers
  https://www.analog.com/media/en/technical-documentation/data-sheets/adf4371.pdf
  https://www.analog.com/media/en/technical-documentation/data-sheets/adf4372.pdf

properties:
  compatible:
    enum:
      - adi,adf4371
      - adi,adf4372

  reg:
    maxItems: 1

  clocks:
    description:
      Definition of the external clock (see clock/clock-bindings.txt)
    maxItems: 1

  clock-names:
    description:
      Must be "clkin"
    maxItems: 1

  adi,mute-till-lock-en:
    description:
      If this property is present, then the supply current to RF8P and RF8N
      output stage will shut down until the ADF4371/ADF4372 achieves lock as
      measured by the digital lock detect circuitry.

  '#address-cells':
    const: 1

  '#size-cells':
    const: 0

required:
  - compatible
  - reg
  - clocks
  - clock-names

  patternProperties:
  "^channel@[01]$":
    type: object
    description: Represents the external channels which are connected to the device.

    properties:
      reg:
        description: |
          The channel number. It can have up to 3 channels on adf4372
          and 4 channels on adf4371, numbered from 0 to 3.
        maxItems: 1

      adi,output-enable:
        description: |
          If this property is specified, the output channel will be enabled.
          If left empty, the driver will initialize the defaults (RF8x, channel 0
          will be the only one enabled).
        maxItems: 1

      adi,power-up-frequency:
        description: |
          Set the frequency after power up for the channel. If this property is
          specified, it has to be in sync with the power up frequency set on the
          other channels. This limitation is due to the fact that all the channel
          frequencies are derived from the VCO fundamental frequency.
        maxItems: 1

    required:
      - reg

examples:
  - |
    spi0 {
        #address-cells = <1>;
        #size-cells = <0>;

        frequency@0 {
                compatible = "adi,adf4371";
                reg = <0>;

                #address-cells = <1>;
                #size-cells = <0>;

                spi-max-frequency = <1000000>;
                clocks = <&adf4371_clkin>;
                clock-names = "clkin";

                channel@0 {
                        reg = <0>;
                        adi,output-enable;
                        adi,power-up-frequency = /bits/ 64 <8000000000>;
                };

                channel@1 {
                        reg = <1>;
                        adi,output-enable;
                };

                channel@2 {
                        reg = <2>;
                        adi,output-enable;
                        adi,power-up-frequency = /bits/ 64 <16000000000>;
                };

                channel@3 {
                        reg = <3>;
                        adi,output-enable;
                        adi,power-up-frequency = /bits/ 64 <32000000000>;
                };
        };
    };
...
```

## Documentation/devicetree/bindings/iio/frequency/adf5355.txt
```
Analog Devices ADF5355/ADF4355 device driver

Required properties:
	- compatible: Should be one of
		* "adi,adf5355": When using the ADF5355 device
		* "adi,adf5356": When using the ADF5356 device
		* "adi,adf4355": When using the ADF4355 device
		* "adi,adf4355-2": When using the ADF4355-2 device
		* "adi,adf4355-3": When using the ADF4355-3 device
	- reg: SPI chip select numbert for the device
	- spi-max-frequency: Max SPI frequency to use (< 20000000)
	- clocks: From common clock binding. Clock is phandle to clock for
		ADF5355 Reference Clock (CLKIN).

Optional properties:
	- gpios:	GPIO Lock detect - If set with a valid phandle and GPIO
			number, pll lock state is tested upon read.
	- clock-output-names : From common clock binding to override the
			default output clock name.
	- adi,power-up-frequency: If set in Hz the PLL tunes to
			the desired frequency on probe.
	- adi,reference-div-factor: If set the driver skips dynamic calculation
			and uses this default value instead.
	- adi,reference-doubler-enable: Enables reference doubler.
	- adi,reference-div2-enable: Enables reference divider.
	- adi,reference-differential-input-enable: The device permits use of
			either differential or single ended reference sources.
			For differential sources set this property.
	- adi,phase-detector-polarity-negative-enable: When a passive loop
			filter or a noninverting active loop filter is used,
			clear for positive. If an active filter with an
			inverting characteristic is used, set this to negative.
	- adi,charge-pump-current: Set the charge pump current in uA.
			Set this value to the charge pump current that the loop
			filter is designed with. For the lowest spurs, the
			900 uA setting is recommended.
	- adi,charge-pump-negative-bleed-enable: Use of constant negative bleed.
			(recommended for most fractional-N applications)
	- adi,charge-pump-gated-bleed-enable: Enables gated bleed.
	- adi,charge-pump-bleed-current-polarity-enable: Sets the polarity of
			the charge pump bleed current.
	- adi,muxout-select: On chip multiplexer output selection.
			Valid values for the multiplexer output are:
			0: Three-State Output (default)
			1: DVDD
			2: DGND
			3: R-Counter output
			4: N-Divider output
			5: Analog lock detect
			6: Digital lock detect
	- adi,muxout-level-3v3-enable: MUXOUT is programmable to two logic
			levels. Clear this to select 1.8 V logic,
			and set it to select 3.3 V logic.
	- adi,mute-till-lock-enable: If enabled, the supply current to the RF
			output stage is shut down until the device achieves lock,
			as determined by the digital lock detect circuitry.
	- adi,output-b-enable: Enables or disables the primary RF output
	- adi,output-a-enable: Enables or disables the auxiliary/high RF output
	- adi,output-a-power: Primary RF output power selection.
			Valid values for the power mode are:
			0: -4dBm (default)
			1: -1dBm
			2: +2dBm
			3: +5dBm
	- adi,output-b-power: Auxiliary output power selection.
			Valid values for the power mode are:
			0: -4dBm (default)
			1: -1dBm
			2: +2dBm
			3: +5dBm


Example:
			adf5355@0 {
				compatible = "adf5355";
				reg = <0>;
				spi-max-frequency = <1000000>;
				clocks = <&adf4351_clkin>;
				clock-names = "clkin";
				clock-output-names = "adf5355_out";
				adi,charge-pump-current = <900>;
				adi,muxout-select = <6>;
				adi,mute-till-lock-enable;
				adi,output-a-power = <2>;
				adi,output-b-power = <2>;
				adi,output-b-enable;
				adi,output-a-enable;
				adi,charge-pump-negative-bleed-enable;
				adi,reference-differential-input-enable;
				adi,muxout-level-3v3-enable;
				adi,power-up-frequency = <123000000>;
			};
```

## Documentation/devicetree/bindings/iio/frequency/adi,ad9172.txt
```
Analog Devices AD9172 device driver

Required properties:
	- compatible: Should be one of "adi,ad9171", "adi,ad9172", "adi,ad9173",
		"adi,ad9174", "adi,ad9175", "adi,ad9176".
	- reg: SPI chip select number.
	- spi-max-frequency: Max SPI frequency to use (<= 10000000).
	- clocks: a list of phandle, one for each entry in clock-names.
	- clock-names: Must include the following entries:
		"jesd_dac_clk", "dac_clk", "dac_sysref"
	- adi,dac-rate-khz: The desired DAC rate in kHz
	- adi,jesd-link-mode: The desired JESD204 Link Mode,
		please refer to the AD917x datasheet.
	- adi,dac-interpolation: The DAC or main datapath interpolation,
		please refer to the supported values for a given Link Mode
		in the AD917x datasheet.
	- adi,channel-interpolation: The channel interpolation,
		please refer to the supported values for a given Link Mode
		in the AD917x datasheet.


Optional properties:
	- adi,jesd-subclass: The JESD204 subclass (0, 1).
	- adi,clock-output-divider: Divide down DAC clock, supported
		values (ratios) are 0 (disabled), 1, 2, 3.
		The clock output frequency ranges from 727.8Mhz to 2GHz.
	- adi,syncoutb-signal-type-lvds-enable: Enables LVDS mode for the
		SYNCOUTB signal, default is CMOS.
	- adi,sysref-coupling-dc-enable: Enables SYSREF signal DC coupling,
		default is AC coupling.
	- reset-gpio: a GPIO spec for the reset pin.
	- txen0-gpio: a GPIO spec for the TXEN0 pin.
	- txen1-gpio: a GPIO spec for the TXEN1 pin.


Example:

	dac0_ad9172: ad9172@1 {
		#address-cells = <1>;
		#size-cells = <0>;
		compatible = "adi,ad9172";
		reg = <1>;
		spi-max-frequency = <1000000>;
		clocks = <&axi_ad9172_jesd>, <&hmc7044 2>, <&hmc7044 3>;
		clock-names = "jesd_dac_clk", "dac_clk", "dac_sysref";

		adi,dac-rate-khz = <3000000>;
		adi,jesd-link-mode = <10>;

		adi,jesd-subclass = <0>;
		adi,dac-interpolation = <1>;
		adi,channel-interpolation = <1>;
		adi,clock-output-divider = <1>;
		adi,syncoutb-signal-type-lvds-enable;
	};
```
