## Documentation/devicetree/bindings/iio/dac/adi,max5380.yaml
```yaml
# SPDX-License-Identifier: (GPL-2.0 OR BSD-2-Clause)
# Copyright 2023 Analog Devices Inc.
%YAML 1.2
---
$id: http://devicetree.org/schemas/iio/dac/adi,max5380.yaml#
$schema: http://devicetree.org/meta-schemas/core.yaml#

title: Analog Devices MAX5380 8-bit DAC Device Driver

description: |
   The MAX5380 are low-cost, 8-bit digital-to-analog converters (DACs)
   in miniature 5-pin SOT23 packages, with a simple 2-wire serial
   interface that allows communication with multiple devices.

   More details here:
   https://www.analog.com/media/en/technical-documentation/data-sheets/MAX5380-MAX5382.pdf

maintainers:
  - Marc Paolo Sosa <marcpaolo.sosa@analog.com>

properties:
  compatible:
    enum:
      - maxim,max5380

  reg:
    maxItems: 1

  '#address-cells':
    const: 1

  '#size-cells':
    const: 0

required:
  - compatible
  - reg

unevaluatedProperties: false

examples:
  - |

    &i2c1 {
         #address-cells = <1>;
         #size-cells = <0>;

        max5380: dac@0 {
                compatible = "maxim,max5380";
                reg=<0x31>;
          };
    };
...
```

## Documentation/devicetree/bindings/iio/dac/adi,max538x.yaml
```yaml
# SPDX-License-Identifier: (GPL-2.0 OR BSD-2-Clause)
# Copyright 2020 Analog Devices Inc.
%YAML 1.2
---

title: Analog Devices MAX5380/1/2 DAC device driver

description: |

  The MAX5380/1/2 are low-cost, 8-bit digital-to-analog converters (DACs) 
  in miniature 5-pin SOT23 packages, with a simple 2-wire serial interface that allows 
  communication with multiple devices.

maintainers:
  - Marc Paolo Sosa <marcpaolo.sosa@analog.com>

description: |
  Bindings for the Analog Devices MAX5380 current DAC device. Datasheet can be found here:
  https://www.analog.com/media/en/technical-documentation/data-sheets/MAX5380-MAX5382.pdf

properties:
  compatible:
    Must be "maxim,max538X"

  reg:
    Should contain the DAC I2C address

  '#address-cells':
    const: 1

  '#size-cells':
    const: 0

required:
  - compatible
  - reg


additionalProperties: false

examples:
  - |
  
&i2c1 {
        status = "okay";

        #address-cells = <1>;
        #size-cells = <0>;

        max5380l: adc@0{
            compatible = "max,max5380l";
            reg = <0x30>;

        };
        max5380m: adc@1{
            compatible = "max,max5380m";
            reg = <0x31>;

        };
        max5380n: adc@2{
            compatible = "max,max5380n";
            reg = <0x32>;

        };
        max5380k: adc@3{
            compatible = "max,max5380k";
            reg = <0x33>;

        };
        max5381l: adc@4{
            compatible = "max,max5381l";
            reg = <0x30>;
  
        };
        max5381m: adc@5{
            compatible = "max,max5381m";
            reg = <0x31>;

        };
        max5381n: adc@6{
            compatible = "max,max5381n";
            reg = <0x32>;

        };
        max5381k: adc@7{
            compatible = "max,max5381k";
            reg = <0x33>;
 
        };
        max5382l: adc@8{
            compatible = "max,max5382l";
            reg = <0x30>;

        };
        max5382m: adc@9{
            compatible = "max,max5382m";
            reg = <0x31>;

        };
        max5382n: adc@10{
            compatible = "max,max5382n";
            reg = <0x32>;

        };
        max5382k: adc@11{
            compatible = "max,max5382k";
            reg = <0x33>;

        };

};
```

## Documentation/devicetree/bindings/iio/dac/adi,pwm-dac.yaml
```yaml
# SPDX-License-Identifier: (GPL-2.0 OR BSD-2-Clause)
%YAML 1.2
---
$id: http://devicetree.org/schemas/iio/dac/adi,pwm-dac.yaml#
$schema: http://devicetree.org/meta-schemas/core.yaml#

title: Analog Devices PWM DAC

maintainers:
  - Jie Zhang <jie.zhang@analog.com>

properties:
  compatible:
    const: adi,pwm-dac

  reg:
    maxItems: 1

  clocks:
    items:
      - description: Clock phandle for input clock

  adi,iovdd-microvolt:
    description: |
      The IOVDD voltagge [mV]
    minimum: 0
    maximum: 5000000

  adi,gpio-max-frequency:
    description: |
      The maximum frequency of GPIO [Hz]
    minimum: 0
    maximum: 0xffffffff

additionalProperties: false

required:
  - compatible
  - reg
  - clocks
  - adi,iovdd-microvolt
  - adi,gpio-max-frequency

examples:
  - |
    dac@PWM_BASE_UADDR {
        compatible = "adi,pwm-dac";
        reg = <PWM_BASE 0x100>;
        clocks = <&hsdigclk>;
        adi,iovdd-microvolt = <3300000>;
        adi,gpio-max-frequency = <122880000>;
    };
...
```

## Documentation/devicetree/bindings/iio/dac/max5380.yaml
```yaml
# SPDX-License-Identifier: (GPL-2.0 OR BSD-2-Clause)
# Copyright 2023 Analog Devices Inc.
%YAML 1.2
---

title: Analog Devices MAX5380 DAC device driver

description: |

  The MAX5380 are low-cost, 8-bit digital-to-analog converters (DACs) 
  in miniature 5-pin SOT23 packages, with a simple 2-wire serial interface that allows 
  communication with multiple devices.

maintainers:
  - Marc Paolo Sosa <marcpaolo.sosa@analog.com>

description: |
  Bindings for the Analog Devices MAX5380 current DAC device. Datasheet can be found here:
  https://www.analog.com/media/en/technical-documentation/data-sheets/MAX5380-MAX5382.pdf

properties:
  compatible:
    Must be "maxim,max5380"

  reg:
    Should contain the DAC I2C address

  '#address-cells':
    const: 1

  '#size-cells':
    const: 0

required:
  - compatible
  - reg


additionalProperties: false

examples:
  - |
    i2c {
        #address-cells = <1>;
        #size-cells = <0>;

        max5380: max5380@31 {
                compatible = "maxim,max5380";
                reg = <0x31>;
                status = "okay";
        };
    };
...
```

## Documentation/devicetree/bindings/iio/dac/maxim,ds4424.yaml
```yaml
# SPDX-License-Identifier: (GPL-2.0 OR BSD-2-Clause)
%YAML 1.2
---
$id: http://devicetree.org/schemas/iio/dac/maxim,ds4424.yaml#
$schema: http://devicetree.org/meta-schemas/core.yaml#

title: Maxim Integrated DS4402/DS4404 and DS4422/DS4424 Current DACs

maintainers:
  - Ismail Kose <ihkose@gmail.com>

description: |
  Datasheets publicly available at:
  https://datasheets.maximintegrated.com/en/ds/DS4402-DS4404.pdf
  https://datasheets.maximintegrated.com/en/ds/DS4422-DS4424.pdf

properties:
  compatible:
    enum:
      - maxim,ds4402
      - maxim,ds4404
      - maxim,ds4422
      - maxim,ds4424

  reg:
    maxItems: 1

  vcc-supply: true

required:
  - compatible
  - reg

additionalProperties: false

examples:
  - |
    i2c {
        #address-cells = <1>;
        #size-cells = <0>;

        dac@10 {
            compatible = "maxim,ds4424";
            reg = <0x10>; /* When A0, A1 pins are ground */
            vcc-supply = <&vcc_3v3>;
        };
    };
...
```

## Documentation/devicetree/bindings/iio/dac/maxim,max538x.yaml
```yaml
# SPDX-License-Identifier: (GPL-2.0 OR BSD-2-Clause)
# Copyright 2023 Analog Devices Inc.
%YAML 1.2
---
$id: http://devicetree.org/schemas/iio/dac/maxim,max538x.yaml#
$schema: http://devicetree.org/meta-schemas/core.yaml#

title: Analog Devices MAX5380/1/2 8-bit DAC Device Driver

description: |
   The MAX5380/1/2 are low-cost, 8-bit digital-to-analog converters (DACs)
   in miniature 5-pin SOT23 packages, with a simple 2-wire serial
   interface that allows communication with multiple devices.
   More details here:
   https://www.analog.com/media/en/technical-documentation/data-sheets/MAX5380-MAX5382.pdf

maintainers:
  - Marc Paolo Sosa <marcpaolo.sosa@analog.com>

properties:

  compatible:
    enum:
      - maxim,max5380
      - maxim,max5381
      - maxim,max5382

  reg:
    maxItems: 1

  vref-supply:
    description: If not supplied, internal reference will be used.

unevaluatedProperties: false

required:
  - compatible
  - reg

allOf:
  - if:
      properties:
        compatible:
          contains:
            enum:
              - maxim,max5382
    then:
      required:
        - vref-supply

examples:
  - |
    i2c {
         #address-cells = <1>;
         #size-cells = <0>;

         dac@31 {
            compatible = "maxim,max5380";
            reg = <0x31>;
            vref-supply = <&dac_vref>;
        };
    };
...
```

## Documentation/devicetree/bindings/iio/filter/adi,admv8818.yaml
```yaml
# SPDX-License-Identifier: (GPL-1.0-only OR BSD-2-Clause)
%YAML 1.2
---
$id: http://devicetree.org/schemas/iio/filter/adi,admv8818.yaml#
$schema: http://devicetree.org/meta-schemas/core.yaml#

title: ADMV8818 Digitally Tunable, High-Pass and Low-Pass Filter

maintainers:
  - Antoniu Miclaus <antoniu.miclaus@analog.com>

description: |
    Fully monolithic microwave integrated circuit (MMIC) that
    features a digitally selectable frequency of operation.
    The device features four independently controlled high-pass
    filters (HPFs) and four independently controlled low-pass filters
    (LPFs) that span the 2 GHz to 18 GHz frequency range.

    https://www.analog.com/en/products/admv8818.html

properties:
  compatible:
    enum:
      - adi,admv8818

  reg:
    maxItems: 1

  spi-max-frequency:
    maximum: 10000000

  clocks:
    description:
      Definition of the external clock.
    minItems: 1

  clock-names:
    items:
      - const: "rf_in"

  clock-output-names:
    maxItems: 1

  clock-scales:
    description:
      The Common Clock Framework max rate is limited by MAX of unsigned long.
      For ADMV8818 device this is a deficiency. If specified, this
      property allows arbitrary scales. The first element in the array should
      be the multiplier and the second element should be the divider.
    $ref: /schemas/types.yaml#/definitions/uint32-array
    minimum: 1

  '#clock-cells':
    const: 0

  adi,bw-hz:
    description:
      Allows the user to increase the Bandpass Filter (BPF) bandwidth
      in Hz. Normally when invoked by the clk notifier, the driver
      sets the HPF cutoff close below the frequency and the LPF cutoff
      close above the frequency, and thus creating a BPF.
    $ref: /schemas/types.yaml#/definitions/uint64

required:
  - compatible
  - reg
  - clocks
  - clock-names

additionalProperties: false

examples:
  - |
    spi {
      #address-cells = <1>;
      #size-cells = <0>;
      admv8818@0 {
        compatible = "adi,admv8818";
        reg = <0>;
        spi-max-frequency = <10000000>;
        clocks = <&admv8818_rfin>;
        clock-scales = <1 5>;
        clock-names = "rf_in";
        adi,tolerance-percent = <3>;
      };
    };
...
```
