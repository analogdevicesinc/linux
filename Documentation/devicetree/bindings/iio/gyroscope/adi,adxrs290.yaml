## Documentation/devicetree/bindings/iio/temperature/nxp,p3t1085.yaml
```yaml
# SPDX-License-Identifier: (GPL-2.0 OR BSD-2-Clause)
%YAML 1.2
---
$id: http://devicetree.org/schemas/iio/temperature/nxp,p3t1085.yaml#
$schema: http://devicetree.org/meta-schemas/core.yaml#

title: NXP P3T1085UK I3C/I2C temperature sensor

maintainers:
  - Clark Wang <xiaoning.wang@nxp.com>

description: |
  https://www.nxp.com/docs/en/data-sheet/P3T1085UK.pdf

  P3T1085UK is a temperature-to-digital converter with a -40 °C
  to +125 °C range. The device can be communicated by a controller
  via the 2-wire serial I3C (up to 12.5 MHz) and I2C (up to 3.4 MHz)
  interface.

  The I2C interface supports up to four target addresses and an
  alert function which becomes active when the temperature exceeds
  the programmed limits.

  The I3C interface supports IBI (In Band Interrupt) where P3T1085UK
  emits its address into the arbitrated address header on the I3C bus
  to notify the controller of an interrupt. It does not require an
  additional interrupt pin.

  P3T1085UK can be configured for different operation conditions.
  It can be set in normal mode to periodically monitor the ambient
  temperature, or in shut-down mode to minimize power consumption.
  The temperature register always stores a 12 bit two's complement
  data, giving a temperature resolution of 0.0625 °C

properties:
  compatible:
    const: nxp,p3t1085

  reg:
    maxItems: 1
    description: supports up to four target addresses.

required:
  - compatible
  - reg

additionalProperties: false

examples:
  - |
    i2c {
        #address-cells = <1>;
        #size-cells = <0>;

        temp-sensor@48 {
            compatible = "nxp,p3t1085";
            reg = <0x48>;
        };
    };
```

## Documentation/devicetree/bindings/iio/trigger/adi,axi-spi-engine-offload-pwm-trigger-dma-output.yaml
```yaml
# SPDX-License-Identifier: (GPL-2.0 OR BSD-2-Clause)
%YAML 1.2
---
$id: http://devicetree.org/schemas/iio/trigger/adi,axi-spi-engine-offload-pwm-trigger-dma-output.yaml#
$schema: http://devicetree.org/meta-schemas/core.yaml#

title: ADI AXI SPI Engine Offload PWM Trigger, DMA Data Output

maintainers:
  - Michael Hennerich <Michael.Hennerich@analog.com>
  - Nuno Sá <nuno.sa@analog.com>

description: |
  This binding describes the connection of a PWM device to the trigger input
  and a DMA channel to the output data stream of an ADI AXI SPI Engine Offload
  instance.

  https://wiki.analog.com/resources/fpga/peripherals/spi_engine/offload
  https://wiki.analog.com/resources/fpga/peripherals/spi_engine/tutorial

$ref: /schemas/spi/adi,axi-spi-engine.yaml#/$defs/offload

properties:
  compatible:
    const: adi,axi-spi-engine-offload-pwm-trigger-dma-output

  reg:
    maxItems: 1

  pwms:
    maxItems: 1

  dmas:
    maxItems: 1

required:
  - compatible
  - pwms
  - dmas

unevaluatedProperties: false

examples:
  - |
    spi {
      #address-cells = <1>;
      #size-cells = <0>;

      offloads {
        #address-cells = <1>;
        #size-cells = <0>;

        offload@0 {
          compatible = "adi,axi-spi-engine-offload-pwm-trigger-dma-output";
          reg = <0>;
          pwms = <&pwm 0>;
          dmas = <&dma 0>;
        };
      };
    };
```

## Documentation/devicetree/bindings/input/adi,max16150.yaml
```yaml
# SPDX-License-Identifier: (GPL-2.0 OR BSD-2-Clause)
%YAML 1.2
---
$id: http://devicetree.org/schemas/input/adi,max16150.yaml#
$schema: http://devicetree.org/meta-schemas/core.yaml#

title: Analog Devices MAX16150/MAX16169 nanoPower Pushbutton On/Off Controller

maintainers:
  - Marc Paolo Sosa <marcpaolo.sosa@analog.com>

description:
  The MAX16150/MAX16169 is a low-power pushbutton on/off controller with a
  switch debouncer and built-in latch. It accepts a noisy input from a
  mechanical switch and produces a clean latched output, as well as a one-shot
  interrupt output.

properties:
  compatible:
    description:
      Specifies the supported device variants. The MAX16150 and MAX16169 are supported.
    enum:
      - adi,max16150a
      - adi,max16150b
      - adi,max16169a
      - adi,max16169b

  interrupt-gpio:
    maxItems: 1

  clr-gpios:
    description:
      Clear Input. Pulling CLR low deasserts the latched OUT signal. If OUT is
      already deasserted when CLR is pulled low, the state of OUT is unchanged.
    maxItems: 1

  linux,code:
    default: KEY_POWER

required:
  - compatible
  - interrupt-gpios
  - clr-gpios

additionalProperties: false

examples:
  - |
    #include <dt-bindings/input/linux-event-codes.h>
    #include <dt-bindings/gpio/gpio.h>

    power-button {
        compatible = "adi,max16150a";
        interrupt-gpios = <&gpio 17 GPIO_ACTIVE_HIGH>;
        clr-gpios = <&gpio 4 GPIO_ACTIVE_LOW>;
        linux,code = <KEY_POWER>;
    };
```

## Documentation/devicetree/bindings/input/imx-rpmsg-input.txt
```
Device-Tree bindings for inputc/rpmsg_input.c input driver over
rpmsg. For NXP i.MX7ULP EVK platform, all sensors connect with
M4, A core access sensor should communicate with M4 core by rpmsg
bus.

Required properties:
	- compatible = "fsl,rpmsg-input";

Examples:
	rpmsg_sensor: rpmsg-sensor {
		compatible = "fsl,rpmsg-input";
	};
```

## Documentation/devicetree/bindings/input/imx-sc-pwrkey.txt
```
Device-Tree bindings for input/keyboard/imx_sc_pwrkey.c poweron/off driver
over SCU. On i.mx8QM/QXP poweron/off key is connected on SCU side, so need
to get key event by MU.

Required properties:
	- compatible = "fsl,imx8-pwrkey";

Each button/key looked as the sub node:
Required properties:
	- linux,code: the key value defined in
		include/dt-bindings/input/input.h
Optional property:
	- wakeup-source: wakeup feature, the keys can wakeup from
	suspend if the keys with this property pressed.

Example nodes:
	sc_pwrkey: sc-powerkey {
		compatible = "fsl,imx8-pwrkey";
		linux,keycode = <KEY_POWER>;
		wakeup-source;
	};
```

## Documentation/devicetree/bindings/input/rpmsg-keys.txt
```
Device-Tree bindings for input/keyboard/rpmsg-keys.c keys driver over
rpmsg. On i.mx7ULP keys are connected on M4 side, so rpmsg-keys driver
needed to get the key status from M4 side by rpmsg.

Required properties:
	- compatible = "fsl,rpmsg-keys";

Each button/key looked as the sub node:
Required properties:
	- label: the key name
	- linux,code: the key value defined in
		include/dt-bindings/input/input.h
Optional property:
	- rpmsg-key,wakeup: wakeup feature, the keys can wakeup from
	suspend if the keys with this property pressed.

Example nodes:
	rpmsg_keys: rpmsg-keys {
		compatible = "fsl,rpmsg-keys";

		volume-up {
			label = "Volume Up";
			rpmsg-key,wakeup;
			linux,code = <KEY_VOLUMEUP>;
		};

		volume-down {
			label = "Volume Down";
			rpmsg-key,wakeup;
			linux,code = <KEY_VOLUMEDOWN>;
		};
	};
```

## Documentation/devicetree/bindings/input/touchscreen/focaltech,fts.yaml
```yaml
# SPDX-License-Identifier: (GPL-2.0 OR BSD-2-Clause)
%YAML 1.2
---
$id: http://devicetree.org/schemas/input/touchscreen/focaltech,fts.yaml#
$schema: http://devicetree.org/meta-schemas/core.yaml#

title: FocalTech series touchscreen controller

maintainers:
  - Carlos Song <carlos.song@nxp.com>

allOf:
  - $ref: touchscreen.yaml#

properties:
  compatible:
    const: focaltech,ft3518u
  reg:
    const: 0x38
  irq-gpio:
    maxItems: 1
  max-touch-number:
    $ref: /schemas/types.yaml#/definitions/uint32
    description: max number of fingers supported
    minimum: 2
    maximum: 10
  touchscreen-size-x: true
  touchscreen-size-y: true

additionalProperties: false

required:
  - compatible
  - reg
  - irq-gpio
  - max-touch-number
  - touchscreen-size-x
  - touchscreen-size-y

examples:
  - |
    &i2c {
      #address-cells = <1>;
      #size-cells = <0>;
      clock-frequency = <400000>;

      focaltech_touch: touchscreen@38 {
        compatible = "focaltech,ft3518u";
        reg = <0x38>;
        irq-gpio = <&gpio3 27 GPIO_ACTIVE_HIGH>;
        touchscreen-size-x = <1080>;
        touchscreen-size-y = <1920>;
        max-touch-number = <10>;
      };
    };
```

## Documentation/devicetree/bindings/interrupt-controller/nxp,imx-intmux.txt
```
* NXP i.MX8QM/i.MX8QXP INTMUX Interrupt Multiplexing

Required properties:
- compatible: "nxp,imx-intmux".
- reg: should contain IC registers location and length.
- clocks : ipg clock for intmux.
- interrupts: an interrupt to the parent interrupt controller.
- interrupt-controller: identifies the node as an interrupt controller.
- interrupt-parent: gic interrupt controller, link to parent
- #interrupt-cells: the number of cells to define an interrupt, should be 2.
  The first cell is the IRQ number, the second cell is used to specify
  one of the supported IRQ types:
      IRQ_TYPE_EDGE_RISING = low-to-high edge triggered,
      IRQ_TYPE_EDGE_FALLING = high-to-low edge triggered,
      IRQ_TYPE_LEVEL_HIGH = active high level-sensitive,
      IRQ_TYPE_LEVEL_LOW = active low level-sensitive.

Optional properties:
- nxp,intmux_chans: specify the interrupt channel number, default is 1.

Examples:

	intmux_cm40: intmux@37400000 {
		compatible = "nxp,imx-intmux";
		reg = <0x0 0x37400000 0x0 0x1000>;
		interrupts = <GIC_SPI 16 IRQ_TYPE_LEVEL_HIGH>,
				<GIC_SPI 17 IRQ_TYPE_LEVEL_HIGH>,
				<GIC_SPI 18 IRQ_TYPE_LEVEL_HIGH>,
				<GIC_SPI 19 IRQ_TYPE_LEVEL_HIGH>,
				<GIC_SPI 20 IRQ_TYPE_LEVEL_HIGH>,
				<GIC_SPI 21 IRQ_TYPE_LEVEL_HIGH>,
				<GIC_SPI 22 IRQ_TYPE_LEVEL_HIGH>,
				<GIC_SPI 23 IRQ_TYPE_LEVEL_HIGH>;
		interrupt-controller;
		interrupt-parent = <&gic>;
		#interrupt-cells = <2>;
		clocks = <&clk IMX8QXP_CM40_IPG_CLK>;
		clock-names = "ipg";
		power-domains = <&pd_cm40_intmux>;
		status = "disabled";
	};

	i2c0_cm40: i2c@37230000 {
		compatible = "fsl,imx8qm-lpi2c";
		reg = <0x0 0x37230000 0x0 0x1000>;
		interrupts = <9 IRQ_TYPE_LEVEL_HIGH>;
		interrupt-parent = <&intmux_cm40>;
		clocks = <&clk IMX8QXP_CM40_I2C_CLK>,
			<&clk IMX8QXP_CM40_I2C_IPG_CLK>;
		clock-names = "per", "ipg";
		assigned-clocks = <&clk IMX8QXP_CM40_I2C_CLK>;
		assigned-clock-rates = <24000000>;
		power-domains = <&pd_cm40_i2c>;
		status = "disabled";
	};
```

## Documentation/devicetree/bindings/interrupt-controller/nxp,imx-irqsteer.txt
```
* NXP i.MX8QM/i.MX8QXP IRQSteer Interrupt Controllers

Required properties:
- compatible: "nxp,imx-irqsteer".
- reg: should contain IC registers location and length.
- interrupts: an interrupt to the parent interrupt controller.
- interrupt-controller: identifies the node as an interrupt controller.
- interrupt-parent: gic interrupt controller, link to parent
- #interrupt-cells: the number of cells to define an interrupt, should be 2.
  The first cell is the IRQ number, the second cell is used to specify
  one of the supported IRQ types:
      IRQ_TYPE_EDGE_RISING = low-to-high edge triggered,
      IRQ_TYPE_EDGE_FALLING = high-to-low edge triggered,
      IRQ_TYPE_LEVEL_HIGH = active high level-sensitive,
      IRQ_TYPE_LEVEL_LOW = active low level-sensitive.

Optional properties:
- nxp,irqsteer_chans: specify the interrupt channel number, default is 1.

Examples:

	irqsteer_hdmi: irqsteer@56260000 {
		compatible = "nxp,imx-irqsteer";
		reg = <0x0 0x56260000 0x0 0x1000>;
		interrupts = <GIC_SPI 61 IRQ_TYPE_LEVEL_HIGH>;
		interrupt-controller;
		interrupt-parent = <&gic>;
		#interrupt-cells = <2>;
		power-domains = <&pd_hdmi_i2c0>;
	};

	i2c0_hdmi: i2c@56266000 {
		compatible = "fsl,imx8qm-lpi2c";
		reg = <0x0 0x56266000 0x0 0x1000>;
		interrupts = <8 IRQ_TYPE_LEVEL_HIGH>;
		interrupt-parent = <&irqsteer_hdmi>;
		clocks = <&clk IMX8QM_HDMI_I2C0_CLK>;
		clock-names = "per";
		assigned-clocks = <&clk IMX8QM_HDMI_I2C0_CLK>;
		assigned-clock-rates = <24000000>;
		power-domains = <&pd_hdmi_i2c0>;
		status = "disabled";
	};
```
