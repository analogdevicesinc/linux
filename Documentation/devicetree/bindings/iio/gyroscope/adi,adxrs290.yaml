## Documentation/devicetree/bindings/iio/multiplexer/iio-gen-mux.yaml
```yaml
# SPDX-License-Identifier: (GPL-2.0 OR BSD-2-Clause)
# Copyright 2021 Analog Devices Inc.
%YAML 1.2
---
$id: http://devicetree.org/schemas/iio/multiplexer/io-gen-mux.yaml#
$schema: http://devicetree.org/meta-schemas/core.yaml#

title: I/O generic multiplexer bindings

maintainers:
  - Michael Hennerich <michael.hennerich@analog.com>

description: |
  If a signal or clock multiplexer device is needed to be under application
  control e.g. one or multiple SPDT switches, these bindings describe
  that situation.

  For each non-empty string in the mux-state-names property, a valid mux_select
  value will be created. Valid values can be queried using the
  mux_select_available attribute. The corresponding mux controller state
  is described in Documentation/devicetree/bindings/mux/mux-controller.yaml

properties:

  compatible:
    const: io-channel-mux

  mux-controls: true

  mux-state-names:
    $ref: /schemas/types.yaml#/definitions/string-array
    description:
      List of strings, labeling the mux controller states.

  clocks:
    description: Must contain a phandle for each entry in clock-names.

  '#clock-cells':
    const: 0

  clock-names:
    $ref: /schemas/types.yaml#/definitions/string-array
    description:
      List of strings, describing the parent clocks.

  clock-output-names:
    maxItems: 1

required:
  - compatible
  - mux-controls
  - mux-state-names

additionalProperties: false

examples:
  - |
    #include <dt-bindings/gpio/gpio.h>

    mux0: mux-controller {
      compatible = "gpio-mux";
      #mux-control-cells = <0>;

      mux-gpios = <&gpio 114 GPIO_ACTIVE_HIGH>, <&gpio 115 GPIO_ACTIVE_HIGH>;
    };

    clk_mux0: mux-doubler {
      compatible = "adi,gen_mux";

      clocks = <&fixed_clk0>, <&fixed_clk1>, <&fixed_clk2>, <&fixed_clk3>;
      #clock-cells = <0>;
      clock-names = "clk_100", "clk_200", "clk_400", "clk_800";
      clock-output-names = "clk-mux-out";

      mux-controls = <&mux0>;
      mux-state-names = "100M", "200M", "400M", "800M";
    };

...
```

## Documentation/devicetree/bindings/iio/offload/adi,spi-offload-pwm-trigger-dma-buffer.yaml
```yaml
# SPDX-License-Identifier: (GPL-2.0 OR BSD-2-Clause)
%YAML 1.2
---
$id: http://devicetree.org/schemas/iio/offload/adi,spi-offload-pwm-trigger-dma-buffer.yaml#
$schema: http://devicetree.org/meta-schemas/core.yaml#

title: SPI Offload with PWM Trigger and DMA Buffer Data Output

maintainers:
  - Michael Hennerich <Michael.Hennerich@analog.com>
  - Nuno Sá <nuno.sa@analog.com>

description: |
  This binding describes the connection of a PWM device to the trigger input
  and a DMA channel to the output data stream of a SPI Offload instance.

  https://wiki.analog.com/resources/fpga/peripherals/spi_engine/offload
  https://wiki.analog.com/resources/fpga/peripherals/spi_engine/tutorial

$ref: /schemas/spi/adi,axi-spi-engine.yaml#/$defs/offload

properties:
  compatible:
    const: adi,spi-offload-pwm-trigger-dma-buffer

  reg:
    maxItems: 1

  pwms:
    maxItems: 1

  dmas:
    maxItems: 1

required:
  - compatible
  - pwms
  - dmas

unevaluatedProperties: false

examples:
  - |
    spi {
        #address-cells = <1>;
        #size-cells = <0>;

        offloads {
            #address-cells = <1>;
            #size-cells = <0>;

            offload@0 {
                compatible = "adi,spi-offload-pwm-trigger-dma-buffer";
                reg = <0>;
                pwms = <&pwm 0>;
                dmas = <&dma 0>;
            };
        };
    };
```

## Documentation/devicetree/bindings/iio/position/adi,admt4000.yaml
```yaml
# SPDX-License-Identifier: (GPL-2.0 OR BSD-2-Clause)
# Copyright (c) 2025 Analog Devices, Inc.
%YAML 1.2
---
$id: http://devicetree.org/schemas/iio/position/adi,admt4000.yaml#
$schema: http://devicetree.org/meta-schemas/core.yaml#

title: Analog Devices ADMT4000 True Power-On Multiturn Sensor
maintainers:
  - Celine Joy Capua <celinejoy.capua@analog.com>

description: |
  The ADMT4000 is a magnetic turn count sensor capable of recording the number
  of rotations of a magnetic system even while the device is powered down. On
  power-up, the device can be interrogated to report the absolute position of
  the system. Datasheet can be found here:
  https://www.analog.com/media/en/technical-documentation/data-sheets/admt4000.pdf

properties:
  compatible:
    enum:
      - adi,admt4000

  reg:
    maxItems: 1

  spi-max-frequency:
    maximum: 10000000

  vdd-supply:
    description: Power Supply Input.

  acalc-gpios:
    description:
      Angle Calculation Status. Indicates when the angle is being calculated.
    maxItems: 1

  busy-gpios:
    description:
      Busy indicator gpio. Indicates when the part is performing measurement.
    maxItems: 1

  cnv-gpios:
    description:
      Conversion start gpio. Used when an external convert start
      signal is desired. If not present, the conversion start is done via device
      registers.
    maxItems: 1

  adi,one-shot-conversion:
    description:
      If present, this indicates that the device is operation at a one-shot
      conversion mode.
    type: boolean

  adi,cnv-sync-mode:
    description:
      Convert start synchronization mode.
    enum: [seq_ctrl, start_edge]
    default: seq_ctrl

required:
  - compatible
  - reg
  - vdd-supply

allOf:
  - $ref: /schemas/spi/spi-peripheral-props.yaml#

unevaluatedProperties: false

examples:
  - |
    spi {
      #address-cells = <1>;
      #size-cells = <0>;
      pos@0 {
        compatible = "adi,admt4000";
        reg = <0>;
        spi-max-frequency = <1000000>;

        vdd-supply = <&vdd>;
      };
    };
...
```
