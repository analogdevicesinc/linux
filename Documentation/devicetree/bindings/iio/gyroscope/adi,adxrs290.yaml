## Documentation/devicetree/bindings/jesd204/jesd204-device-props.yaml
```yaml
# SPDX-License-Identifier: (GPL-2.0-only OR BSD-2-Clause)
%YAML 1.2
---
$id: http://devicetree.org/schemas/jesd204/jesd204-device-props.yaml#
$schema: http://devicetree.org/meta-schemas/core.yaml#

title: JESD204 Device Node properties.

maintainers:
  - Michael Hennerich <michael.hennerich@analog.com>

description: |
  Bindings for JESD204 framework devices and topologies.

properties:
  jesd204-device:
    type: boolean
    description: Indicates this node is a JESD204 device.

  jesd204-top-device:
    $ref: /schemas/types.yaml#/definitions/uint32
    description: Marks this node as a JESD204 top-level device and provides a topology ID.

  jesd204-link-ids:
    $ref: /schemas/types.yaml#/definitions/uint32-array
    minItems: 1
    maxItems: 32
    description: Array of link IDs for the top-level JESD204 device.

  jesd204-ignore-errors:
    type: boolean
    description: Ignore errors for all links in this device.

  jesd204-sysref-provider:
    type: boolean
    description: Marks this device as a SYSREF provider for the topology.

  jesd204-secondary-sysref-provider:
    type: boolean
    description: Marks this device as a secondary SYSREF provider for the topology.

  jesd204-stop-states:
    $ref: /schemas/types.yaml#/definitions/uint32-array
    minItems: 1
    maxItems: 32
    description: Array of FSM state IDs where the device should stop.

  jesd204-inputs:
    description: |
      List of phandles with arguments describing input connections to other JESD204 devices.
      Each entry must have at least 2 arguments: topology ID and link ID.
    $ref: /schemas/types.yaml#/definitions/phandle-array

  "#jesd204-cells":
    description: Number of cells in each jesd204-inputs phandle.
    const: 2

  jesd204-device-id:
    description: JESD204 device ID (DID)
    $ref: /schemas/types.yaml#/definitions/uint32

  jesd204-bank-id:
    description: JESD204 bank ID (BID)
    $ref: /schemas/types.yaml#/definitions/uint32

  jesd204-lanes-per-device:
    description: Number of lanes per device (L)
    $ref: /schemas/types.yaml#/definitions/uint32

  jesd204-converters-per-device:
    description: Number of converters per device (M)
    $ref: /schemas/types.yaml#/definitions/uint32

  jesd204-octets-per-frame:
    description: Number of octets per frame (F)
    $ref: /schemas/types.yaml#/definitions/uint32

  jesd204-frames-per-multiframe:
    description: Number of frames per multiframe (K)
    $ref: /schemas/types.yaml#/definitions/uint32

  jesd204-num-multiblocks-in-emb:
    description: Number of multiblocks in extended multiblock (E)
    $ref: /schemas/types.yaml#/definitions/uint32

  jesd204-bits-per-sample:
    description: Number of bits per sample (N') or (NP)
    $ref: /schemas/types.yaml#/definitions/uint32

  jesd204-converter-resolution:
    description: Converter resolution in bits (N)
    $ref: /schemas/types.yaml#/definitions/uint32

  jesd204-scrambling:
    description: Enable or disable scrambling (SCR)
    $ref: /schemas/types.yaml#/definitions/uint32

  jesd204-encoding:
    description: JESD204 encoding type
    $ref: /schemas/types.yaml#/definitions/uint32

  jesd204-high-density:
    description: High-density mode (HD)
    $ref: /schemas/types.yaml#/definitions/uint32

  jesd204-version:
    description: JESD204 version (JESDV)
    $ref: /schemas/types.yaml#/definitions/uint32

  jesd204-subclass:
    description: JESD204 subclass (SC)
    $ref: /schemas/types.yaml#/definitions/uint32

  jesd204-control-words-per-frame-clk:
    description: Number of control words per frame clock (CF)
    $ref: /schemas/types.yaml#/definitions/uint32

  jesd204-control-bits-per-sample:
    description: Number of control bits per sample (CS)
    $ref: /schemas/types.yaml#/definitions/uint32

  jesd204-samples-per-converter-per-frame:
    description: Number of samples per converter per frame (S)
    $ref: /schemas/types.yaml#/definitions/uint32

  jesd204-dac-adj-resolution-steps:
    description: DAC adjustment resolution steps (ADJCNT)
    $ref: /schemas/types.yaml#/definitions/uint32

  jesd204-dac-adj-direction:
    description: DAC adjustment direction (ADJDIR)
    $ref: /schemas/types.yaml#/definitions/uint32

  jesd204-dac-phase-adjust:
    description: DAC phase adjustment (PHADJ)
    $ref: /schemas/types.yaml#/definitions/uint32

required:
  - jesd204-device

additionalProperties: true

examples:
  - |
    jesd204_top {
      compatible = "vendor,jesd204-top";
      jesd204-device;
      jesd204-top-device = <0>;
      jesd204-link-ids = <0 1>;
      jesd204-ignore-errors;
      jesd204-sysref-provider;
    };

    jesd204_dev {
      compatible = "vendor,jesd204-dev";
      jesd204-device;
      jesd204-inputs = <&jesd204_top 0 1>;
      #jesd204-cells = <2>;
    };
...
```

## Documentation/devicetree/bindings/leds/leds-ltc3208.yaml
```yaml
# SPDX-License-Identifier: (GPL-2.0-only OR BSD-2-Clause)
# Copyright (c) 2025 Analog Devices, Inc.
%YAML 1.2
---
$id: http://devicetree.org/schemas/leds/leds-ltc3208.yaml#
$schema: http://devicetree.org/meta-schemas/core.yaml#

title: LTC3208 Multidisplay LED Controller from Linear Technologies (Now Analog Devices).

maintainers:
  - Jan Carlo Roleda <jancarlo.roleda@analog.com>

description:
  The LTC3208 is a multidisplay LED controller that can support up to 1A to all
  connected LEDs.

  The datasheet for this device can be found in
  https://www.analog.com/en/products/ltc3208.html


properties:
  compatible:
    const: adi,ltc3208

  reg:
    maxItems: 1

  '#address-cells':
    const: 1

  '#size-cells':
    const: 0

  adi,disable-camhl-pin:
    type: boolean
    description: Configures whether the external CAMHL pin is disabled.
      if disabled then the output pins associated with CAM will always select
      the CAM register's high half-byte brightness.

  adi,cfg-enrgbs-pin:
    type: boolean
    description:
      Configures which channel the ENRGBS pin toggles when it receives a signal.
      ENRGBS pin controls the SUB channel's output pins if this is set,
      or RGB channel's output pins if this is unset.

  adi,force-cpo-level:
    $ref: /schemas/types.yaml#/definitions/string
    description: Forces the Charge Pump Output to a specified multiplier
    enum:
      - "1" # none; device CPO multiplier acts on dropout signals
      - "1.5"
      - "2"
    default:
      - "1"

  adi,disable-rgb-aux4-dropout:
    type: boolean
    description: Configures the RGB and AUX4 dropout signals to be disabled.

  adi,aux1-channel:
    $ref: /schemas/types.yaml#/definitions/string
    description:
      LED Channel that the AUX1 output pin mirrors its brightness level from.
    enum: [aux, main, sub, cam]
    default: aux

  adi,aux2-channel:
    $ref: /schemas/types.yaml#/definitions/string
    description:
      LED Channel that the AUX2 output pin mirrors its brightness level from.
    enum: [aux, main, sub, cam]
    default: aux

  adi,aux3-channel:
    $ref: /schemas/types.yaml#/definitions/string
    description:
      LED Channel that the AUX3 output pin mirrors its brightness level from.
    enum: [aux, main, sub, cam]
    default: aux

  adi,aux4-channel:
    $ref: /schemas/types.yaml#/definitions/string
    description:
      LED Channel that the AUX4 output pin mirrors its brightness level from.
    enum: [aux, main, sub, cam]
    default: aux

patternProperties:
  "^led@[0-7]$":
    type: object
    $ref: /schemas/leds/common.yaml#
    unevaluatedProperties: false
    properties:
      reg:
        description:
          LED Channel Number. each channel maps to a specific channel group used
          to configure the brightness level of the output pins corresponding to
          the channel.
        enum:
          - 0 # Main Channel (8-bit brightness)
          - 1 # Sub Channel (8-bit brightness)
          - 2 # AUX Channel (4-bit brightness)
          - 3 # Camera Channel, Low-side byte (4-bit brightness)
          - 4 # Camera Channel, High-side byte (4-bit brightness)
          - 5 # Red Channel (4-bit brightness)
          - 6 # Blue Channel (4-bit brightness)
          - 7 # Green Channel (4-bit brightness)
    required:
      - reg

required:
  - compatible
  - reg

additionalProperties: false

examples:
  - |
    #include <dt-bindings/gpio/gpio.h>
    i2c {
      #address-cells = <1>;
      #size-cells = <0>;

      led-controller@1b {
        compatible = "adi,ltc3208";
        reg = <0x1b>;
        #address-cells = <1>;
        #size-cells = <0>;
        adi,force-cpo-level = "1";
        adi,disable-camhl-pin;
        adi,cfg-enrgbs-pin;
        adi,disable-rgb-aux4-dropout;

        led@0 {
          reg = <0>;
        };

        led@1 {
          reg = <1>;
        };

        led@2 {
          reg = <2>;
        };

        led@3 {
          reg = <3>;
        };

        led@4 {
          reg = <4>;
        };

        led@5 {
          reg = <5>;
        };

        led@6 {
          reg = <6>;
        };

        led@7 {
          reg = <7>;
        };
      };
    };
```
