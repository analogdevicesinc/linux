## Documentation/devicetree/bindings/iio/temperature/adi,ltc2983.yaml
```yaml
# SPDX-License-Identifier: GPL-2.0
%YAML 1.2
---
$id: http://devicetree.org/schemas/iio/temperature/adi,ltc2983.yaml#
$schema: http://devicetree.org/meta-schemas/core.yaml#

title: Analog Devices LTC2983 Multi-sensor Temperature system

maintainers:
  - Nuno Sá <nuno.sa@analog.com>

description: |
  Analog Devices LTC2983 Multi-Sensor Digital Temperature Measurement System
  https://www.analog.com/media/en/technical-documentation/data-sheets/2983fc.pdf

properties:
  compatible:
    enum:
      - adi,ltc2983

  reg:
    maxItems: 1

  interrupts:
    maxItems: 1

  adi,temperature-celcius:
    description:
      If this property is present, the temperature is reported in Celsius.
    type: boolean
    maxItems: 1

  adi,mux-delay-config:
    description:
      The LTC2983 performs 2 or 3 internal conversion cycles per temperature result.
      Each conversion cycle is performed with different excitation and input multiplexer
      configurations. Prior to each conversion, these excitation circuits and input
      switch configurations are changed and an internal 1ms delay ensures settling prior
      to the conversion cycle in most cases. An extra delay can be configured using this
      property. The value written here is multiplied by 100us.
    allOf:
      - $ref: /schemas/types.yaml#/definitions/uint32
      - maximum: 255
        maxItems: 1

  adi,filter-notch-freq:
    description:
      Set's the default setting of the digital filter. The default is simultaneous
      50/60Hz rejection.
    allOf:
      - $ref: /schemas/types.yaml#/definitions/uint32
      - enum: [0, 1, 2]
    maxItems: 1

  '#address-cells':
    const: 1

  '#size-cells':
    const: 0

patternProperties:
  "^thermocouple@([1-9]|1[0-9]|20)$":
    type: object
    description: Represents a thermocouple sensor which is connected to one of the device channels.

    properties:
      reg:
        description: |
          The channel number. It can be connected to one of the 20 channels of the device.
          Note that, for differential thermocouples, the minimum is 2.
        minimum: 1
        maximum: 20
        maxItems: 1

      adi,sensor-type:
        description: |
           Identifies the type of thermocouple connected to the device.
        allOf:
          - $ref: /schemas/types.yaml#/definitions/uint32
          - enum: [1 2 3 4 5 6 7 8]
        maxItems: 1

      adi,sensor-config:
        description: |
          Raw value which set's the sensor configuration. Look at table 14 of the
          datasheet for how to set this value for thermocouples.
        allOf:
          - $ref: /schemas/types.yaml#/definitions/uint32
          - minimum: 1
          - maximun: 15
        maxItems: 1

      adi,cold-junction-handle:
        description: |
          Phandle which points to a sensor object responsible for measuring the
          thermocouple cold junction temperature.
        $ref: "/schemas/types.yaml#/definitions/phandle"
        maxItems: 1

    required:
      - reg
      - adi,sensor-type

patternProperties:
  "^diode@([1-9]|1[0-9]|20)$":
    type: object
    description: Represents a diode sensor which is connected to one of the device channels.

    properties:
      reg:
        description:
          The channel number. It can be connected to one of the 20 channels of the device.
          Note that, for differential diodes, the minimum is 2.
        minimum: 1
        maximum: 20
        maxItems: 1

      adi,sensor-type:
        description: |
          Identifies the sensor as a diode.
        const: 28
        maxItems: 1

      adi,sensor-config:
        description: |
          Raw value which set's the sensor configuration. Look at table 17 of the
          datasheet for how to set this value for diodes.
        allOf:
          - $ref: /schemas/types.yaml#/definitions/uint32
          - enum: [0 1 2 3 4 5 6 7]
        maxItems: 1

      adi,excitation-current:
        description: |
          This property controls the magnitude of the excitation current applied
          to the diode. Look at table 19 of the datasheet for more info.
        allOf:
          - $ref: /schemas/types.yaml#/definitions/uint32
          - enum: [0 1 2 3]
        maxItems: 1

      adi,ideal-factor-value:
        description: |
          This property sets the diode ideality factor. It is a 22 bit word. For
          more information look at table 20 of the datasheet.
        allOf:
          - $ref: /schemas/types.yaml#/definitions/uint32
        maxItems: 1

    required:
      - reg
      - adi,sensor-type

patternProperties:
  "^rtd@([2-9]|1[0-9]|20)$":
    type: object
    description: Represents a rtd sensor which is connected to one of the device channels.

    properties:
      reg:
        description: |
          The channel number. It can be connected to one of the 20 channels of the device.
        minimum: 2
        maximum: 20
        maxItems: 1

      adi,sensor-type:
        description: |
          Identifies the type of RTD connected to the device.
        allOf:
          - $ref: /schemas/types.yaml#/definitions/uint32
          - enum: [10 11 12 13 14 15 16 17]
        maxItems: 1

      adi,rsense-handle:
        description: |
          Phandle pointing to a rsense object associated with this RTD.
        $ref: "/schemas/types.yaml#/definitions/phandle"
        maxItems: 1

      adi,sensor-config:
        description: |
          Raw value which set's the sensor configuration. Look at table 28 of the
          datasheet for how to set this value for RTD's.
        allOf:
          - $ref: /schemas/types.yaml#/definitions/uint32
          - enum: [0 1 4 5 8 9 10 12 13 14]
        maxItems: 1

      adi,excitation-current:
        description: |
          This property controls the magnitude of the excitation current applied
          to the RTD. Look at table 29 of the datasheet for more info.
        allOf:
          - $ref: /schemas/types.yaml#/definitions/uint32
          - enum: [1 2 3 4 5 6 7 8]
        maxItems: 1

      adi,rtd-curve:
        description: |
          This property set the RTD curve used and the corresponding Callendar-Van
          Dusen constants. Look at table 30 of the datasheet.
        allOf:
          - $ref: /schemas/types.yaml#/definitions/uint32
          - enum: [0 1 2 3]
        maxItems: 1

    required:
      - reg
      - adi,sensor-type
      - adi,rsense-handle

patternProperties:
  "^thermistor@([1-9]|1[0-9]|20)$":
    type: object
    description: Represents a thermistor sensor which is connected to one of the device channels.

    properties:
      reg:
        description: |
          The channel number. It can be connected to one of the 20 channels of the device.
          Note that, for differential thermistors, the minimum is 2.
        minimum: 1
        maximum: 20
        maxItems: 1

      adi,sensor-type:
        description: |
          Identifies the type of thermistor connected to the device.
        allOf:
          - $ref: /schemas/types.yaml#/definitions/uint32
          - enum: [19 20 21 22 23 24 25]
        maxItems: 1

      adi,rsense-handle:
        description: |
          Phandle pointing to a rsense object associated with this thermistor.
        $ref: "/schemas/types.yaml#/definitions/phandle"
        maxItems: 1

      adi,sensor-config:
        description: |
          Raw value which set's the sensor configuration. Look at table 52 of the
          datasheet for how to set this value for thermistors.
        allOf:
          - $ref: /schemas/types.yaml#/definitions/uint32
          - enum: [0 1 2 4]
        maxItems: 1

      adi,excitation-current:
        description: |
          This property controls the magnitude of the excitation current applied
          to the thermistor. Look at table 53 of the datasheet for more info.
        allOf:
          - $ref: /schemas/types.yaml#/definitions/uint32-array
          - enum: [1 2 3 4 5 6 7 8 9 10 11 12]
        maxItems: 1

    required:
      - reg
      - adi,sensor-type
      - adi,rsense-handle

patternProperties:
  "^adc@([1-9]|1[0-9]|20)$":
    type: object
    description: Represents a channel which is being used as a direct adc.

    properties:
      reg:
        description: |
          The channel number. It can be connected to one of the 20 channels of the device.
          Note that, for differential adc's, the minimum is 2.
        minimum: 1
        maximum: 20
        maxItems: 1

      adi,sensor-type:
        description: |
          Identifies the sensor as a direct adc.
        const: 30
        maxItems: 1

      adi,single-ended:
        description: |
          Boolean property which set's the adc as single-ended.
        type: boolean

    required:
      - reg
      - adi,sensor-type

patternProperties:
  "^rsense@([2-9]|1[0-9]|20)$":
    type: object
    description: |
      Represents a rsense which is connected to one of the device channels.
      Rsense are used by thermistors and RTD's.

    properties:
      reg:
        description: |
          The channel number. It can be connected to one of the 20 channels of the device.
        minimum: 2
        maximum: 20
        maxItems: 1

      adi,sensor-type:
        description: |
          Identifies the sensor as a rsense.
        const: 29
        maxItems: 1

      adi,rsense-val:
        description: |
          Sets the value of the sense resistor. Look at table 20 of the datasheet
          for information on how to set this value.
        allOf:
          - $ref: /schemas/types.yaml#/definitions/uint32
        maxItems: 1

    required:
      - reg
      - adi,sensor-type
      - adi, rsense-val

required:
  - compatible
  - reg
  - interrupts

examples:
  - |
    #include <dt-bindings/interrupt-controller/irq.h>
    spi0 {
        #address-cells = <1>;
        #size-cells = <0>;

        sensor_ltc2983: ltc2983@0 {
                compatible = "adi,ltc2983";
                reg = <0>;

                #address-cells = <1>;
                #size-cells = <0>;

                adi,temperature-celcius;
                interrupts = <20 IRQ_TYPE_EDGE_RISING>;
                interrupt-parent = <&gpio>;

                thermocouple@18 {
                        reg = <18>;
                        adi,sensor-type = <8>; //Type B
                        adi,sensor-config = <1>; //Differential, open-circuit current
                        adi,cold-junction-handle = <&diode5>;
                };

                diode5: diode@5 {
                        reg = <5>;
                        adi,sensor-type = <28>;
                };

                rsense2: rsense@2 {
                        reg = <2>;
                        adi,sensor-type = <29>;
                        adi,rsense-val = <0x0012c000>; //1.2Kohms
                };

                rtd@14 {
                        reg = <14>;
                        adi,sensor-type = <15>; //PT1000
                        /*2-wire, internal gnd, no current rotation*/
                        adi,sensor-config = <1>;
                        adi,excitation-current = <7>; //500uA
                        adi,rsense-handle = <&rsense2>;
                };

                adc@10 {
                        reg = <10>;
                        adi,sensor-type = <30>;
                        adi,single-ended;
                };
        };
    };
...
```

## Documentation/devicetree/bindings/iio/temperature/adi,max30210.yaml
```yaml
# SPDX-License-Identifier: (GPL-2.0-only OR BSD-2-Clause)
# Copyright 2024 Analog Devices Inc.
%YAML 1.2
---
$id: http://devicetree.org/schemas/iio/temperature/adi,max30210.yaml#
$schema: http://devicetree.org/meta-schemas/core.yaml#

title: Analog Devices MAX30210 Low-Power I2C Digital Temperature Sensor

maintainers:
  - Daniel Matyas <daniel.matyas@analog.com>
  - John Erasmus Mari Geronimo <johnerasmusmari.geronimo@analog.com>

description: |
  The MAX30210 operates from 1.7V to 2.0V supply voltage, and is a low-power,
  high-accuracy digital temperature sensor with ±0.1°C accuracy from +20°C to
  +50°C and ±0.15°C accuracy from -20°C to +85°C.
  https://www.analog.com/media/en/technical-documentation/data-sheets/max30210.pdf

properties:
  compatible:
    enum:
      - adi,max30210

  reg:
    maxItems: 1

  vdd-supply:
    description: |
      Analog Supply Voltage Input. Must have values in the interval (1.7V; 5.5V)
      in order for the device to function correctly.

  powerdown-gpios:
    description: |
      GPIO spec for CVT/PDB pin. Should be configured with GPIO_ACTIVE_LOW.
    maxItems: 1

  interrupts:
    description: |
      Connected to INT pin. Should be configured with type IRQ_TYPE_EDGE_BOTH.
    maxItems: 1

  pwms:
    description: |
      If present, CVT/PDB pin is used for external temperature conversion. The
      active edge of CVT/PDB pin is the polarity of the PWM. Name of PWM should
      be "ext-cvt-pwm".

  pwm-names:
    const: ext-cvt-pwm

  adi,ext-conv-rising-edge:
    description:
      It is used to set the active edge of the EXT CVT to rising. By default,
      the active edge is falling.
    type: boolean

  adi,roc-en:
    description: |
      If present, temperature change detection is enabled.
    type: boolean

  adi,roc-len:
    description: |
      If present, this is the length of the rate of change filter. The rate of
      change is calculated based on the number of samples selected in this
      property. The user needs to set the appropriate number of samples to fit
      the application needs. The default value is 2.
    $ref: /schemas/types.yaml#/definitions/uint32
    enum: [2, 3, 5, 9, 17, 33, 65]

  adi,comp-int:
    description: |
      If present, the device is in comparator mode. In this mode, the low
      temperature threshold value acts as high temperature hysteresis. If not
      present, interrupt mode is used (default).
    type: boolean

required:
  - compatible
  - reg
  - vdd-supply
  - powerdown-gpios

additionalProperties: false

examples:
  - |
    #include <dt-bindings/interrupt-controller/irq.h>
    #include <dt-bindings/gpio/gpio.h>
    #include <dt-bindings/pwm/pwm.h>

    i2c {
        #address-cells = <1>;
        #size-cells = <0>;
        status = "okay";

        temperature-sensor@40 {
            compatible = "adi,max30210";
            reg = <0x40>;
            vdd-supply = <&vdd>;
            powerdown-gpios = <&gpio 12 GPIO_ACTIVE_LOW>;

            interrupt-parent = <&gpio>;
            interrupts = <17 IRQ_TYPE_EDGE_BOTH>;

            pwm-names = "ext-cvt-pwm";
            pwms = <&pwm 0 0>;
            adi,ext-conv-rising-edge;
            adi,roc-en;
            adi,comp-int;
        };
    };
...
```

## Documentation/devicetree/bindings/iio/temperature/adi,max31827.yaml
```yaml
# SPDX-License-Identifier: (GPL-2.0-only OR BSD-2-Clause)
%YAML 1.2
---
$id: http://devicetree.org/schemas/iio/temperature/adi,max31827.yaml#
$schema: http://devicetree.org/meta-schemas/core.yaml#

title: Analog Devices MAX31827, MAX31828, MAX31829 Low-Power Temperature Switch

maintainers:
  - Daniel Matyas <daniel.matyas@analog.com>

description: |
  Analog Devices MAX31827, MAX31828, MAX31829 Low-Power Temperature Switch with
  I2C Interface

  https://www.analog.com/media/en/technical-documentation/data-sheets/MAX31827-MAX31829.pdf

properties:
  compatible:
    enum:
      - adi,max31827

  reg:
    maxItems: 1

required:
  - compatible
  - reg

additionalProperties: false

examples:
  - |
    i2c {
      #address-cells = <1>;
      #size-cells = <0>;
      status = "okay";

      max31827: max31827@42 {
        compatible = "adi,max31827";
        reg = <0x42>;
      };
    };
...
```
