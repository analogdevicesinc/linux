## Documentation/devicetree/bindings/iio/gyroscope/adi,adxrs290.yaml
```yaml
# SPDX-License-Identifier: (GPL-2.0 OR BSD-2-Clause)
# Copyright 2020 Analog Devices Inc.
%YAML 1.2
---
$id: http://devicetree.org/schemas/iio/gyroscope/adi,adxrs290.yaml#
$schema: http://devicetree.org/meta-schemas/core.yaml#

title: Analog Devices ADXRS290 Dual-Axis MEMS Gyroscope

maintainers:
  - Nishant Malpani <nish.malpani25@gmail.com>

description: |
  Bindings for the Analog Devices ADXRS290 dual-axis MEMS gyroscope device.
  https://www.analog.com/media/en/technical-documentation/data-sheets/ADXRS290.pdf

properties:
  compatible:
    enum:
      - adi,adxrs290

  reg:
    maxItems: 1

required:
  - compatible
  - reg

examples:
  - |
    spi {
        #address-cells = <1>;
        #size-cells = <0>;
        adxrs290@0 {
                   compatible = "adi,adxrs290";
                   reg = <0>;
                   spi-max-frequency = <5000000>;
        };
    };
...
```

## Documentation/devicetree/bindings/iio/imu/adi,adis16475.yaml
```yaml
# SPDX-License-Identifier: (GPL-2.0-only OR BSD-2-Clause)
%YAML 1.2
---
$id: http://devicetree.org/schemas/iio/imu/adi,adis16475.yaml#
$schema: http://devicetree.org/meta-schemas/core.yaml#

title: Analog Devices ADIS16475 and similar IMUs

maintainers:
  - Nuno Sá <nuno.sa@analog.com>

description: |
  Analog Devices ADIS16475 and similar IMUs
  https://www.analog.com/media/en/technical-documentation/data-sheets/ADIS16475.pdf

properties:
  compatible:
    enum:
      - adi,adis16475-1
      - adi,adis16475-2
      - adi,adis16475-3
      - adi,adis16477-1
      - adi,adis16477-2
      - adi,adis16477-3

  reg:
    maxItems: 1

  spi-cpha: true

  spi-cpol: true

  spi-max-frequency:
    maximum: 2000000

  interrupts:
    maxItems: 1

  clocks:
    maxItems: 1

  clock-names:
    oneOf:
      - const: sync
      - const: direct-sync
      - const: pulse-sync
      - const: scaled-sync

  reset-gpios:
    description:
      Must be the device tree identifier of the RESET pin. If specified,
      it will be asserted during driver probe. As the line is active low,
      it should be marked GPIO_ACTIVE_LOW.
    maxItems: 1

  adi,scaled-output-hz:
    description:
      This property must be present if the clock mode is scaled-sync through
      clock-names property. In this mode, the input clock can have a range
      of 1Hz to 128HZ which must be scaled to originate an allowable sample
      rate. This property specifies that rate.
    minimum: 1900
    maximum: 2100

required:
  - compatible
  - reg
  - interrupts
  - spi-cpha
  - spi-cpol

examples:
  - |
    #include <dt-bindings/interrupt-controller/irq.h>
    spi {
            #address-cells = <1>;
            #size-cells = <0>;

            adis16475: adis16475-3@0 {
                    compatible = "adi,adis16475-3";
                    reg = <0>;
                    spi-cpha;
                    spi-max-frequency = <2000000>;
                    interrupts = <4 IRQ_TYPE_EDGE_RISING>;
                    interrupt-parent = <&gpio>;
            };
    };
...
```

## Documentation/devicetree/bindings/iio/imu/adi,adis16550.yaml
```yaml
# SPDX-License-Identifier: (GPL-2.0 OR BSD-2-Clause)
%YAML 1.2
---
$id: http://devicetree.org/schemas/iio/imu/adi,adis16550.yaml#
$schema: http://devicetree.org/meta-schemas/core.yaml#

title: Analog Devices ADIS16550 and similar IMUs

maintainers:
  - Ramona Gradinariu <ramona.gradinariu@analog.com>

properties:
  compatible:
    enum:
      - adi,adis16550

  reg:
    maxItems: 1

  spi-cpha: true

  spi-cpol: true

  spi-max-frequency:
    maximum: 15000000

  interrupts:
    maxItems: 1

  reset-gpios:
    description:
      Must be the device tree identifier of the RESET pin. If specified,
      it will be asserted during driver probe. As the line is active low,
      it should be marked GPIO_ACTIVE_LOW.
    maxItems: 1

  clocks:
    maxItems: 1
    description: If not provided, then the internal clock is used.

  adi,sync-mode:
    description:
      Configures the device SYNC pin. The following modes are supported
      0 - direct_sync
      1 - scaled_sync
    $ref: /schemas/types.yaml#/definitions/uint32
    minimum: 0
    maximum: 1

required:
  - compatible
  - reg
  - interrupts
  - spi-cpha
  - spi-cpol
  - spi-max-frequency

allOf:
  - if:
      properties:
        adi,sync-mode:
          enum: [0, 1]

    then:
      dependencies:
        adi,sync-mode: [ clocks ]

  - $ref: /schemas/spi/spi-peripheral-props.yaml#

additionalProperties: false

examples:
  - |
    #include <dt-bindings/interrupt-controller/irq.h>
    spi {
        #address-cells = <1>;
        #size-cells = <0>;

        imu@0 {
            compatible = "adi,adis16550";
            reg = <0>;
            spi-max-frequency = <15000000>;
            spi-cpol;
            spi-cpha;
            interrupts = <4 IRQ_TYPE_EDGE_FALLING>;
            interrupt-parent = <&gpio>;
        };
    };
...
```

## Documentation/devicetree/bindings/iio/imu/nxp,rpmsg_iio_pedometer.yaml
```yaml
# SPDX-License-Identifier: (GPL-2.0-only OR BSD-2-Clause)
%YAML 1.2
---
$id: http://devicetree.org/schemas/iio/imu/nxp,rpmsg_iio_pedometer.yaml#
$schema: http://devicetree.org/meta-schemas/core.yaml#

title: NXP virtual pedometer sensor through rpmsg

maintainers:
  - Haibo Chen <haibo.chen@nxp.com>

description: |
  For NXP iMX7ULP/iMX8ULP evk board, some sensors connect with M4 core,
  A core has to communicate with sensors through virtual IO bus like
  RPMSG.

properties:
  compatible:
    enum:
      - nxp,rpmsg-iio-pedometer

required:
  - compatible

additionalProperties: false

examples:
  - |
    rpmsg_sensor:rpmsg-sensor {
        compatible = "nxp,rpmsg-iio-pedometer";
    };
```

## Documentation/devicetree/bindings/iio/jesd204/adi,iio-fakedev.yaml
```yaml
# SPDX-License-Identifier: (GPL-2.0-only OR BSD-2-Clause)
%YAML 1.2
---
$id: http://devicetree.org/schemas/iio/jesd204/adi,iio-fakedev.yaml#
$schema: http://devicetree.org/meta-schemas/core.yaml#

title: Analog Devices Generic IIO fake device driver

maintainers:
  - Michael Hennerich <michael.hennerich@analog.com>

description: |
  This driver allows to link a list of device sysfs attributes
  from either a platform, spi or i2c device to an iio device.
  This driver should only be used for debug or test purposes.

properties:
  compatible:
    enum:
      - adi,iio-fake-platform-device
      - adi,iio-fake-spi-device"
      - adi,iio-fake-i2c-device"

  adi,faked-dev:
    $ref: /schemas/types.yaml#/definitions/phandle
    description:
      A reference (phandle) to a the actual device to which the fake device links attribues from.

  adi,attribute-names:
    $ref: /schemas/types.yaml#/definitions/string-array
    description:
      List of device sysfs attribute strings.

required:
  - compatible
  - adi,faked-dev
  - adi,attribute-names

additionalProperties: false

examples:
  - |
    axi-jesd204-rx@0 {
      compatible = "adi,iio-fake-platform-device";
      adi,faked-dev = <&axi_ad9081_rx_jesd>;
      adi,attribute-names =
        "status", "encoder", "lane0_info", "lane1_info",
        "lane2_info", "lane3_info";
      label = "axi-jesd204-rx";
    };

    axi-jesd204-rx@1 {
      compatible = "adi,iio-fake-platform-device";
      adi,faked-dev = <&axi_ad9081_tx_jesd>;
      adi,attribute-names = "status", "encoder";
      label = "axi-jesd204-rx";
    };

    axi-adxcvr-rx@2 {
      compatible = "adi,iio-fake-platform-device";
      adi,faked-dev = <&axi_ad9081_adxcvr_rx>;
      adi,attribute-names =
        "eyescan_info", "prbs_status", "prbs_counter_reset",
        "prescale", "enable", "prbs_error_counters", "reg_access",
        "eye_data", "prbs_select";
      label = "axi-adxcvr-rx";
    };

    axi-adxcvr-tx@4 {
      compatible = "adi,iio-fake-platform-device";
      adi,faked-dev = <&axi_ad9081_adxcvr_tx>;
      adi,attribute-names = "prbs_select", "prbs_error_inject", "reg_access";
      label = "axi-adxcvr-tx";
    };
...
```

## Documentation/devicetree/bindings/iio/jesd204/adi,jesd204-tx.txt
```
Analog Devices JESD204B Transmit Peripheral Driver

The AXI JESD204B TX peripheral driver is a simple driver that supports the
ADI JESD204B Transmit Peripheral. The driver reads JESD204B link configuration
data from the devicetree and configures the peripheral accordingly. After
configuration has completed the JESD204B link is enabled. Link state can be
monitored through sysfs files.

Required properties:
  - compatible: One of "adi,axi-jesd204-tx-1.0, "adi,axi-jesd204-tx-1.3".
  - reg: Base address and register area size. This parameter expects a register
         range.
  - interrupts: Property with a value describing the interrupt number.
  - clock-names: List of input clock names - “s_axi_aclk”, “device_clk”
  - clocks: Clock phandles and specifiers (See clock bindings for details on
            clock-names and clocks).
  - adi,frames-per-multiframe: Number of frames per multi-frame (K).
  - adi,octets-per-frame: Number of octets per frame (N).

Optional properties:
  - adi,high-density: If specified the JESD204B link is configured for high
                      density (HD) operation.

Example:

jesd204b-tx@77a00000 {
	compatible = "adi,axi-jesd204-tx-1.0";
	reg = <0x77a00000 0x10000>;
	interrupts = <0 56 4>;

	clock-names = "s_axi_aclk", "device_clk";
	clocks = <&clkc 14>, <&ad9528 13>;

	adi,octets-per-frame = <32>;
	adi,frames-per-multiframe = <4>;
};
```

## Documentation/devicetree/bindings/iio/light/adi,adpd188.yaml
```yaml
# SPDX-License-Identifier: (GPL-2.0 OR BSD-2-Clause)
# Copyright 2019 Analog Devices Inc.
%YAML 1.2
---
$id: http://devicetree.org/schemas/bindings/iio/light/adi,adpd188.yaml#
$schema: http://devicetree.org/meta-schemas/core.yaml#

title: Analog Devices ADPD188 device driver

maintainers:
  - Andrei Drimbarean <andrei.drimbarean@analog.com>

description: |
  Bindings for the Analog Devices ADPD188 device. The device support both SPI and I2C
  interfaces. Datasheet can be found here:
    https://www.analog.com/media/en/technical-documentation/data-sheets/adpd188bi.pdf
properties:
  compatible:
    enum:
      - adi,adpd188

  reg:
    description: SPI chip select number or I2C slave address
    maxItems: 1

  interrupts:
    description: IRQ line for the device or device chain
    maxItems: 1

  spi-cpol: true

  spi-cpha: true

  spi-max-frequency:
    maximum: 10000000

  '#address-cells':
    const: 1

  '#size-cells':
    const: 0

  status:
    const: 'okay'

  adi,no-of-devices:
    description: Number of daisy-chained devices on an I2C bus
      string
    $ref: "http://devicetree.org/schemas/types.yaml#/definitions/uint8-item"

required:
  - compatible
  - reg
  - interrupts

examples:
  - |
    i2c {
      #address-cells = <1>;
      #size-cells = <0>;
      status = "okay";
      
      adpd188@064 {
        compatible = "adi,adpd188";
        reg = <0x64>;
        interrupts = <9 IRQ_TYPE_EDGE_RISING>;
        interrupt-parent = <&gpio>;
        adi,no-of-devices = <8>;
    };

additionalProperties: false
```

## Documentation/devicetree/bindings/iio/meter/adi,ade9078.yaml
```yaml
# SPDX-License-Identifier: (GPL-2.0 OR BSD-2-Clause)
# Copyright 2021 Analog Devices Inc.
%YAML 1.2
---
$id: http://devicetree.org/schemas/bindings/iio/addac/adi,ade9078.yaml#
$schema: http://devicetree.org/meta-schemas/core.yaml#

title: Analog Devices ADE9078 High Performance, Polyphase Energy Metering driver

mainterners:
  -Ciprian Hegbeli <ciprian.hegbeli@analog.com>

description: |
  The ADE9078 1 is a highly accurate, fully integrated energy
  metering device. Interfacing with both current transformer
  (CT) and Rogowski coil sensors, the ADE9078 enables users to
  develop a 3-phase metrology platform, which achieves high
  performance for Class 1 up to Class 0.2 meters.

properties:
  compatible:
    enum:
      - adi,ade9078

    reg:
      maxItems: 1

    '#address-cells':
      const: 1

    '#size-cells':
      const: 0

    spi-max-frequency:
      maximum: 1000000

    interrupts:
      maxItems: 2

    reset-gpios:
      description: |
        Must be the device tree identifier of the RESET pin. As the line is
        active low, it should be marked GPIO_ACTIVE_LOW.
      maxItems: 1

    interrupt-names:
      description: |
        Names to be attributed to the interrupts of the device. Should be "irq0"
        or "irq1"

    adi,wf-cap-sel:
      description: |
        This bit selects whether the waveform buffer is filled with resampled
        data or fixed data rate data
      maxItems: 1
      minimum: 0
      maximum: 1

    adi,wf-mode:
      description: |
        Fixed data rate waveforms filling and trigger based modes.
        0 - Stop when waveform buffer is full.
        1 - Continuous fill—stop only on enabled trigger events.
        2 - Continuous filling—center capture around enabled trigger events.
        3 - Continuous fill—save event address of enabled trigger events.
      maxItems: 1
      minimum: 0
      maximum: 3

    adi,wf-src:
      description: |
        Waveform buffer source and DREADY, data ready update rate, selection.
        0 - Sinc4 output, at 16 kSPS.
        1 - Reserved
        2 - Sinc4 + IIR LPF output, at 4 kSPS.
        3 - Current and voltage channel waveform samples,processed by the DSP
            (xI_PCF, xV_PCF) at 4 kSPS.
      maxItems: 1
      minimum: 0
      maximum: 3

    adi,wf-in-en:
      description: |
        This setting determines whether the IN waveform samples are read out of
        the waveform buffer through SPI.
      maxItems: 1
      minimum: 0
      maximum: 1

  required:
    - compatible
    - reg
    - interrupts
    - interrupt-names
    - adi,wf-cap-sel
    - adi,wf-mode
    - adi,wf-src
    - adi,wf-in-en

patternProperties:
  "^phase@[0-3]$":
    type: object
    description: |
      Represents the external phases which are externally connected. Each phase
      has a current, voltage and power component

    properties:
      reg:
        description: |
          The phase represented by a number
          0 - Phase A
          1 - unused
          2 - Phase B
          3 - unused
          4 - Phase C
        maxItems: 1
        minimum: 0
        maximum: 4

    required:
      - reg

examples:
  - |
    ade9078@0 {
      compatible = "adi,ade9078";
      reg = <0>;
      spi-max-frequency = <1000000>;

      #address-cells = <1>;
      #size-cells = <0>;

      reset-gpios = <&gpio 4 GPIO_ACTIVE_LOW>;

      interrupts = <2 IRQ_TYPE_EDGE_FALLING>, <3 IRQ_TYPE_EDGE_FALLING>;
      interrupt-names = "irq0", "irq1";
      interrupt-parent = <&gpio>;

      adi,wf-cap-sel = <0x1>;
      adi,wf-mode = <0x0>;
      adi,wf-src = <0x3>;
      adi,wf-in-en = <0x0>;

      phase@0 {
        reg = <0>;
      };
      phase@1 {
        reg = <4>;
      };
    };
```
