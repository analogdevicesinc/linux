## Documentation/devicetree/bindings/media/i2c/sony,isx021.yaml
```yaml
# SPDX-License-Identifier: (GPL-2.0-only OR BSD-2-Clause)
%YAML 1.2
---
$id: http://devicetree.org/schemas/media/i2c/sony,isx021.yaml#
$schema: http://devicetree.org/meta-schemas/core.yaml#

title: Sony 1/2.57-inch 2.51MP CMOS Digital Image Sensor

maintainers:
  - Bogdan Togorean <bogdan.togorean@analog.com>

description: |
  The Sony ISX021 is a 1/2.57-inch CMOS active pixel digital image sensor.
  It is programmable through an I2C interface. Image data is sent through MIPI CSI-2,
  through 2 or 4 lanes.

properties:
  compatible:
    const: sony,isx021

  reg:
    maxItems: 1

  clocks:
    description: Reference to the xclk clock.
    maxItems: 1

  reset-gpios:
    description: GPIO descriptor for the reset pin.
    maxItems: 1

  dvdd-supply:
    description: Chip digital IO regulator (1.8V).

  port:
    description: Video output port.
    $ref: /schemas/graph.yaml#/$defs/port-base
    additionalProperties: false

    properties:
      endpoint:
        $ref: /schemas/media/video-interfaces.yaml#
        additionalProperties: false

        properties:
          clock-lanes:
            const: 0

          data-lanes:
            minItems: 1

          remote-endpoint: true

        required:
          - data-lanes
          - clock-lanes
    required:
      - endpoint

required:
  - compatible
  - reg
  - clocks
  - reset-gpios
  - dvdd-supply
  - port

additionalProperties: false

examples:
  - |
    #include <dt-bindings/gpio/gpio.h>

    i2c0 {
        #address-cells = <1>;
        #size-cells = <0>;

        camera-sensor@1a {
            compatible = "sony,isx021";
            reg = <0x1a>;
            dvdd-supply = <&sw2_reg>;
            reset-gpios = <&gpio0 8 GPIO_ACTIVE_LOW>;
            clocks = <&camera_clk>;

            port {
                isx021_ep: endpoint {
                    clock-lanes = <0>;
                    data-lanes = <1 2 3 4>;
                    remote-endpoint = <&csiphy0_ep>;
                };
            };
        };
    };
```

## Documentation/devicetree/bindings/media/imx8-isi.txt
```
NXP Image Sensor Interface
========================

The Image Sensor Interface (ISI) is used to obtain the image data for
processing in its pipeline channels. Each pipeline processes the image
line from a configured source and performs one or more functions that
are configured by software, such as down scaling, color space conversion,
de-interlacing, alpha insertion, cropping and rotation (horizontal and
vertical). The processed image is stored into programmable memory locations.

Required properties:
- compatible: should be "fsl,imx8-isi", where SoC can be one of imx8qxp, imx8qm
- reg: the register base and size for the device registers
- interrupts: the ISI interrupt, high level active
- clock-names: should be "per"
- clocks: the ISI AXI clock
- interface: specify ISI input, virtual channel and output,
             <Input MIPI_VCx Output>
             Input : 0-DC0, 1-DC1, 2-MIPI CSI0, 3-MIPI CSI1, 4-HDMI, 5-MEM
	     VCx   : 0-VC0, 1-VC1, 2-VC2, 3-VC3, MIPI CSI only
	     Output: 0-DC0, 1-DC1, 2-MEM

Example:
        isi_0: isi@58100000 {
                compatible = "fsl,imx8-isi";
                reg = <0x58100000 0x10000>;
                interrupts = <GIC_SPI 297 IRQ_TYPE_LEVEL_HIGH>;
                interrupt-parent = <&gic>;
                clocks = <&img_lpcg IMX_IMG_LPCG_PDMA0_CLK>;
                clock-names = "per";
                power-domains = <&pd IMX_SC_R_ISI_CH0>;
                interface = <2 0 2>;
        };
```

## Documentation/devicetree/bindings/media/imx8-media-dev.txt
```
Virtual Media device
-------------------------------

Virtual Media device is used to manage all modules in image capture subsystem
of imx8qxp/qm platform. ISI(Image Sensor Interface), MIPI CSI, Parallel CSI
device node should be under it.

Required properties:
  - compatible    : must be "fsl,mxc-md";
  - reg           : Must contain an entry for each entry in reg-names;
  - #address-cells: should be <1>;
  - #size-cells   : should be <1>;
  - ranges        : use to handle address space

Optional properties:
  - parallel_csi: indicate that camera sensor use parallel interface



For example:

        cameradev: camera {
                compatible = "fsl,mxc-md", "simple-bus";
                #address-cells = <1>;
                #size-cells = <1>;
                ranges;

                isi@58100000 {
                        compatible = "fsl,imx8-isi";
                        reg = <0x58100000 0x10000>;
                        ...
                };
                csi@58227000 {
                        compatible = "fsl,mxc-mipi-csi2";
                        ...
                };
                ...
        };
```

## Documentation/devicetree/bindings/media/nxp,imx-parallel-csi.yaml
```yaml
# SPDX-License-Identifier: (GPL-2.0-only OR BSD-2-Clause)
%YAML 1.2
---
$id: http://devicetree.org/schemas/media/nxp,imx-parallel-csi.yaml#
$schema: http://devicetree.org/meta-schemas/core.yaml#

title: i.MX8 and i.MX9 Parallel Camera Interface

maintainers:
  - Alice Yuan <alice.yuan@nxp.com>

description: |
  This is device node for the Parallel Camera Interface which enables the
  chip to connect directly to external Parallel CMOS image sensors.
  Supports up to 80MHz input clock from sensor.
  Supports the following input data formats
    - 8-bit/10-bit Camera Sensor Interface (CSI)
    - 8-bit data port for RGB, YCbCr, and YUV data input
    - 8-bit/10-bit data ports for Bayer data input
  Parallel Camera Interface is hooked to the Imaging subsystem via the
  Pixel Link.

properties:
  compatible:
    oneOf:
      - enum:
          - fsl,imx8-parallel-csi
          - fsl,imx93-parallel-csi
          - fsl,imx91-parallel-csi
      - items:
          - const: fsl,imx8-parallel-csi
          - const: fsl,imx93-parallel-csi
          - const: fsl,imx91-parallel-csi

  reg:
    maxItems: 1

  clocks:
    maxItems: 2

  clock-names:
    items:
      - const: pixel, ipg

  power-domains:
    maxItems: 2

  port:
    $ref: /schemas/graph.yaml#/properties/port

required:
  - compatible
  - reg
  - clocks
  - clock-names
  - port

additionalProperties: false

examples:
  - |
    parallel_csi: pcsi@4ac10070 {
            compatible = "fsl,imx93-parallel-csi";
            reg = <0x4ac10070 0x10>;
            clocks = <&clk IMX93_CLK_MIPI_CSI_GATE>,
            <&clk IMX93_CLK_MEDIA_APB>;
            clock-names = "pixel", "ipg";
            assigned-clocks = <&clk IMX93_CLK_CAM_PIX>;
            assigned-clock-parents = <&clk IMX93_CLK_VIDEO_PLL>;
            assigned-clock-rates = <140000000>;
            power-domains = <&media_blk_ctrl IMX93_MEDIABLK_PD_MIPI_CSI>;
            status = "disabled";
            ports {
                    #address-cells = <1>;
                    #size-cells = <0>;

                    port@0 {
                            reg = <0>;
                            parallel_csi_in: endpoint {
                                remote-endpoint = <&mt9m114_ep>;
                            };
                    };

                    port@1 {
                            reg = <1>;
                             parallel_csi_out: endpoint {
                                     remote-endpoint = <&isi_in>;
                             };
                    };
            };
    };
...
```

## Documentation/devicetree/bindings/media/nxp,neoisp.yaml
```yaml
# SPDX-License-Identifier: (GPL-2.0-only OR BSD-2-Clause)
%YAML 1.2
---
$id: http://devicetree.org/schemas/media/nxp,neoisp.yaml#
$schema: http://devicetree.org/meta-schemas/core.yaml#

title: NXP NEOISP Image Signal Processing Pipeline

maintainers:
  - Aymen Sghaier <aymen.sghaier@nxp.com>
  - Julien Vuillaumier <julien.vuillaumier@nxp.com>

description: |-
  The NXP NEOISP performs a set of image processing tasks on the RAW camera stream,
  where the input camera stream and NEOISP processed output image are stored in DDR
  or any system memory fast enough to keep up with NEOISP processing.

properties:
  compatible:
    enum:
      - nxp,neosip

  reg:
    maxItems: 2

  reg-names:
    items:
      - const: registers
      - const: stats

  interrupts:
    maxItems: 1

  clocks:
    maxItems: 4

  clock-names:
    items:
      - const: camblk_isp_axi
      - const: camblk_isp_pixel
      - const: camblk_isp
      - const: camcm0

  power-domains:
    maxItems: 1

required:
  - compatible
  - reg
  - interrupts
  - clocks
  - power-domains

additionalProperties: false

examples:
  - |
    #include <dt-bindings/clock/fsl,imx95-clock.h>
    #include <dt-bindings/interrupt-controller/arm-gic.h>
    #include <dt-bindings/power/fsl,imx95-power.h>
    neosip0: isp@4ae00000 {
        compatible = "nxp,imx95-a0-neoisp";
        #address-cells = <2>;
        #size-cells = <2>;
        reg = <0x0 0x4ae00000 0x0 0x8000>, <0x0 0x4afe0000 0x0 0x10000>;
        reg-names = "registers", "stats";
        interrupts = <GIC_SPI 222 IRQ_TYPE_LEVEL_HIGH>;
        interrupt-parent = <&gic>;
        clocks = <&cameramix_csr IMX95_CLK_CAMBLK_ISP_AXI>,
                 <&cameramix_csr IMX95_CLK_CAMBLK_ISP_PIXEL>,
                 <&cameramix_csr IMX95_CLK_CAMBLK_ISP>;
        clock-names = "camblk_isp_axi", "camblk_isp_pixel", "camblk_isp";
        power-domains = <&scmi_devpd IMX95_PD_CAMERA>;
    };
```

## Documentation/devicetree/bindings/mfd/adi,ad242x-master.yaml
```yaml
# SPDX-License-Identifier: (GPL-2.0 OR BSD-2-Clause)
%YAML 1.2
---
$id: "http://devicetree.org/schemas/mfd/adi,ad242x-master.yaml#"
$schema: "http://devicetree.org/meta-schemas/core.yaml#"

title: Analog Devices AD242x A²B master node transceiver

maintainers:
  - Daniel Mack <daniel@zonque.org>

description: |
  AD242x devices are A²B (Automotive Audio Bus) transceivers that are connected
  to each other in a daisy-chain. The payload transported on that bus includes
  multi-channel audio, I²C, GPIOs and others.

  The datasheet is located here:

    https://www.analog.com/media/en/technical-documentation/user-guides/AD242x_TRM_Rev1.1.pdf

  The primary node in the chain is called the master node, and the nodes in the
  chain are called slave nodes. A master can address up to 15 slave nodes. The
  master node exposes two I²C addresses, one for accessing the registers on the
  node itself, and one for registers on one of the slave nodes.

properties:
  compatible:
    enum:
      - adi,ad2428w-master

  reg:
    maxItems: 1
    description: |
      The primary I²C address of the master node
      (called 'BASE' in the datasheet)

  clocks:
    minItems: 1

  clock-names:
    $ref: /schemas/types.yaml#/definitions/string-array
    const: sync

  clock-frequency:
    $ref: '/schemas/types.yaml#/definitions/uint32'
    enum: [44100, 48000]
    description: |
      Specifies the clock frequency in Hz to configure on the given sync clock.
      If not specified, the clock is expected to already be configured to either
      44100 or 48000 Hz.

  interrupts:
    maxItems: 1

  adi,upstream-slot-size:
    description: The size for upstream slots
    allOf:
      - $ref: '/schemas/types.yaml#/definitions/uint32'
      - enum: [8, 12, 16, 20, 24, 28, 32]

  adi,downstream-slot-size:
    description: The size for downstream slots
    allOf:
      - $ref: '/schemas/types.yaml#/definitions/uint32'
      - enum: [8, 12, 16, 20, 24, 28, 32]

  adi,tdm-mode:
    description: The TDM mode to use
    allOf:
      - $ref: '/schemas/types.yaml#/definitions/uint32'
      - enum: [2, 4, 8, 12, 16, 20, 24, 32]

  adi,tdm-slot-size:
    description: The TDM slot size to use
    allOf:
      - $ref: '/schemas/types.yaml#/definitions/uint32'
      - enum: [16, 32]

  adi,alternate-upstream-slot-format:
    description: Selects the alternate format for upstream slots
    type: boolean

  adi,alternate-downstream-slot-format:
    description: Selects the alternate format for downstream slots
    type: boolean

  adi,invert-xcvr-b:
    description: Inverts the LVDS XCVR B data line
    type: boolean

  adi,alternating-sync:
    description: Drives the SYNC pin for I²S operation
    type: boolean

  adi,invert-sync:
    description: Invert the SYNC pin
    type: boolean

  adi,early-sync:
    description: |
      Make the SYNC pin change one cycle before the first slot is transmitted
    type: boolean

  adi,spread-a2b-clock:
    description: Enables spread spectrum mode for A²B bus clocks
    type: boolean

  adi,spread-a2b-i2s-clock:
    description: Enables spread spectrum mode for both A²B and I²S clocks
    type: boolean

  adi,spread-spectrum-high:
    description: Selects high spectrum spreading mode
    type: boolean

required:
  - compatible
  - reg
  - clocks
  - clock-names
  - adi,upstream-slot-size
  - adi,downstream-slot-size
  - adi,tdm-mode
  - adi,tdm-slot-size

examples:
  - |
    sync_clock: clock {
      compatible = "fixed-clock";
      #clock-cells = <0>;
      clock-frequency  = <48000>;
    };

    i2c-bus {
      ad2428w-master@68 {
        reg = <0x68>;
        compatible = "adi,ad2428w-master";
        clocks = <&sync_clock>;
        clock-names = "sync";

        adi,upstream-slot-size = <24>;
        adi,downstream-slot-size = <24>;
        adi,tdm-mode = <2>;
        adi,tdm-slot-size = <32>;
        adi,alternating-sync;
        adi,early-sync;

        codec {
          compatible = "adi,ad2428w-codec";
          #sound-dai-cells = <1>;
        };

        clock {
          compatible = "adi,ad2428w-clk";
          #clock-cells = <1>;
          clock-output-names = "master-clk1", "master-clk2";
        };

        nodes {
          #address-cells = <1>;
          #size-cells = <0>;

          node@0 {
            compatible = "adi,ad2428w-slave";
            reg = <0>;

            adi,alternating-sync;
            adi,early-sync;
            adi,invert-sync;
            adi,tdm-mode = <8>;
            adi,tdm-slot-size = <32>;

            downstream {
              rx-slots = <2 3 6 7 8 9>;
              #tx-slots = <4>;
              #forward-slots = <6>;
            };

            upstream {
              rx-slots = <0 1 6 7 8 9>;
              #tx-slots = <4>;
              #forward-slots = <6>;
            };

            a2bgpio: gpio {
              compatible = "adi,ad2428w-gpio";
              gpio-controller;
              #gpio-cells = <2>;

              gpio-over-distance {
                #address-cells = <1>;
                #size-cells = <0>;

                pin@0 {
                  reg = <0>;
                  adi,virtual-port-mask = <0x01>;
                };
              };
            };

            i2c {
              compatible = "adi,ad2428w-i2c";
              clock-frequency = <400000>;
              #address-cells = <1>;
              #size-cells = <0>;

              // I²C client devices located on the remote side
              eeprom-top@52 {
                reg = <0x52>;
                compatible = "atmel,24c02";
                read-only;
              };
            };

            a2bclk: clock {
              compatible = "adi,ad2428w-clk";
              #clock-cells = <1>;
              clock-output-names = "node0-clk1", "node0-clk2";
            };

            codec {
              compatible = "adi,ad2428w-codec";
              #sound-dai-cells = <1>;
              adi,pdm-highpass-filter;
            };
          };
        };
      };
    };
```
