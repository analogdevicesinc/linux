## Documentation/devicetree/bindings/media/i2c/maxim,max96724.yaml
```yaml
# SPDX-License-Identifier: (GPL-2.0-only OR BSD-2-Clause)
%YAML 1.2
---
$id: http://devicetree.org/schemas/media/i2c/maxim,max96724.yaml#
$schema: http://devicetree.org/meta-schemas/core.yaml#

title: Maxim MAX96724 GMSL deserializer chip

maintainers:
  - Laurentiu Palcu <laurentiu.palcu@oss.nxp.com>

description: |
  The MAX96724/F/R deserializer converts four GMSL2/1 inputs to 1, 2, or 4 MIPI D-PHY or C-PHY
  outputs. Up to four remotely located sensors can be supported using industry-standard coax or
  STP interconnects.

properties:
  compatible:
    enum:
      - maxim,max96724

  '#address-cells':
    const: 1

  '#size-cells':
    const: 0

  reg:
    description: I2C device address
    maxItems: 1

  ports:
    $ref: /schemas/graph.yaml#/properties/ports

    patternProperties:
      "^port@[0-3]$":
        $ref: /schemas/graph.yaml#/properties/port
        description: |
          Internal video pipe which connects the deserializer to a serializer and outputs to a
          certain CSI-2 port.
        unevaluatedProperties: false

        properties:
          endpoint@0:
            description: Connection to a serializer GMSL link output.

          endpoint@1:
            description: Connection to one of the 2 CSI-2 output ports (port@4 or port@5).

      "^port@[4-5]$":
        $ref: /schemas/graph.yaml#/$defs/port-base
        unevaluatedProperties: false
        description: CSI-2 output port

        patternProperties:
          endpoint@[0-3]:
            $ref: /schemas/graph.yaml#/properties/endpoint
            description: Connection to video pipe 0-3

        properties:
          endpoint@4:
            $ref: /schemas/media/video-interfaces.yaml#
            description: Connection to the remote CSI-2 controller
            unevaluatedProperties: false

            properties:
              data-lanes: true

            required:
              - data-lanes

        allOf:
          - anyOf:
              - required:
                  - endpoint@0
              - required:
                  - endpoint@1
              - required:
                  - endpoint@2
              - required:
                  - endpoint@3
          - required:
              - endpoint@4

    anyOf:
      - required:
          - port@4
      - required:
          - port@5

  i2c-mux:
    description: |
      Each GMSL link is modelled as a child bus of an i2c bus multiplexer/switch as the device
      extends the I2C bus to the remote deserializer chip.
    type: object
    $ref: /schemas/i2c/i2c-mux.yaml#
    unevaluatedProperties: false

    patternProperties:
      '^i2c@[0-3]$':
        type: object
        description: |
          Child node of the I2C bus multiplexer that represents a GMSL link to a serializer
          device. The MAX96724 chip supports up to 4 GMSL links.

        properties:
          reg:
            description: The index of the GMSL channel.
            maxItems: 1

          '#address-cells':
            const: 1

          '#size-cells':
            const: 0

        required:
          - reg
          - '#address-cells'
          - '#size-cells'

        additionalProperties: true

required:
  - compatible
  - '#address-cells'
  - '#size-cells'
  - reg
  - ports
  - i2c-mux

additionalProperties: false

examples:
  # example for using just one camera with output on CSI port A
  - |
    i2c@42530000 {
      #address-cells = <1>;
      #size-cells = <0>;

      reg = <0x42530000 0x10000>;

      max96724_1@27 {
        compatible = "maxim,max96724";
        reg = <0x27>;
        status = "okay";

        #address-cells = <1>;
        #size-cells = <0>;

        ports {
          #address-cells = <1>;
          #size-cells = <0>;

          port@0 {
            #address-cells = <1>;
            #size-cells = <0>;
            reg = <0>;

            max96724_1_gmsl_a_in: endpoint@0 {
              reg = <0>;
              remote-endpoint = <&mx95mbcam_1_gmsl_a_out>;
            };

            max96724_1_pipe_0_out: endpoint@1 {
              reg = <1>;
              remote-endpoint = <&max96724_1_csi_0_in_0>;
            };
          };

          port@4 {
            reg = <4>;
            #address-cells = <1>;
            #size-cells = <0>;

            max96724_1_csi_0_in_0: endpoint@0 {
              reg = <0>;
              remote-endpoint = <&max96724_1_pipe_0_out>;
            };

            max96724_1_csi_0_out: endpoint@4 {
              reg = <4>;
              data-lanes = <1 2 3 4>;
              remote-endpoint = <&mipi_csi0_ep>;
            };
          };
        };

        i2c-mux {
          #address-cells = <1>;
          #size-cells = <0>;

          i2c@0 {
            #address-cells = <1>;
            #size-cells = <0>;
            reg = <0>;

            camera@40 {
              compatible = "nxp,mx95mbcam";
              reg = <0x40>;
              nxp,camera_sensor_reset_pin = <8>;
              nxp,camera_sensor_clock_pin = <4>;

              port {
                mx95mbcam_1_gmsl_a_out: endpoint {
                  remote-endpoint = <&max96724_1_gmsl_a_in>;
                };
              };
            };
          };
        };
      };
    };

  # example for using 4 cameras with output on CSI port A
  - |
    i2c@42530000 {
      #address-cells = <1>;
      #size-cells = <0>;

      reg = <0x42530000 0x10000>;

      max96724_2@27 {
        compatible = "maxim,max96724";
        reg = <0x27>;
        status = "okay";

        #address-cells = <1>;
        #size-cells = <0>;

        ports {
          #address-cells = <1>;
          #size-cells = <0>;

          port@0 {
            #address-cells = <1>;
            #size-cells = <0>;
            reg = <0>;

            max96724_2_gmsl_a_in: endpoint@0 {
              reg = <0>;
              remote-endpoint = <&mx95mbcam_2_gmsl_a_out>;
            };

            max96724_2_pipe_0_out: endpoint@1 {
              reg = <1>;
              remote-endpoint = <&max96724_2_csi_0_in_0>;
            };
          };

          port@1 {
            #address-cells = <1>;
            #size-cells = <0>;
            reg = <1>;

            max96724_2_gmsl_b_in: endpoint@0 {
              reg = <0>;
              remote-endpoint = <&mx95mbcam_2_gmsl_b_out>;
            };

            max96724_2_pipe_1_out: endpoint@1 {
              reg = <1>;
              remote-endpoint = <&max96724_2_csi_0_in_1>;
            };
          };

          port@2 {
            #address-cells = <1>;
            #size-cells = <0>;
            reg = <2>;

            max96724_2_gmsl_c_in: endpoint@0 {
              reg = <0>;
              remote-endpoint = <&mx95mbcam_2_gmsl_c_out>;
            };

            max96724_2_pipe_2_out: endpoint@1 {
              reg = <1>;
              remote-endpoint = <&max96724_2_csi_0_in_2>;
            };
          };

          port@3 {
            #address-cells = <1>;
            #size-cells = <0>;
            reg = <3>;

            max96724_2_gmsl_d_in: endpoint@0 {
              reg = <0>;
              remote-endpoint = <&mx95mbcam_2_gmsl_d_out>;
            };

            max96724_2_pipe_3_out: endpoint@1 {
              reg = <1>;
              remote-endpoint = <&max96724_2_csi_0_in_3>;
            };
          };

          port@4 {
            reg = <4>;
            #address-cells = <1>;
            #size-cells = <0>;

            max96724_2_csi_0_in_0: endpoint@0 {
              reg = <0>;
              remote-endpoint = <&max96724_2_pipe_0_out>;
            };

            max96724_2_csi_0_in_1: endpoint@1 {
              reg = <1>;
              remote-endpoint = <&max96724_2_pipe_1_out>;
            };

            max96724_2_csi_0_in_2: endpoint@2 {
              reg = <2>;
              remote-endpoint = <&max96724_2_pipe_2_out>;
            };

            max96724_2_csi_0_in_3: endpoint@3 {
              reg = <3>;
              remote-endpoint = <&max96724_2_pipe_3_out>;
            };

            max96724_2_csi_0_out: endpoint@4 {
              reg = <4>;
              data-lanes = <1 2 3 4>;
              remote-endpoint = <&mipi_csi0_ep>;
            };
          };
        };

        i2c-mux {
          #address-cells = <1>;
          #size-cells = <0>;

          i2c@0 {
            #address-cells = <1>;
            #size-cells = <0>;
            reg = <0>;

            camera@40 {
              compatible = "nxp,mx95mbcam";
              reg = <0x40>;
              nxp,camera_sensor_reset_pin = <8>;
              nxp,camera_sensor_clock_pin = <4>;

              port {
                mx95mbcam_2_gmsl_a_out: endpoint {
                  remote-endpoint = <&max96724_2_gmsl_a_in>;
                };
              };
            };
          };

          i2c@1 {
            #address-cells = <1>;
            #size-cells = <0>;
            reg = <1>;

            camera@40 {
              compatible = "nxp,mx95mbcam";
              reg = <0x40>;
              nxp,camera_sensor_reset_pin = <8>;
              nxp,camera_sensor_clock_pin = <4>;

              port {
                mx95mbcam_2_gmsl_b_out: endpoint {
                  remote-endpoint = <&max96724_2_gmsl_b_in>;
                };
              };
            };
          };

          i2c@2 {
            #address-cells = <1>;
            #size-cells = <0>;
            reg = <2>;

            camera@40 {
              compatible = "nxp,mx95mbcam";
              reg = <0x40>;
              nxp,camera_sensor_reset_pin = <8>;
              nxp,camera_sensor_clock_pin = <4>;

              port {
                mx95mbcam_2_gmsl_c_out: endpoint {
                  remote-endpoint = <&max96724_2_gmsl_c_in>;
                };
              };
            };
          };

          i2c@3 {
            #address-cells = <1>;
            #size-cells = <0>;
            reg = <3>;

            camera@40 {
              compatible = "nxp,mx95mbcam";
              reg = <0x40>;
              nxp,camera_sensor_reset_pin = <8>;
              nxp,camera_sensor_clock_pin = <4>;

              port {
                mx95mbcam_2_gmsl_d_out: endpoint {
                  remote-endpoint = <&max96724_2_gmsl_d_in>;
                };
              };
            };
          };
        };
      };
    };
```

## Documentation/devicetree/bindings/media/i2c/maxim-deserializer.yaml
```yaml
# SPDX-License-Identifier: GPL-2.0
# Copyright (C) 2023 Analog Devices Inc.
%YAML 1.2
---
$id: http://devicetree.org/schemas/media/i2c/maxim-deserializer.yaml#
$schema: http://devicetree.org/meta-schemas/core.yaml#

title: Maxim GMSL2 Deserializer

maintainers:
  - Cosmin Tanislav <cosmin.tanislav@analog.com>

allOf:
  - $ref: /schemas/pinctrl/i2c/i2c-atr.yaml#

unevaluatedProperties: false

required:
  - '#address-cells':
  - '#size-cells'
  - reg
  - i2c-atr
  - i2c-alias-pool

properties:
  '#address-cells':
    const: 1

  '#size-cells':
    const: 0

  reg:
    description: I2C device address
    maxItems: 1

  i2c-atr:
    type: object
    additionalProperties: false

    properties:
      '#address-cells':
        const: 1

      '#size-cells':
        const: 0

    patternProperties:
      '^i2c@[0-9a-f]+$':
        unevaluatedProperties: false

        allOf:
          - $ref: /schemas/i2c/i2c-controller.yaml

patternProperties:
  '^phy@[0-9a-f]+$':
    type: object
    additionalProperties: false
    description: |
      A PHY receives data from multiple pipes.

    properties:
      maxim,alt-mem-map8:
        type: boolean
        description: Alternative memory mapping for 8bit types.

      maxim,alt-mem-map10:
        type: boolean
        description: Alternative memory mapping for 8bit types.

      maxim,alt-mem-map12:
        type: boolean
        description: Alternative memory mapping for 10bit types.

  '^pipe@[0-9a-f]+$':
    type: object
    additionalProperties: false
    description: |
      A pipe can carry multiple video streams with each stream having
      different virtual channels and data types.

      A pipe operates in one of the following modes:
       - Mode 1: Streams with the same bpp of up to 24 bpp.
       - Mode 2: Streams with 16, 14, 12, 10, 8 bpp, with streams less than
                 16 bpp being zero-padded.
       - Mode 3: Streams with two different bpp rates, one being double
                 the other, with the highest possible bpp being 24.
      Only modes 1 and 3 carry data at full bandwidth.

      Each pipe receives data from one link.

      Each pipe outputs data to a PHY, and multiple pipes can output data
      to the same PHY.

    properties:
      reg:
        description: The pipe id.
        maxItems: 1

      maxim,phy-id:
        $ref: /schemas/types.yaml#/definitions/uint32
        description: |
          The PHY id to which this pipe will output its data.
          The default PHY id will be the same as the pipe id.

      maxim,link-id:
        $ref: /schemas/types.yaml#/definitions/uint32
        description: |
          The link id from which the pipe will receive its data.
          The default link id will be the same as the pipe id.
          Some chips might not support using a different link than the default.

      maxim,stream-id:
        $ref: /schemas/types.yaml#/definitions/uint32
        description: |
          The stream id which the pipe will use to receive its data.
          The default stream id will be the same as the pipe id.
        min: 0
        max: 3

  '^channel@[0-9a-f]+$':
    type: object
    additionalProperties: false
    description: |
      A channel can carry a single video stream with a specific virtual
      channel and data type.
      Each channel outputs data to a pipe, and multiple channels can output
      data to the same pipe.

    properties:
      reg:
        description: The channel id.
        maxItems: 1

      maxim,pipe-id:
        $ref: /schemas/types.yaml#/definitions/uint32
        description: |
        The pipe id to output data to.
        The default pipe id will be the same as the channel id.

      maxim,phy-id:
        $ref: /schemas/types.yaml#/definitions/uint32
        description: |
          The PHY id to which this channel will output its data.
          The default PHY id will be the same as the pipe's PHY id.

      maxim,src-vc-id:
        $ref: /schemas/types.yaml#/definitions/uint32
        description: The source virtual channel id.
        default: 0
        min: 0
        max: 3

      maxim,dst-vc-id:
        $ref: /schemas/types.yaml#/definitions/uint32
        description: |
          The destination virtual channel id.
          The default destination virtual channel id will be the same as the
          channel id.
        min: 0
        max: 3

      ports:
        $ref: /schemas/graph.yaml#/properties/ports
        properties:
          port@0:
            $ref: /schemas/graph.yaml#/$defs/port-base
            description: Output port

            properties:
              endpoint:
                $ref: /schemas/media/video-interfaces.yaml#
                unevaluatedProperties: false

          port@1:
            $ref: /schemas/graph.yaml#/$defs/port-base
            description: Input port

            properties:
              endpoint:
                $ref: /schemas/media/video-interfaces.yaml#
                unevaluatedProperties: false

        required:
          - port@0
          - port@1
```
