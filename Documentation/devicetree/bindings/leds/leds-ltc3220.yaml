## Documentation/devicetree/bindings/leds/leds-ltc3220.yaml
```yaml
# SPDX-License-Identifier: (GPL-2.0-only OR BSD-2-Clause)
%YAML 1.2
---
$id: http://devicetree.org/schemas/leds/leds-ltc3220.yaml#
$schema: http://devicetree.org/meta-schemas/core.yaml#

title: Analog Devices LTC3220 LED Drivers

maintainers:
  - Edelweise Escala <edelweise.escala@analog.com>

description: Bindings for the Analog Devices LTC3220 18 channel LED Drivers.

  For more product information please see the link below
    https://www.analog.com/en/products/ltc3220.html

properties:
  compatible:
    enum:
      - adi,ltc3220
      - adi,ltc3220-1

  reg:
    maxItems: 1

  '#address-cells':
    const: 1

  '#size-cells':
    const: 0

  reset-gpios:
    maxItems: 1
    description: GPIO attached to the chip's reset pin

  adi,force-cpo-level:
    $ref: /schemas/types.yaml#/definitions/string
    description: Forces the Charge Pump Output to a specified multiplier.
    enum:
      - "0" # Auto(default) - Automatically selects optimal charge pump mode
      - "1.5"
      - "2"
      - "1"
    default: "0"

  adi,quick-write:
    type: boolean
    description: If present, LED 1 output becomes a master control that
      simultaneously updates all 18 LED outputs using the hardware's quick-write
      mode. When enabled, led@1 must be defined in the device tree to provide
      the control interface, even if no physical LED is connected to the D1
      output pin. When disabled or not present, LED 1 operates as a normal
      independent LED output.

patternProperties:
  "^led@([1-9]|1[0-8])$":
    type: object
    $ref: /schemas/leds/common.yaml#
    unevaluatedProperties: false
    properties:
      reg:
        description: Output channel for the LED (1-18 maps to LED outputs D1-D18).
        minimum: 1
        maximum: 18

    required:
      - reg

required:
  - compatible
  - reg

additionalProperties: false

examples:
  - |
    #include <dt-bindings/gpio/gpio.h>
    #include <dt-bindings/leds/common.h>

    i2c {
       #address-cells = <1>;
       #size-cells = <0>;

       led-controller@1c {
             compatible = "adi,ltc3220";
             reg = <0x1c>;
             #address-cells = <1>;
             #size-cells = <0>;
             reset-gpios = <&gpio 17 GPIO_ACTIVE_LOW>;
             adi,force-cpo-level = "0";
             adi,quick-write;

             led@1 {
                 reg = <1>;
                 function = LED_FUNCTION_INDICATOR;
                 function-enumerator = <1>;
             };

             led@2 {
                 reg = <2>;
                 function = LED_FUNCTION_INDICATOR;
                 function-enumerator = <2>;
             };

             led@3 {
                 reg = <3>;
                 function = LED_FUNCTION_INDICATOR;
                 function-enumerator = <3>;
             };

             led@4 {
                 reg = <4>;
                 function = LED_FUNCTION_INDICATOR;
                 function-enumerator = <4>;
             };

             led@5 {
                 reg = <5>;
                 function = LED_FUNCTION_INDICATOR;
                 function-enumerator = <5>;
             };

             led@6 {
                 reg = <6>;
                 function = LED_FUNCTION_INDICATOR;
                 function-enumerator = <6>;
             };
        };
    };

...
```

## Documentation/devicetree/bindings/media/adi,adi-axi-fb.yaml
```yaml
# SPDX-License-Identifier: GPL-2.0
# Copyright 2019 Analog Devices Inc.
%YAML 1.2
---
$id: http://devicetree.org/schemas/bindings/media/adi,adi-fb.yaml#
$schema: http://devicetree.org/meta-schemas/core.yaml#

title: Analog Devices AXI Frame Buffer Device Tree Bindings

maintainers:
  - Bogdan Togorean <bogdan.togorean@analog.com>

description: |
  Bindings for the Analog Devices Frame Buffer core. Spefications of the
  core can be found in:
  https://wiki.analog.com/resources/fpga/docs/axi_dmac
  First example is used when FB is stored in PS RAM and second for PL RAM.

properties:
  compatible:
    enum:
        - adi,axi-framebuffer-1.00.a

  memory-region:
    description:
      Phandle to a node used to specify reserved memory for video frame buffers.
      If not used, frame buffer address and size should be specified using reg
      property.
    allOf:
      - $ref: /schemas/types.yaml#/definitions/phandle-array

  reg:
    minItems: 2
    maxItems: 3

  adi,flock-resolution:
    description:
      (u32, u32) tuple setting resolution of input/output image in pixels.
      <horizontal> <vertical>
    allOf:
      - $ref: /schemas/types.yaml#/definitions/uint32-array
    minItems: 2
    maxItems: 2

  adi,flock-mode:
    description:
      Select operating mode of the framebuffer.
      0 -> Frame rate conversion mode
      1 -> Output delay mode
    enum: [ 0, 1 ]
    maxItems: 1

  adi,flock-frm-buf-nr:
    description:
      The total number of video frame buffers.
      Related to NUM_BUF synthesys parameter.
    minimum: 3
    maxItems: 1

  adi,flock-distance:
    description:
      Applicable only in output delay mode. Set the output delay in frames.
      Should be set in interval 0 to flock,frm-buf-nr - 2
    minimum: 0
    maxItems: 1

  adi,flock-line-stride:
    description:
      The number of bytes between the start of one row and the next row.
      Needs to be aligned to the bus width.
    maxItems: 1

  adi,flock-frm-stride:
    description:
      Stride of consecutive frames in memory in bytes. Should be at least the
      size of one frame.
    maxItems: 1

  adi,flock-dwidth:
    description:
      Represent the number of bytes per pixel according to used color space.
    enum: [ 1, 2, 4 ]
    maxItems: 1

required:
  - compatible
  - reg

examples:
  - |
    adi-fb {
            compatible = "adi,axi-framebuffer-1.00.a";
            memory-region = <&reserved>;
            reg = <0x43000000 0x1000>, <0x43c20000 0x1000>;
            reg-names = "tx_dma", "rx_dma";
            adi,flock-resolution = <1920>, <1080>;
            adi,flock-distance = <0>;
            adi,flock-mode = <0>;
            adi,flock-dwidth = <4>;
            adi,flock-frm-buf-nr = <3>;
    };

    reserved-memory {
            #address-cells = <1>;
            #size-cells = <1>;
            ranges;

            reserved: buffer@0 {
                    no-map;
                    reg = <0x1C000000 0x2000000>;
            };
    };

  - |
    adi-fb {
            compatible = "adi,axi-framebuffer-1.00.a";
            reg = <0x1C000000 0x2000>, <0x43000000 0x1000>, <0x43c20000 0x1000>;
            reg-names = "fb_mem", "tx_dma", "rx_dma";
            adi,flock-resolution = <1920>, <1080>;
            adi,flock-distance = <0>;
            adi,flock-mode = <0>;
            adi,flock-dwidth = <4>;
            adi,flock-frm-buf-nr = <3>;
    };
```

## Documentation/devicetree/bindings/media/i2c/adi,addi9036.yaml
```yaml
# SPDX-License-Identifier: GPL-2.0
# Copyright 2019 Analog Devices Inc.
%YAML 1.2
---
$id: http://devicetree.org/schemas/bindings/media/i2c/adi,addi9036.yaml#
$schema: http://devicetree.org/meta-schemas/core.yaml#

title: Analog Devices ADDI9036 CCD TOF Signal Processor

maintainers:
  - Bogdan Togorean <bogdan.togorean@analog.com>

description: |
  Bindings for the Analog Devices ADDI9036 CCD TOF Signal Processor with
  Programmable Timing and V-Driver driver. This driver integrates in V4L2
  subsystem.
  https://www.analog.com/media/en/technical-documentation/data-sheets/ADDI9036.pdf

properties:
  compatible:
    enum:
        - adi,addi9036

  reset-gpios:
    description: Phandle to the GPIO pin used to control reset signal
    maxItems: 1

  port:
    type: object
    description: |
      A port node with endpoint definitions as defined in
      Documentation/devicetree/bindings/media/video-interfaces.txt. This is the
      output endpint that should be connected to CSI input.

required:
  - compatible
  - reg
  - reset-gpios
  - port

examples:
  - |
    addi9036_camera@64 {
        compatible = "adi,addi9036";
        reg = <0x64>;

        reset-gpios = <&gpio 41 1>;

        port {
                addi9036_ep: endpoint {
                        remote-endpoint = <&csi1_ep>;
                        clock-lanes = <0>;
                        data-lanes = <1 2>;
                };
        };
    };
```

## Documentation/devicetree/bindings/media/i2c/maxim,max96717-pinctrl.yaml
```yaml
# SPDX-License-Identifier: (GPL-2.0-only OR BSD-2-Clause)
# Copyright (C) 2025 Analog Devices Inc.
%YAML 1.2
---
$id: http://devicetree.org/schemas/media/i2c/maxim,max96717-pinctrl.yaml#
$schema: http://devicetree.org/meta-schemas/core.yaml#

title: Maxim GMSL2 Serializer Pinctrl

maintainers:
  - Cosmin Tanislav <cosmin.tanislav@analog.com>

allOf:
  - $ref: /schemas/pinctrl/pincfg-node.yaml#
  - $ref: /schemas/pinctrl/pinmux-node.yaml#

unevaluatedProperties: false

properties:
  function: true
  pins: true
  drive-open-drain: true
  drive-push-pull: true
  bias-disable: true
  bias-pull-up: true
  bias-pull-down: true
  output-disable: true
  output-enable: true
  output-low: true
  output-high: true
  slew-rate: true
  input-enable: true

  maxim,jitter-compensation:
    type: boolean
    description: Enables jitter compensation.

  maxim,gmsl-tx:
    type: boolean
    description: Enable transmitting pin value to GMSL link.

  maxim,gmsl-rx:
    type: boolean
    description: Enable receiving pin value from GMSL link.

  maxim,gmsl-tx-id:
    $ref: /schemas/types.yaml#/definitions/uint32
    description:
      Identifier used while transmitting value to GMSL link.
      Default value matches the pin number.
    minimum: 0
    maximum: 31

  maxim,gmsl-rx-id:
    $ref: /schemas/types.yaml#/definitions/uint32
    description:
      Identifier used while receiving value from GMSL link.
      Default value matches the pin number.
    minimum: 0
    maximum: 31

  maxim,rclkout-clock:
    $ref: /schemas/types.yaml#/definitions/uint32
    description: |
      Clock value.
      0 - XTAL / 1 = 25MHz
      1 - XTAL / 2 = 12.5MHz
      2 - XTAL / 4 = 6.25MHz
      3 - Reference PLL output
    minimum: 0
    maximum: 3
```

## Documentation/devicetree/bindings/media/i2c/maxim,max96717.yaml
```yaml
# SPDX-License-Identifier: GPL-2.0
# Copyright (C) 2023 Analog Devices Inc.
%YAML 1.2
---
$id: http://devicetree.org/schemas/media/i2c/maxim,max96717.yaml#
$schema: http://devicetree.org/meta-schemas/core.yaml#

title: Maxim MAX96717 and MAX9295A GMSL2 Serializer

maintainers:
  - Cosmin Tanislav <cosmin.tanislav@analog.com>

description: |
  The MAX96717 and MAX9295A are serializers that receive video on an
  MIPI CSI-2 interface and outputs it on a GMSL2 link.

unevaluatedProperties: false

properties:
  compatible:
    const: maxim,max96717
    const: maxim,max9295a

  gpio-controller: true

  '#gpio-cells':
    const: 2

  i2c-alias-pool:
    maxItems: 1

  i2c-atr:
    patternProperties:
      '^i2c@[0-9a-f]+$':
        properties:
          reg:
            items:
              max: 0

required:
  - compatible
  - gpio-controller
  - '#gpio-cells'

additionalProperties:
  anyOf:
    - type: object
      allOf:
        - $ref: /schemas/media/i2c/maxim,max96717-pinctrl.yaml#

      unevaluatedProperties: false

    - type: object
      additionalProperties:
        type: object
        allOf:
          - $ref: /schemas/media/i2c/maxim,max96717-pinctrl.yaml#

        unevaluatedProperties: false

allOf:
  - $ref: maxim-serializer.yaml#
  - if:
      properties:
        compatible:
          contains:
            const: maxim,max96717
  - then:
      patternProperties:
        '^pipe@[0-9a-f]+$'::
          properties:
            reg:
              items:
                min: 0
                max: 0
            maxim,phy-id:
              min: 0
              max: 0
        '^channel@[0-9a-f]+$':
          properties:
            maxim,pipe-id:
              min: 0
              max: 0
            maxim,vc-id:
              min: 0
              max: 15

  - if:
      properties:
        compatible:
          contains:
            const: maxim,max9295a
  - then:
      patternProperties:
        '^pipe@[0-9a-f]+$'::
          properties:
            reg:
              items:
                min: 0
                max: 3
            maxim,phy-id:
              min: 0
              max: 0
        '^channel@[0-9a-f]+$':
          properties:
            maxim,pipe-id:
              min: 0
              max: 3
            maxim,vc-id:
              min: 0
              max: 3
```
