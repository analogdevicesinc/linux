## Documentation/devicetree/bindings/mfd/adi,ad242x-slave.yaml
```yaml
# SPDX-License-Identifier: (GPL-2.0 OR BSD-2-Clause)
%YAML 1.2
---
$id: "http://devicetree.org/schemas/mfd/adi,ad242x-slave.yaml#"
$schema: "http://devicetree.org/meta-schemas/core.yaml#"

title: Analog Devices AD242x A²B slave node transceiver

maintainers:
  - Daniel Mack <daniel@zonque.org>

description: |
  AD242x slave nodes are connected to the master node through a daisy-chain.
  Modules of this type must be listed under the 'nodes' property of the master
  DT schema.

properties:
  compatible:
    enum:
      - adi,ad2428w-slave

  adi,tdm-mode:
    description: The TDM mode to use
    allOf:
      - $ref: '/schemas/types.yaml#/definitions/uint32'
      - enum: [2, 4, 8, 12, 16, 20, 24, 32]

  adi,tdm-slot-size:
    description: The TDM slot size to use
    allOf:
      - $ref: '/schemas/types.yaml#/definitions/uint32'
      - enum: [16, 32]

  adi,alternating-sync:
    description: Drives the SYNC pin for I²S operation
    type: boolean

  adi,invert-sync:
    description: Invert the SYNC pin
    type: boolean

  adi,early-sync:
    description: |
      Make the SYNC pin change one cycle before the first slot is transmitted
    type: boolean

  adi,spread-a2b-clock:
    description: Enables spread spectrum mode for A²B bus clocks
    type: boolean

  adi,spread-a2b-i2s-clock:
    description: Enables spread spectrum mode for both A²B and I²S clocks
    type: boolean

  adi,spread-spectrum-high:
    description: Selects high spectrum spreading mode
    type: boolean

  upstream:
    type: object
    properties:
      rx-slots:
        $ref: '/schemas/types.yaml#/definitions/uint32'
        description: |
          A bitmask that describes the slots that are received by the
          transceiver from the upstream (A) side and put into its TX output
          framebuffers. If not specified, an empty bitmask is assumed.

      '#tx-slots':
        $ref: '/schemas/types.yaml#/definitions/uint32'
        description: |
          The number of slots this transceiver contributes to the upstream
          traffic from its RX input frame buffer

      '#forward-slots':
        $ref: '/schemas/types.yaml#/definitions/uint32'
        description: |
          The number of slots this transceiver forwards from the upstream side
          to the downstream side.

  downstream:
    type: object
    properties:
      rx-slots:
        $ref: '/schemas/types.yaml#/definitions/uint32'
        description: |
          A bitmask that describes the slots that are received by the
          transceiver from the downstream (B) side and put into its TX output
          framebuffers. If not specified, an empty bitmask is assumed.

      '#tx-slots':
        $ref: '/schemas/types.yaml#/definitions/uint32'
        description: |
          The number of slots this transceiver contributes to the downstream
          traffic from its RX input frame buffer

      '#forward-slots':
        $ref: '/schemas/types.yaml#/definitions/uint32'
        description: |
          The number of slots this transceiver forwards from the downstream side
          to the upstream side.

required:
  - compatible
  - adi,tdm-mode
  - adi,tdm-slot-size
  - upstream
  - downstream
```

## Documentation/devicetree/bindings/mfd/adi,ltc4283.yaml
```yaml
%YAML 1.2
---
$id: http://devicetree.org/schemas/mfd/adi,ltc4282.yaml#
$schema: http://devicetree.org/meta-schemas/core.yaml#

title: LTC4282 I2C Negative Voltage Hot Swap Controller

maintainers:
  - Nuno Sá <nuno.sa@analog.com>

description: |
  The LTC4283 negative voltage hot swap controller drives an external N-channel
  MOSFET to allow a board to be safely inserted and removed from a live
  backplane.

  https://www.analog.com/media/en/technical-documentation/data-sheets/ltc4283.pdf

properties:
  compatible:
    enum:
      - adi,ltc4283

  reg:
    maxItems: 1

required:
  - compatible
  - reg
```

## Documentation/devicetree/bindings/mfd/adi,max42500.yaml
```yaml
# SPDX-License-Identifier: (GPL-2.0-only OR BSD-2-Clause)
%YAML 1.2
---
$id: http://devicetree.org/schemas/hwmon/adi,max42500.yaml#
$schema: http://devicetree.org/meta-schemas/core.yaml#

title: Analog Devices MAX42500 Industrial Power System Monitor

maintainers:
  - Kent Libetario <Kent.Libetario@analog.com>

description: |
  Analog Devices MAX42500 Industrial Power System Monitor Family
  https://www.analog.com/media/en/technical-documentation/data-sheets/max42500.pdf

properties:
  compatible:
    enum:
      - adi,max42500
  reg:
    maxItems: 1

  poweroff-gpios:
    description:
      This property sets the GPIO as output. Then used to control the power and
      mode state of the device. This can be enabled optionally to control the
      state of comparators in the voltage monitoring and/or trigger timestamp
      recording in the flexible power sequence recording functions. Check the
      state transition conditions in datasheet for more information.
    maxItems: 1

  sleepoff-gpios:
    description:
      This property sets the GPIO as output. Then used to control the power and
      mode state of the device. This can be enabled and masked optionally to
      control the state of comparators in the voltage monitoring and/or trigger
      timestamp recording in the flexible power sequence recording functions.
      Check the state transition conditions in datasheet for more information.
    maxItems: 1

required:
  - compatible
  - reg

additionalProperties: false

examples:
  - |
    #include <dt-bindings/gpio/gpio.h>
    i2c {
        #address-cells = <1>;
        #size-cells = <0>;

        hwmon@28 {
            compatible = "adi,max42500";
            reg = <0x28>;
        };
    };
```

## Documentation/devicetree/bindings/mfd/adi,max77658.yaml
```yaml
# SPDX-License-Identifier: GPL-2.0-only OR BSD-2-Clause
%YAML 1.2
---
$id: http://devicetree.org/schemas/mfd/adi,max77658.yaml#
$schema: http://devicetree.org/meta-schemas/core.yaml#

title: MAX77643/54/58/59 PMIC from ADI

maintainers:
  - Nurettin Bolucu <Nurettin.Bolucu@analog.com>
  - Zeynep Arslanbenzer <Zeynep.Arslanbenzer@analog.com>

description: |
  MAX77643, MAX77654, MAX77658 and MAX77659 devices are a family of ADI PMICs
  providing battery charging and power supply solutions for
  low-power applications.

  MAX77643 is a Power Management IC with 1 LDO regulator.

  MAX77654 is a Power Management IC with 2 LDO regulators and 1 charger.

  MAX77658 is a Power Management IC with 2 LDO regulators, 1 charger
  and 1 fuel gauge.

  MAX77659 is a Power Management IC with 1 LDO regulator and 1 charger.

properties:
  compatible:
    enum:
      - adi,max77643
      - adi,max77654
      - adi,max77658
      - adi,max77659

  reg:
    items:
      - enum: [0x40, 0x48]

  interrupts:
    maxItems: 1

  charger:
    $ref: /schemas/power/supply/max77650-charger.yaml

  regulators:
    type: object

    description:
      The regulators is represented as a sub-node of the PMIC node on the device tree.

    patternProperties:
      "^LDO[01]$":
        type: object
        $ref: /schemas/regulator/regulator.yaml
        additionalProperties: false
        description:
          LDO regulator

        properties:
          regulator-always-on: true
          regulator-boot-on: true

    additionalProperties: false

allOf:
  - if:
      properties:
        compatible:
          contains:
            enum:
              - adi,max77643
              - adi,max77654
              - adi,max77658

    then:
      properties:
        reg:
          items:
            - const: 0x48

    else:
      properties:
        reg:
          items:
            - const: 0x40

required:
  - compatible
  - reg
  - interrupts

additionalProperties: false

examples:
  - |
    #include <dt-bindings/interrupt-controller/irq.h>
    i2c {
      #address-cells = <1>;
      #size-cells = <0>;
      pmic@48 {
        compatible = "adi,max77658";
        reg = <0x48>;
        interrupt-parent = <&gpio>;
        interrupts = <16 IRQ_TYPE_EDGE_FALLING>;
        charger {
          compatible = "adi,max77658-charger";
          input-voltage-min-microvolt = <4200000>;
          input-current-limit-microamp = <285000>;
        };
        regulators {
          LDO0 {
            regulator-boot-on;
            regulator-always-on;
          };
          LDO1 {
            regulator-boot-on;
            regulator-always-on;
          };
        };
      };
    };

  - |
    #include <dt-bindings/interrupt-controller/irq.h>
    i2c {
      #address-cells = <1>;
      #size-cells = <0>;
      pmic@40 {
        compatible = "adi,max77659";
        reg = <0x40>;
        interrupt-parent = <&gpio>;
        interrupts = <16 IRQ_TYPE_EDGE_FALLING>;
        charger {
          compatible = "adi,max77659-charger";
        };
        regulators {
          LDO0 {
            regulator-boot-on;
            regulator-always-on;
          };
        };
      };
    };
```

## Documentation/devicetree/bindings/mfd/fsl,qixis-cpld.yaml
```yaml
# SPDX-License-Identifier: (GPL-2.0-only OR BSD-2-Clause)
%YAML 1.2
---
$id: http://devicetree.org/schemas/mfd/fsl,qixis-cpld.yaml#
$schema: http://devicetree.org/meta-schemas/core.yaml#

title: NXP's QIXIS CPLD board management controller

maintainers:
  - Ioana Ciornei <ioana.ciornei@nxp.com>

description: |
  The board management controller found on some Layerscape boards contains
  different IP blocks like GPIO controllers, interrupt controllers, reg-muxes
  etc.

properties:
  compatible:
    enum:
      - fsl,lx2160a-qds-qixis-cpld
      - fsl,lx2160a-rdb-qixis-cpld

  reg:
    description:
      I2C device address.
    maxItems: 1

  "#address-cells":
    const: 1

  "#size-cells":
    const: 0

patternProperties:
  "^gpio(@[0-9a-f]+)?$":
    $ref: ../gpio/fsl,qixis-cpld-gpio.yaml

required:
  - "#address-cells"
  - "#size-cells"
  - compatible
  - reg

additionalProperties: false

examples:
  - |
    qixis@66 {
        compatible = "fsl,lx2160a-rdb-qixis-cpld";
        reg = <0x66>;
        #address-cells = <1>;
        #size-cells = <0>;

        sfp2_csr: gpio@19 {
            compatible = "fsl,lx2160a-rdb-qixis-cpld-gpio";
            reg = <0x19>;
            gpio-controller;
            #gpio-cells = <2>;
            gpio-line-names =
                "SFP2_TX_EN", "",
                "", "",
                "SFP2_RX_LOS", "SFP2_TX_FAULT",
                "", "SFP2_MOD_ABS";
        };
    };
```

## Documentation/devicetree/bindings/mfd/max77650.yaml
```yaml
# SPDX-License-Identifier: GPL-2.0
%YAML 1.2
---
$id: http://devicetree.org/schemas/mfd/max77650.yaml#
$schema: http://devicetree.org/meta-schemas/core.yaml#

title: MAX77650 ultra low-power PMIC from Maxim Integrated.

maintainers:
  - Bartosz Golaszewski <bgolaszewski@baylibre.com>

description: |
  MAX77650 is an ultra-low power PMIC providing battery charging and power
  supply for low-power IoT and wearable applications.

  The GPIO-controller module is represented as part of the top-level PMIC
  node. The device exposes a single GPIO line.

  For device-tree bindings of other sub-modules (regulator, power supply,
  LEDs and onkey) refer to the binding documents under the respective
  sub-system directories.

properties:
  compatible:
    enum:
      - maxim,max77650
      - adi,max77643
      - adi,max77654
      - adi,max77658
      - adi,max77659

  reg:
    description:
      I2C device address.
    items:
      - enum: [0x40, 0x48]

  interrupts:
    maxItems: 1

  interrupt-controller: true

  "#interrupt-cells":
    const: 2
    description:
      The first cell is the IRQ number, the second cell is the trigger type.

  gpio-controller: true

  "#gpio-cells":
    const: 2
    description:
      The first cell is the pin number and the second cell is used to specify
      the gpio active state.

  gpio-line-names:
    maxItems: 1
    description:
      Single string containing the name of the GPIO line.

  regulators:
    $ref: ../regulator/max77650-regulator.yaml

  charger:
    $ref: ../power/supply/max77650-charger.yaml

  leds:
    $ref: ../leds/leds-max77650.yaml

  onkey:
    $ref: ../input/max77650-onkey.yaml

allOf:
  - if:
      properties:
        compatible:
          contains:
            enum:
              - maxim,max77650
              - adi,max77643
              - adi,max77654
              - adi,max77658

    then:
      properties:
        reg:
          items:
            - const: 0x48

    else:
      properties:
        reg:
          items:
            - const: 0x40

  - if:
      properties:
        compatible:
          contains:
            enum:
              - adi,max77643
              - adi,max77654
              - adi,max77658
              - adi,max77659

    then:
      properties:
        gpio-controller: false
        "#gpio-cells": false

required:
  - compatible
  - reg
  - interrupts
  - interrupt-controller
  - "#interrupt-cells"

additionalProperties: false

examples:
  - |
    #include <dt-bindings/interrupt-controller/irq.h>
    #include <dt-bindings/input/linux-event-codes.h>
    i2c {
        #address-cells = <1>;
        #size-cells = <0>;

        pmic@48 {
            compatible = "maxim,max77650";
            reg = <0x48>;

            interrupt-controller;
            interrupt-parent = <&gpio2>;
            #interrupt-cells = <2>;
            interrupts = <3 IRQ_TYPE_LEVEL_LOW>;

            gpio-controller;
            #gpio-cells = <2>;
            gpio-line-names = "max77650-charger";

            regulators {
                compatible = "maxim,max77650-regulator";

                max77650_ldo: regulator-ldo {
                    regulator-compatible = "ldo";
                    regulator-name = "max77650-ldo";
                    regulator-min-microvolt = <1350000>;
                    regulator-max-microvolt = <2937500>;
                };

                max77650_sbb0: regulator-sbb0 {
                    regulator-compatible = "sbb0";
                    regulator-name = "max77650-sbb0";
                    regulator-min-microvolt = <800000>;
                    regulator-max-microvolt = <1587500>;
                };
            };

            charger {
                compatible = "maxim,max77650-charger";
                input-voltage-min-microvolt = <4200000>;
                input-current-limit-microamp = <285000>;
            };

            leds {
                compatible = "maxim,max77650-led";
                #address-cells = <1>;
                #size-cells = <0>;

                led@0 {
                    reg = <0>;
                    label = "blue:usr0";
                };

                led@1 {
                    reg = <1>;
                    label = "red:usr1";
                    linux,default-trigger = "heartbeat";
                };

                led@2 {
                    reg = <2>;
                    label = "green:usr2";
                };
            };

            onkey {
                compatible = "maxim,max77650-onkey";
                linux,code = <KEY_END>;
                maxim,onkey-slide;
            };
        };
    };
```
