## Documentation/devicetree/bindings/media/i2c/maxim-serializer.yaml
```yaml
# SPDX-License-Identifier: GPL-2.0
# Copyright (C) 2023 Analog Devices Inc.
%YAML 1.2
---
$id: http://devicetree.org/schemas/media/i2c/maxim-serializer.yaml#
$schema: http://devicetree.org/meta-schemas/core.yaml#

title: Maxim GMSL2 Serializer

maintainers:
  - Cosmin Tanislav <cosmin.tanislav@analog.com>

allOf:
  - $ref: /schemas/pinctrl/i2c/i2c-atr.yaml#

unevaluatedProperties: false

required:
  - '#address-cells':
  - '#size-cells'
  - reg
  - i2c-atr
  - i2c-alias-pool

properties:
  '#address-cells':
    const: 1

  '#size-cells':
    const: 0

  reg:
    description: I2C device address
    maxItems: 1

  maxim,tunnel-mode:
    type: boolean
    description: |
      Whether to use tunnel mode.
      While in tunnel mode, the device forwards all received data to the
      deserializer.

  i2c-atr:
    type: object
    additionalProperties: false

    properties:
      '#address-cells':
        const: 1

      '#size-cells':
        const: 0

    patternProperties:
      '^i2c@[0-9a-f]+$':
        unevaluatedProperties: false

        allOf:
          - $ref: /schemas/i2c/i2c-controller.yaml

patternProperties:
  '^pipe@[0-9a-f]+$':
    type: object
    additionalProperties: false
    description: |
      A pipe can carry multiple video streams with each stream having
      different virtual channels and data types.

      A pipe operates in one of the following modes:
       - Mode 1: Streams with the same bpp of up to 24 bpp.
       - Mode 2: Streams with 16, 14, 12, 10, 8 bpp, with streams less than
                 16 bpp being zero-padded.
       - Mode 3: Streams with two different bpp rates, one being double
                 the other, with the highest possible bpp being 24.
      Only modes 1 and 3 carry data at full bandwidth.

      Each pipe receives data from a PHY, and multiple pipes can receive data
      from the same PHY.

    properties:
      reg:
        description: The pipe id.
        maxItems: 1

      maxim,phy-id:
        $ref: /schemas/types.yaml#/definitions/uint32
        description: |
          The PHY id from which this pipe will receive its data.
          The default PHY id will depend on the number of pipes and PHYs.
          Eg: on a device with 4 pipes and 2 PHYs, pipe 0 and 1 will
          receive data from PHY 0, while pipes 2 and 3 will receive data
          from PHY 1.

      maxim,stream-id:
        $ref: /schemas/types.yaml#/definitions/uint32
        description: |
          The stream id which the pipe will use to transmit its frames.
          On the deserializer side, each pipe will also have a stream id
          which it will use to filter the frames.
          Multiple pipes cannot use the same stream id.
          The default stream id is the same as the pipe id.
        min: 0
        max: 3

  '^channel@[0-9a-f]+$':
    type: object
    additionalProperties: false
    description: |
      A channel can carry a single video stream with a specific virtual
      channel and data type.
      Each channel outputs data to a pipe, and multiple channels can output
      data to the same pipe.

    properties:
      reg:
        description: The channel id.
        maxItems: 1

      maxim,pipe-id:
        $ref: /schemas/types.yaml#/definitions/uint32
        description: The pipe id to output data to.

      maxim,vc-id:
        $ref: /schemas/types.yaml#/definitions/uint32
        description: The virtual channel id.
        default: 0
        min: 0
        max: 3

      ports:
        $ref: /schemas/graph.yaml#/properties/ports
        properties:
          port@0:
            $ref: /schemas/graph.yaml#/$defs/port-base
            description: Output port

            properties:
              endpoint:
                $ref: /schemas/media/video-interfaces.yaml#
                unevaluatedProperties: false

          port@1:
            $ref: /schemas/graph.yaml#/$defs/port-base
            description: Input port

            properties:
              endpoint:
                $ref: /schemas/media/video-interfaces.yaml#
                unevaluatedProperties: false

        required:
          - port@0
          - port@1
```

## Documentation/devicetree/bindings/media/i2c/nxp,mx95mbcam.yaml
```yaml
# SPDX-License-Identifier: (GPL-2.0-only OR BSD-2-Clause)
%YAML 1.2
---
$id: http://devicetree.org/schemas/media/i2c/nxp,mx95mbcam.yaml#
$schema: http://devicetree.org/meta-schemas/core.yaml#

title: NXP MX95MBCAM camera module.

maintainers:
  - Laurentiu Palcu <laurentiu.palcu@oss.nxp.com>

description: |
  The MX95MBCAM module contains an OmniVision OX03C10 camera sensor and one MAX96717 GMSL serializer
  chip that receives the data from the sensor on CSI-2 interface and serializes it for transmission
  over a GMSL2/1 link. The module needs a deserializer chip on the remote side in order to convert
  the GMSL packets to CSI-2 MIPI packets.

allOf:
  - $ref: /schemas/media/video-interface-devices.yaml#

properties:
  compatible:
    enum:
      - nxp,mx95mbcam

  reg:
    description: I2C device address
    maxItems: 1

  nxp,camera_sensor_reset_pin:
    $ref: /schemas/types.yaml#/definitions/uint32
    description: indicates the MAX96717 pin used to reset the camera sensor

  nxp,camera_sensor_clock_pin:
    $ref: /schemas/types.yaml#/definitions/uint32
    description: indicates the MAX96717 pin used to transmit the clock signal to the sensor

  orientation: true
  rotation: true

  port:
    $ref: /schemas/graph.yaml#/properties/port
    description: This the GMSL port which should point to a GMSL in port on the deserializer side.

required:
  - compatible
  - reg
  - nxp,camera_sensor_reset_pin
  - nxp,camera_sensor_clock_pin
  - port

additionalProperties: false

examples:
  - |
    i2c@42530000 {
      #address-cells = <1>;
      #size-cells = <0>;

      reg = <0x42530000 0x10000>;

      camera@40 {
        compatible = "nxp,mx95mbcam";
        reg = <0x40>;
        nxp,camera_sensor_reset_pin = <8>;
        nxp,camera_sensor_clock_pin = <4>;

        orientation = <2>;
        rotation = <0>;

        port {
          mx95mbcam_gmsl_a_out: endpoint {
            remote-endpoint = <&max96724_gmsl_a_in>;
          };
        };
      };
    };
```

## Documentation/devicetree/bindings/media/i2c/ov5640_mipi.txt
```
* Omnivision OV5640 image sensor

The Omnivision OV5640 is a 1/4" color CMOS QSXGA 5 megapixel image sensor.
All image processing functions are programmable through the SCCB interface
or embedded microcontroller.
The OV5640 supports both a digital video parallel port and a dual lane
serial MIPI port.

The OV5640 sensor supports multiple resolutions output, such as QSXGA, 1080p,
720p, VGA, QVGA. It also can support YUV422/420, YCbCr422, RGB565/555/444,
CCIR656 or raw RGB output formats.


Required Properties:
- compatible: should be "ovti,ov5640_mipi"
- clocks: reference to the csi_mclk input clock.
- clock-names: should be "csi_mclk".
- reg: I2C slave address
- csi-id: virtual channel for this sensor
- mclk: used to calculate xvclk (sensor master input clock, xvclk = mclk /10000)


Optional Properties:
- rst-gpios: reference to the GPIO connected to the resetb pin, if any.
- pwn-gpios: reference to the GPIO connected to the pwdn pin, if any.

The device node must contain one 'port' child node for its digital output
video port, in accordance with the video interface bindings defined in
Documentation/devicetree/bindings/media/video-interfaces.txt.

Please note that the default I2C slave address is 0x3c.
In case dual-camera is used, it might be necessary to change
the I2C slave address for both cameras, and disable the reset pin,
this is if the board has only one reset line for both cameras, for
example imx-8mq-evk rev B3. Also, unique csi-id is needed for each
camera. See the dual-camera example.


Example for single camera:

i2c1: i2c@30a20000 {
	ov5640_mipi: ov5640_mipi@3c {
		compatible = "ovti,ov5640_mipi";
		reg = <0x3c>;
		status = "okay";
		pinctrl-names = "default";
		pinctrl-0 = <&pinctrl_csi1_pwn>, <&pinctrl_csi_rst>;
		clocks = <&clk IMX8MQ_CLK_CLKO2_DIV>;
		clock-names = "csi_mclk";
		assigned-clocks = <&clk IMX8MQ_CLK_CLKO2_SRC>,
				  <&clk IMX8MQ_CLK_CLKO2_DIV>;
		assigned-clock-parents = <&clk IMX8MQ_SYS2_PLL_200M>;
		assigned-clock-rates = <0>, <20000000>;
		csi_id = <0>;
		pwn-gpios = <&gpio1 3 GPIO_ACTIVE_HIGH>;
		rst-gpios = <&gpio1 6 GPIO_ACTIVE_HIGH>;
		mclk = <20000000>;
		mclk_source = <0>;
		port {
			ov5640_mipi1_ep: endpoint {
				remote-endpoint = <&mipi1_sensor_ep>;
			};
		};
	};


Example for dual-camera:

	ov5640_mipi: ov5640_mipi@1c {
		compatible = "ovti,ov5640_mipi";
		reg = <0x1c>;
		status = "okay";
		pinctrl-names = "default";
		pinctrl-0 = <&pinctrl_csi1_pwn>, <&pinctrl_csi_rst>;
		clocks = <&clk IMX8MQ_CLK_CLKO2_DIV>;
		clock-names = "csi_mclk";
		assigned-clocks = <&clk IMX8MQ_CLK_CLKO2_SRC>,
				  <&clk IMX8MQ_CLK_CLKO2_DIV>;
		assigned-clock-parents = <&clk IMX8MQ_SYS2_PLL_200M>;
		assigned-clock-rates = <0>, <20000000>;
		csi_id = <0>;
		pwn-gpios = <&gpio1 3 GPIO_ACTIVE_HIGH>;
		mclk = <20000000>;
		mclk_source = <0>;
		port {
			ov5640_mipi1_ep: endpoint {
				remote-endpoint = <&mipi1_sensor_ep>;
			};
		};
	};

	ov5640_mipi2: ov5640_mipi2@2c {
		compatible = "ovti,ov5640_mipi";
		reg = <0x2c>;
		status = "okay";
		pinctrl-names = "default";
		pinctrl-0 = <&pinctrl_csi2_pwn>;
		clocks = <&clk IMX8MQ_CLK_CLKO2_DIV>;
		clock-names = "csi_mclk";
		assigned-clocks = <&clk IMX8MQ_CLK_CLKO2_SRC>,
				  <&clk IMX8MQ_CLK_CLKO2_DIV>;
		assigned-clock-parents = <&clk IMX8MQ_SYS2_PLL_200M>;
		assigned-clock-rates = <0>, <20000000>;
		csi_id = <1>;
		pwn-gpios = <&gpio1 5 GPIO_ACTIVE_HIGH>;
		mclk = <20000000>;
		mclk_source = <0>;
		port {
			ov5640_mipi2_ep: endpoint {
				remote-endpoint = <&mipi2_sensor_ep>;
			};
		};
	};
};
```

## Documentation/devicetree/bindings/media/i2c/ovti,ox03c10.yaml
```yaml
# SPDX-License-Identifier: (GPL-2.0-only OR BSD-2-Clause)
%YAML 1.2
---
$id: http://devicetree.org/schemas/media/i2c/ovti,ox03c10.yaml#
$schema: http://devicetree.org/meta-schemas/core.yaml#

title: Omnivision OX03C10 CMOS Sensor

maintainers:
  - G.N. Zhou <guoniu.zhou@nxp.com>

description: |
  The OX03C10 is a 1/26" optical format, 1920x1280 stacked-chip, 3.0
  um split-diode DCG pixel, digital high dynamic range sensor. It can
  output 24-bit HDR combined video featuring LED flicker mitigation(LFM)
  triple exposure HDR, 20-bit HDR combined video featuring LFM, and dual
  exposure staggered HDR.

allOf:
  - $ref: /schemas/media/video-interface-devices.yaml#

properties:
  compatible:
    const: ovti,ox03c10

  reg:
    maxItems: 1

  clocks:
    maxItems: 1

  fsin-gpios:
    description:
      Frame sync input. It can be driven by another sensor's VSYNC or
      from the host GPIO.
    maxItems: 1

  port:
    $ref: /schemas/graph.yaml#/properties/port
    description: Digital Output Port

    properties:
      endpoint:
        $ref: /schemas/media/video-interfaces.yaml#
        unevaluatedProperties: false

required:
  - compatible
  - reg
  - clocks
  - fsin-gpios
  - port

additionalProperties: false

examples:
  - |
      #include <dt-bindings/clock/fsl,imx95-clock.h>
      #include <dt-bindings/gpio/gpio.h

      i2c {
          #address-cells = <1>;
          #size-cells = <0>;

          camera@36 {
              compatible = "ovti,ox03c10";
	      reg = <0x36>;
	      clocks = <&serializer1>;
	      fsin-gpios = <&serializer1 0 GPIO_ACTIVE_HIGH>;

	      port {
                  ox03c10_to_mipi_csi2: endpoint {
                      remote-endpoint = <&mipi_csi2_from_ox03c10>;
		  };
	      };
	  };
      };

...
```

## Documentation/devicetree/bindings/media/i2c/ovti,ox05b1s.yaml
```yaml
# SPDX-License-Identifier: (GPL-2.0 OR BSD-2-Clause)
%YAML 1.2
---
$id: http://devicetree.org/schemas/media/i2c/ovti,ox05b1s.yaml#
$schema: http://devicetree.org/meta-schemas/core.yaml#

title: Omnivision OX05B1S Image Sensor

maintainers:
  - Mirela Rabulea <mirela.rabulea@nxp.com>

description: |-
  The Omnivision OX05B1S is a 1/2.5-Inch CMOS image sensor with an active array size
  of 2592 x 1944. It is programmable through I2C interface.
  The sensor output is available via CSI-2 serial data output.

properties:
  compatible:
    items:
      - enum:
          - ovti,ox05b1s
          - ovti,os08a20

  reg:
    maxItems: 1

  clocks:
    maxItems: 1

  clock-names:
    description: Input clock (24 MHz)
    items:
      - const: csi_mclk

  assigned-clocks:
    maxItems: 1

  assigned-clock-parents:
    maxItems: 1

  assigned-clock-rates:
    maxItems: 1

  reset-gpios:
    description: Reference to the GPIO connected to the XSHUTDOWN pin. Active low.
    maxItems: 1

  orientation: true
  rotation: true

  port:
    $ref: /schemas/graph.yaml#/$defs/port-base
    description: |
      Video output port

    properties:
      endpoint:
        $ref: /schemas/media/video-interfaces.yaml#
        unevaluatedProperties: false

        properties:
          data-lanes:
            anyOf:
              - items:
                  - const: 1
                  - const: 2
              - items:
                  - const: 1
                  - const: 2
                  - const: 3
                  - const: 4
        required:
          - data-lanes

    additionalProperties: false

required:
  - compatible
  - reg
  - port

additionalProperties: false

examples:
  - |
    #include <dt-bindings/gpio/gpio.h>

    i2c {
        #address-cells = <1>;
        #size-cells = <0>;

        ox05b1s: ox05b1s@36 {
            compatible = "ovti,ox05b1s";
            reg = <0x36>;
            reset-gpios = <&i2c3_gpio_expander_20 2 GPIO_ACTIVE_LOW>;
            orientation = <2>;
            rotation = <0>;
            status = "okay";

            port {
                ox05b1s_mipi_0_ep: endpoint {
                    remote-endpoint = <&mipi_csi0_ep>;
                    data-lanes = <1 2 3 4>;
                    clock-lanes = <0>;
                };
            };
        };
    };
...
```
