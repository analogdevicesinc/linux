## Documentation/devicetree/bindings/mmc/sdhci-adrv.txt
```
* ADRV SDHCI controller

This file documents the differences between the core properties in
Documentation/devicetree/bindings/mmc/mmc.txt and the properties used by the
sdhci-of-adi driver.

Required properties:
- compatible:		Must be "adi,dwcmshc-sdhci" for ADRV SDHCI controller
                        Must be "adi,sdhci-phy" for ADRV SDHCI PHY controller
- clocks:		Phandlers to the clock.
- clock-names:		Must be "core"
- cap-mmc-hw-reset:	Mandatory in eMMC
- enable-phy-config:	Enable PHY configuration

Optional properties:
- adi,retune-period:    Set periodic clock retune period
- adi,dcode-legacy:     Set legacy (PHY Tx delay line) data code
- adi,dcode-hs200:      Set HS200 (PHY Tx delay line) data code
- adi,dcode-hs400:      Set HS400 (PHY Tx delay line) data code

Example:

mmcclk: mmcclk {
	compatible = "fixed-clock";
	#clock-cells = <0>;
	clock-frequency = <245000000>;
};

mmc0_phy: phy@24724300 {
	compatible = "adi,sdhci-phy";
	reg = <0x24724300 0x100>;
	#phy-cells = <0>;
	adi,dcode-legacy = <0x78>;
	adi,dcode-hs200 = <0x00>;
	adi,dcode-hs400 = <0x08>;
	status = "disabled";
};

mmc0_regulator: fixed-regulator_1v8 {
	compatible = "regulator-fixed";
	regulator-name = "1V8";
	regulator-min-microvolt = <1800000>;
	regulator-max-microvolt = <1800000>;
	regulator-always-on;
	status = "disabled";
};

mmc0: mmc@24724000 {
	compatible = "adi,dwcmshc-sdhci";
	reg = <0x247243000 0x300>;
	interrupts = <GIC_SPI W_INTR_PIPED IRQ_TYPE_LEVEL_HIGH>;
	clocks = <&mmcclk>;
	clock-names = "core";
	phys = <&mmc0_phy>;
	phy-names = "phy_adi_sdhci";
	max-frequency = <196608000>;
	bus-width = <8>;
	vqmmc-supply = <&mmc0_regulator>;
	status = "disabled";
	enable-phy-config;
	disable-wp;
	non-removable;
	no-sdio;
	no-sd;
	mmc-hs200-1_8v;
	mmc-hs400-1_8v;
	mmc-hs400-enhanced-strobe;
	adi,retune-period = <3600>;
	cap-mmc-hw-reset;
	#address-cells = <1>;
	#size-cells = <0>;
};
```

## Documentation/devicetree/bindings/mtd/cadence_quadspi.txt
```
* Cadence Quad SPI controller

Required properties:
- compatible : Should be "cdns,qspi-nor".
- reg : Contains two entries, each of which is a tuple consisting of a
	physical address and length.  The first entry is the address and
	length of the controller register set.  The second entry is the
	address and length of the QSPI Controller data area.
- interrupts : Unit interrupt specifier for the controller interrupt.
- clocks : phandle to the Quad SPI clock.
- fifo-depth : Size of the data FIFO in words.

Optional properties:
- is-decoded-cs : Flag to indicate whether decoder is used or not.

Optional subnodes:
Subnodes of the Cadence Quad SPI controller are spi slave nodes with additional
custom properties:
- cdns,page-size : Size, in bytes, of the device's write page
- cdns,block-size : Size of the device's erase block
- cdns,read-delay : Delay for read capture logic, in clock cycles
- cdns,tshsl-ns : Delay in nanoseconds for the length that the master mode chip select outputs are de-asserted between transactions.
- cdns,tsd2d-ns : Delay in nanoseconds between one chip select being de-activated and the activation of another.
- cdns,tchsh-ns : Delay in nanoseconds between last bit of current transaction and deasserting the device chip select (qspi_n_ss_out).
- cdns,tslch-ns : Delay in nanoseconds between setting qspi_n_ss_out low and first bit transfer.

Example:

	qspi: spi@ff705000 {
		compatible = "cdns,qspi-nor";
		#address-cells = <1>;
		#size-cells = <0>;
		reg = <0xff705000 0x1000>,
			<0xffa00000 0x1000>;
		interrupts = <0 151 4>;
		clocks = <&qspi_clk>;
		is-decoded-cs = <1>;
		fifo-depth = <128>;

		flash0: n25q00@0 {
			...
			cdns,page-size = <256>;
			cdns,block-size = <16>;
			cdns,read-delay = <4>;
			cdns,tshsl-ns = <50>;
			cdns,tsd2d-ns = <50>;
			cdns,tchsh-ns = <4>;
			cdns,tslch-ns = <4>;
		}
	}
```

## Documentation/devicetree/bindings/mux/adi,adg2404.yaml
```yaml
# SPDX-License-Identifier: (GPL-2.0-only OR BSD-2-Clause)
%YAML 1.2
---
$id: http://devicetree.org/schemas/mux/adi,adg2404.yaml#
$schema: http://devicetree.org/meta-schemas/core.yaml#

title: Analog Devices ADG2404 4:1 multiplexer

maintainers:
  - Antoniu Miclaus <antoniu.miclaus@analog.com>

description: |
  Bindings for Analog Devices ADG2404 4:1 single-ended analog multiplexer

  The multiplexer state corresponds to the selected input channel:
  * 0: Channel S1 selected
  * 1: Channel S2 selected
  * 2: Channel S3 selected
  * 3: Channel S4 selected

allOf:
  - $ref: mux-controller.yaml#

properties:
  compatible:
    const: adi,adg2404

  a0-gpios:
    description: GPIO connected to the A0 address pin
    maxItems: 1

  a1-gpios:
    description: GPIO connected to the A1 address pin
    maxItems: 1

  en-gpios:
    description: GPIO connected to the EN (enable) pin
    maxItems: 1

  '#mux-control-cells':
    const: 0

required:
  - compatible
  - a0-gpios
  - a1-gpios
  - en-gpios
  - '#mux-control-cells'

unevaluatedProperties: false

examples:
  - |
    #include <dt-bindings/gpio/gpio.h>

    mux-controller {
        compatible = "adi,adg2404";
        #mux-control-cells = <0>;

        a0-gpios = <&gpio 1 GPIO_ACTIVE_HIGH>;
        a1-gpios = <&gpio 2 GPIO_ACTIVE_HIGH>;
        en-gpios = <&gpio 3 GPIO_ACTIVE_HIGH>;

        idle-state = <0>; /* Select channel S1 when idle */
    };

...
```

## Documentation/devicetree/bindings/mux/adi,adgs140x.txt
```
Bindings for Analog Devices ADGS1408/1409 8:1/Dual 4:1 Mux

Required properties:
- compatible : "adi,adgs1408" or "adi,adgs1409"
- #mux-control-cells : <0>
* Standard mux-controller bindings as described in mux-controller.txt

Optional properties:
- idle-state : if present, array of states that the mux controllers will have
  when idle. The special state MUX_IDLE_AS_IS is the default and
  MUX_IDLE_DISCONNECT is also supported.

States 0 through 7 correspond to signals S1 through S8 in the datasheet.

Example:

	/*
	 * One mux controller.
	 * Mux 1 to 8 set to idle as is (no idle-state declared)
	 */
	&spi0 {
		mux: mux-controller@2 {
			compatible = "adi,adgs1408";
			reg = <0>;
			spi-max-frequency = <1000000>;
			#mux-control-cells = <0>;
		};
	}

	adc-mux@3 {
		compatible = "io-channel-mux";
		io-channels = <&adc 1>;
		io-channel-names = "parent";
		mux-controls = <&mux>;

		channels = "out_a0", "out_a1", "test0", "test1",
			"out_b0", "out_b1", "testb0", "testb1";

	};
```

## Documentation/devicetree/bindings/net/adi,adin.yaml
```yaml
# SPDX-License-Identifier: GPL-2.0+
%YAML 1.2
---
$id: http://devicetree.org/schemas/net/adi,adin.yaml#
$schema: http://devicetree.org/meta-schemas/core.yaml#

title: Analog Devices ADIN1200/ADIN1300 PHY

maintainers:
  - Alexandru Ardelean <alexandru.ardelean@analog.com>

description: |
  Bindings for Analog Devices Industrial Ethernet PHYs

allOf:
  - $ref: ethernet-phy.yaml#

properties:
  adi,rx-internal-delay-ps:
    description: |
      RGMII RX Clock Delay used only when PHY operates in RGMII mode with
      internal delay (phy-mode is 'rgmii-id' or 'rgmii-rxid') in pico-seconds.
    enum: [ 1600, 1800, 2000, 2200, 2400 ]
    default: 2000

  adi,tx-internal-delay-ps:
    description: |
      RGMII TX Clock Delay used only when PHY operates in RGMII mode with
      internal delay (phy-mode is 'rgmii-id' or 'rgmii-txid') in pico-seconds.
    enum: [ 1600, 1800, 2000, 2200, 2400 ]
    default: 2000

  adi,fifo-depth-bits:
    description: |
      When operating in RMII mode, this option configures the FIFO depth.
    enum: [ 4, 8, 12, 16, 20, 24 ]
    default: 8

  adi,1588-rx-sop-delays-cycles:
    allOf:
      - $ref: /schemas/types.yaml#definitions/uint8-array
      - items:
          - minItems: 3
            maxItems: 3
    description: |
      Enables Start Packet detection (SOP) for received IEEE 1588 time stamp
      controls, and configures the number of cycles (of the MII RX_CLK clock)
      to delay the indication of RX SOP frames for 10/100/1000 BASE-T links.
      The first element (in the array) configures the delay for 10BASE-T,
      the second for 100BASE-T, and the third for 1000BASE-T.

  adi,1588-rx-sop-pin-name:
    description: |
      This option must be used in together with 'adi,1588-rx-sop-delays-cycles'
      to specify which physical pin should be used to signal the MAC that
      the PHY is currently processing an IEEE 1588 timestamp control packet.
      The driver will report an error if the value of this property is the
      same as 'adi,1588-tx-sop-pin-name'
    enum:
      - gp_clk
      - link_st
      - int_n
      - led_0

  adi,1588-tx-sop-delays-ns:
    allOf:
      - $ref: /schemas/types.yaml#definitions/uint8-array
      - items:
          - minItems: 3
            maxItems: 3
    description: |
      Enables Start Packet detection (SOP) for IEEE 1588 time stamp controls,
      and configures the number of nano-seconds to delay the indication of
      TX frames for 10/100/1000 BASE-T links.
      The first element (in the array) configures the delay for 10BASE-T,
      the second for 100BASE-T, and the third for 1000BASE-T.
      The delays must be multiples of 8 ns (i.e. 8, 16, 24, etc).

  adi,1588-tx-sop-pin-name:
    description: |
      This option must be used in together with 'adi,1588-tx-sop-delays-ns'
      to specify which physical pin should be used to signal the MAC that
      the PHY is currently processing an IEEE 1588 timestamp control packet
      on the TX path.
      The driver will report an error if the value of this property is the
      same as 'adi,1588-rx-sop-pin-name'
    enum:
      - gp_clk
      - link_st
      - int_n
      - led_0

examples:
  - |
    ethernet {
        #address-cells = <1>;
        #size-cells = <0>;

        phy-mode = "rgmii-id";

        ethernet-phy@0 {
            reg = <0>;

            adi,rx-internal-delay-ps = <1800>;
            adi,tx-internal-delay-ps = <2200>;
        };
    };
  - |
    ethernet {
        #address-cells = <1>;
        #size-cells = <0>;

        phy-mode = "rmii";

        ethernet-phy@1 {
            reg = <1>;

            adi,fifo-depth-bits = <16>;

            adi,1588-rx-sop-delays-cycles = [ 00 00 00 ];
            adi,1588-rx-sop-pin-name = "int_n";

            adi,1588-tx-sop-delays-ns = [ 00 08 10 ];
            adi,1588-tx-sop-pin-name = "led_0";
        };
    };
```

## Documentation/devicetree/bindings/net/adi,adin1110.yaml
```yaml
# SPDX-License-Identifier: (GPL-2.0 OR BSD-2-Clause)
%YAML 1.2
---
$id: "http://devicetree.org/schemas/net/adi,adin1110.yaml#"
$schema: "http://devicetree.org/meta-schemas/core.yaml#"

title: ADI ADIN1110 MAC-PHY

allOf:
  - $ref: "ethernet-controller.yaml#"

maintainers:
  - Alexandru Tachici <alexandru.tachici@analog.com>

description: |
  The ADIN1110 is a low power single port 10BASE-T1L MAC-
  PHY designed for industrial Ethernet applications. It integrates
  an Ethernet PHY core with a MAC and all the associated analog
  circuitry, input and output clock buffering.

  The ADIN2111 is a low power, low complexity, two-Ethernet ports
  switch with integrated 10BASE-T1L PHYs and one serial peripheral
  interface (SPI) port. The device is designed for industrial Ethernet
  applications using low power constrained nodes and is compliant
  with the IEEE 802.3cg-2019 Ethernet standard for long reach
  10 Mbps single pair Ethernet (SPE).

  The device has a 4-wire SPI interface for communication
  between the MAC and host processor.

properties:
  compatible:
    enum:
      - adi,adin1110
      - adi,adin2111

  '#address-cells':
    const: 1

  '#size-cells':
    const: 0

  reg:
    maxItems: 1

  adi,spi-crc:
    description: |
      Enable CRC8 checks on SPI read/writes.
    type: boolean

  interrupts:
    maxItems: 1

patternProperties:
  "^phy@[0-1]$":
    description: |
      ADIN1100 PHY that is present on the same chip as the MAC.
    type: object

    properties:
      reg:
        items:
          maximum: 1

    allOf:
      - if:
          properties:
            compatible:
              contains:
                const: adi,adin1110
        then:
          properties:
            compatible:
              const: ethernet-phy-id0283.bc91
        else:
          properties:
            compatible:
              const: ethernet-phy-id0283.bca1

    required:
      - compatible
      - reg

required:
  - compatible
  - reg
  - interrupts
  - phy

additionalProperties: false

examples:
  - |
        spi0 {
                #address-cells = <1>;
                #size-cells = <0>;
                status = "okay";

                ethernet@0 {
                        compatible = "adi,adin1110";
                        reg = <0>;
                        spi-max-frequency = <1000000>;

                        adi,spi-crc;

                        #address-cells = <1>;
                        #size-cells = <0>;

                        interrupt-parent = <&gpio>;
                        interrupts = <25 2>;

                        mac-address = [ CA 2F B7 10 23 63 ];

                        phy@0 {
                                compatible = "ethernet-phy-id0283.bc91";
                                reg = <0>;
                        };
                };
        };
```

## Documentation/devicetree/bindings/net/adi,adin1140.yaml
```yaml
# SPDX-License-Identifier: (GPL-2.0 OR BSD-2-Clause)
%YAML 1.2
---
$id: http://devicetree.org/schemas/net/adi,adin1140.yaml#
$schema: http://devicetree.org/meta-schemas/core.yaml#

title: ADI ADIN1140 10BASE-T1S MAC-PHY

maintainers:
  - Analog Devices Inc. <linux-drivers@analog.com>

description: |
  The ADIN1140 is a low power single port 10BASE-T1S MAC-PHY
  designed for industrial Ethernet applications. It integrates
  an Ethernet PHY core with a MAC and all the associated analog
  circuitry, input and output clock buffering.

  The device implements the Open Alliance TC6 10BASE-T1x MAC-PHY
  Serial Interface specification and is compliant with the
  IEEE 802.3cg-2019 Ethernet standard for 10 Mbps single pair
  Ethernet (SPE).

  The device has a 4-wire SPI interface for communication
  between the MAC and host processor.

allOf:
  - $ref: ethernet-controller.yaml#
  - $ref: /schemas/spi/spi-peripheral-props.yaml#

properties:
  compatible:
    const: adi,adin1140

  reg:
    maxItems: 1
    description: SPI chip select number

  spi-max-frequency:
    maximum: 25000000
    description: Maximum SPI clock frequency supported by the device

  interrupts:
    maxItems: 1
    description: Interrupt from the MAC-PHY for receive data available and error conditions

  local-mac-address: true

  mac-address: true

required:
  - compatible
  - reg
  - interrupts

unevaluatedProperties: false

examples:
  - |
    #include <dt-bindings/interrupt-controller/irq.h>

    spi {
        #address-cells = <1>;
        #size-cells = <0>;

        ethernet@0 {
            compatible = "adi,adin1140";
            reg = <0>;
            spi-max-frequency = <23000000>;

            interrupt-parent = <&gpio>;
            interrupts = <6 IRQ_TYPE_EDGE_FALLING>;

            local-mac-address = [ 00 11 22 33 44 55 ];
        };
    };
```
