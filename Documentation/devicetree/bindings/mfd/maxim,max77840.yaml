## Documentation/devicetree/bindings/mfd/nxp,imx-flexio.yaml
```yaml
# SPDX-License-Identifier: (GPL-2.0-only OR BSD-2-Clause)
%YAML 1.2
---
$id: http://devicetree.org/schemas/mfd/nxp,imx-flexio.yaml#
$schema: http://devicetree.org/meta-schemas/core.yaml#

title: NXP iMX Flexible Input/Output (FlexIO)

description: |
  The FlexIO is a highly configurable module providing a wide range of functionality including
  Emulation of a variety of serial/parallel communication protocols
  Flexible 16-bit timers with support for a variety of trigger, reset, enable and disable conditions
  Programmable logic blocks allowing the implementation of digital logic functions on-chip and
  configurable interaction of internal and external modules
  Programmable state machine for offloading basic system control functions from CPU

properties:
  "#address-cells": true

  "#size-cells": true

  compatible:
    items:
      const: nxp,imx-flexio

  reg:
    maxItems: 1

  interrupts:
    maxItems: 1

  clocks:
    minItems: 1

  clock-names:
    items:
      const: ipg
    minItems: 1

patternProperties:
  "^flexio-i2c+$":
    # Child node
    type: object
    $ref: "../i2c/i2c-imx-flexio.yaml"
    description:
      FlexIO I2C mode. This child node should follow the bindings specified in
      Documentation/devicetree/bindings/i2c/i2c-imx-flexio.yaml.

required:
  - "#address-cells"
  - "#size-cells"
  - compatible
  - interrupts
  - clocks
  - clock-names

additionalProperties: false

examples:
  - |
    #include <dt-bindings/interrupt-controller/arm-gic.h>
    #include <dt-bindings/clock/imx8ulp-clock.h>

    flexio@29350000 {
      #address-cells = <1>;
      #size-cells = <1>;
      compatible = "nxp,imx-flexio";
      reg = <0x29350000 0x10000>;
      interrupts = <GIC_SPI 91 IRQ_TYPE_LEVEL_HIGH>;
      clocks = <&pcc3 IMX8ULP_CLK_FLEXIO1>, <&pcc3 IMX8ULP_CLK_FLEXIO1>;
      clock-names = "per", "ipg";

      i2c-master {
        #address-cells = <1>;
        #size-cells = <0>;
        compatible = "nxp,imx-flexio-i2c-master";
        clock-frequency = <100000>;
        sda = /bits/ 8 <0xa>;
        scl = /bits/ 8 <0xb>;
      };
    };
```

## Documentation/devicetree/bindings/mfd/nxp,imx8ulp-sim.yaml
```yaml
# SPDX-License-Identifier: (GPL-2.0-only OR BSD-2-Clause)
%YAML 1.2
---
$id: http://devicetree.org/schemas/mfd/nxp,imx8ulp-sim.yaml#
$schema: http://devicetree.org/meta-schemas/core.yaml#

title: NXP i.MX8ulp System Integration Module Bindings

maintainers:
  - Liu Ying <victor.liu@nxp.com>

description: |
  The System Integration Module (SIM) provides system control and chip
  configuration registers. One typical use-case is for some other nodes to
  acquire a reference to the syscon node by phandle, and the other typical
  use-case is that the operating system should consider all subnodes of the
  SIM module as separate child devices.

properties:
  $nodename:
    pattern: "^syscon@[0-9a-f]+$"

  compatible:
    items:
      - enum:
          - nxp,imx8ulp-avd-sim
      - const: syscon
      - const: simple-mfd

  reg:
    maxItems: 1

  clocks:
    maxItems: 1

patternProperties:
  "^(reset-controller|mux-controller)$":
    type: object
    description: The possible child devices of the SIM module.

required:
  - compatible
  - reg
  - clocks

allOf:
  - if:
      properties:
        compatible:
          contains:
            const: nxp,imx8ulp-avd-sim
    then:
      required:
        - reset-controller
        - mux-controller

additionalProperties: false

examples:
  - |
    #include <dt-bindings/clock/imx8ulp-clock.h>
    syscon@2da50000 {
        compatible = "nxp,imx8ulp-avd-sim", "syscon", "simple-mfd";
        reg = <0x2da50000 0x38>;
        clocks = <&pcc5 IMX8ULP_CLK_AVD_SIM>;

        reset-controller {
            compatible = "nxp,imx8ulp-avd-sim-reset";
            #reset-cells = <1>;
        };

        mux-controller {
            compatible = "mmio-mux";
            #mux-control-cells = <1>;
            mux-reg-masks = <0x8 0x00000200>;
        };
    };
```

## Documentation/devicetree/bindings/misc/adi,axi-data-offload.yaml
```yaml
# SPDX-License-Identifier: GPL-2.0
# Copyright 2021 Analog Devices Inc.
%YAML 1.2
---
$id: http://devicetree.org/schemas/misc/adi,axi-data-offload.yaml#
$schema: http://devicetree.org/meta-schemas/core.yaml#

title: ADI AXI Data Offload Engine

description: |
  Bindings for the Data Offload Engine, which is part of the Analog Devices hdl reference designs.
  For more information see the wiki: https://wiki.analog.com/resources/fpga/docs/data_offload

maintainers:
  - David Winter <david.winter@analog.com>

properties:
  compatible:
    items:
      - enum:
          - adi,axi-data-offload-1.0.a

  reg:
    maxItems: 1

  adi,transfer-length:
    description: |
      In cases where the data source does not indicate packet boundaries, which will usually be
      the case with RX streams coming from an ADC, transfer-length can be used to override the
      default behavior of completely filling up the datastore before any output is produced.
      A value of zero indicates that all available storage should be used. Values MUST be
      divisble by 64!
      Unit is bytes
    $ref: /schemas/types.yaml#/definitions/uint64
    default: 0
    minimum: 0
    maximum: 4294967296


  adi,sync-config:
    description: |
      The synchronization mode determines which triggering mechanism will be used. For the RX
      path the trigger determines when the input side will start accepting samples, while for
      a TX configuration the offload engine will always store (until full), but only forward once
      triggered. Supported modes are: Automatic (0), Hardware triggering (1), Software
      triggering (2).
      Note, for hardware that includes a TDD engine that is controlled by a kernel driver, this
      value may also be overridden by the driver.
    $ref: /schemas/types.yaml#/definitions/uint32
    enum: [0, 1, 2]
    default: 0

  adi,bringup:
    description: |
      If this property is present, the resetn register will be forced high. In most cases this
      will be inconsequential, because the default value of the AUTO_BRINGUP synthesis parameter
      will have the same effect, thus only if you are running a custom hardware configuration
      that does not automatically come out of reset, should this option be used.
    type: boolean

  adi,bypass:
    description: |
      Sets the data_offload to bypass mode, effectively turning it into a small AXIS CDC fifo.
      This option will be overridden by the cf_axi_dds driver, and therefore should only be used
      in hardware configurations where that driver is not used to control the dma and data offload.
    type: boolean

  adi,oneshot:
    description: |
      Sets the data_offload to oneshot mode, while the default behavior would be cyclic operation.
      Like adi,bypass, in most hardware configurations this value will also be overridden by
      other drivers at runtime.
    type: boolean

required:
  - compatible
  - reg

examples:
  - |
    axi_data_offload_tx: axi-data-offload-0@9c440000 {
            compatible = "adi,axi-data-offload-1.0.a";
            reg = <0x9c440000 0x10000>;
            adi,bringup;
            adi,oneshot;
            adi,bypass;
            adi,sync-config = <2>;
            adi,transfer-length = /bits/ 64 <0x10000>;
    };


...
```

## Documentation/devicetree/bindings/misc/adi,axi-tdd-ng.yaml
```yaml
# SPDX-License-Identifier: (GPL-2.0-only OR BSD-2-Clause)
# Copyright 2021 Analog Devices Inc.
%YAML 1.2
---
$id: http://devicetree.org/schemas/trivial-devices.yaml#
$schema: http://devicetree.org/meta-schemas/core.yaml#

title: ADI AXI TDD NG Core

description: |
  Bindings for the new generic TDD NG CORE which is used in the ADI HDL reference designs

maintainers:
  - David Winter <david.winter@analog.com>

properties:
  compatible:
    items:
      - enum:
          - adi,axi-tdd-ng-1.00.a

  reg:
    maxItems: 1

required:
  - compatible
  - reg
  - clocks
  - clock-names

examples:
  - |
    tdd: tdd@9c440000 {
            compatible = "adi,axi-tdd-ng-1.00.a";
            reg = <0x9c440000 0x10000>;
            clocks = <&zynqmp_clk PL0_REF>, <&zynqmp_clk PL1_REF>;
            clock-names = "s_axi_aclk", "intf_clk";
    };

...
```

## Documentation/devicetree/bindings/misc/adi,axi-tdd.yaml
```yaml
# SPDX-License-Identifier: (GPL-2.0-only OR BSD-2-Clause)
# Copyright 2023 Analog Devices Inc.
%YAML 1.2
---
$id: http://devicetree.org/schemas/misc/adi,axi-tdd.yaml#
$schema: http://devicetree.org/meta-schemas/core.yaml#

title: Analog Devices AXI TDD Core

maintainers:
  - Eliza Balas <eliza.balas@analog.com>

description: |
  The TDD controller is a waveform generator capable of addressing RF
  applications which require Time Division Duplexing, as well as controlling
  other modules of general applications through its dedicated 32 channel
  outputs. It solves the synchronization issue when transmitting and receiving
  multiple frames of data through multiple buffers.
  The TDD IP core is part of the Analog Devices hdl reference designs and has
  the following features:
    * Up to 32 independent output channels
    * Start/stop time values per channel
    * Enable and polarity bit values per channel
    * 32 bit-max internal reference counter
    * Initial startup delay before waveform generation
    * Configurable frame length and number of frames per burst
    * 3 sources of synchronization: external, internal and software generated
  For more information see the wiki:
  https://wiki.analog.com/resources/fpga/docs/axi_tdd

properties:
  compatible:
    enum:
      - adi,axi-tdd

  reg:
    maxItems: 1

  clocks:
    items:
      - description: System clock
      - description: TDD Core clock

  clock-names:
    items:
      - const: s_axi_aclk
      - const: intf_clk

required:
  - compatible
  - reg
  - clocks
  - clock-names

unevaluatedProperties: false

examples:
  - |
    tdd@84a00000 {
        compatible = "adi,axi-tdd";
        reg = <0x84a00000 0x10000>;
        clocks = <&zynqmp_clk_PL0_REF>, <&zynqmp_clk_PL1_REF>;
        clock-names = "s_axi_aclk", "intf_clk";
    };
...
```

## Documentation/devicetree/bindings/misc/adi,button-led.yaml
```yaml
# SPDX-License-Identifier: (GPL-2.0-only OR BSD-2-Clause)
%YAML 1.2
---
$id: http://devicetree.org/schemas/misc/adi,button-led.yaml#
$schema: http://devicetree.org/meta-schemas/core.yaml#

title: Analog Devices Button Led Example for SC5XX-family processors

maintainers:
  - Nathan Barrett-Morrison <nathan.morrison@timesys.com>
  - Greg Malysa <greg.malysa@timesys.com>

description: |
  This is an example for SC5XX-family processors.  It will
  wait for a GPIO to be pressed and toggle a corresponding LED
  on each press

properties:
  compatible:
    enum:
      - adi,button-led

  button_gpio:
    maxItems: 1

  led_gpio:
    maxItems: 1

required:
  - compatible
  - button_gpio
  - led_gpio

additionalProperties: false

examples:
  - |
    button0: button@0 {
      compatible = "adi,button-led";
      button_gpio = <80>;
      led_gpio = <77>;
    };

    button1: button@1 {
      compatible = "adi,button-led";
      button_gpio = <81>;
      led_gpio = <78>;
    };
...
```

## Documentation/devicetree/bindings/misc/adi,sram-controller.yaml
```yaml
# SPDX-License-Identifier: (GPL-2.0-only OR BSD-2-Clause)
%YAML 1.2
---
$id: http://devicetree.org/schemas/misc/adi,sram-controller.yaml#
$schema: http://devicetree.org/meta-schemas/core.yaml#

title: Analog Devices SRAM Access Driver for SC5XX Processor Family

maintainers:
  - Nathan Barrett-Morrison <nathan.morrison@timesys.com>
  - Greg Malysa <greg.malysa@timesys.com>

description: |
  Exposes SRAM memory info through /proc/sraminfo

properties:
  compatible:
    enum:
      - adi,sram-controller

  reg:
    maxItems: 1

  "adi,sram":
    minItems: 1
    description: SRAM memory regions

  interrupts:
    maxItems: 1
    description: SRAM ECC interrupt

required:
  - reg
  - compatible
  - "adi,sram"
  - interrupts

additionalProperties: false

examples:
  - |
    sram-controller@31080000 {
      compatible = "adi,sram-controller";
      reg = <0x31080000 0x100>;
      adi,sram = <&sram0>, <&sram1>;
      interrupts = <GIC_SPI 10 IRQ_TYPE_LEVEL_HIGH>;
      status = "okay";
    };

    sram0: sram-icc@20000000 {
      compatible = "mmio-sram";
      #address-cells = <1>;
      #size-cells = <1>;
      reg = <0x20025000 0x1B000>;
      ranges = <0 0x20025000 0x1B000>; /*108KiB*/
    };

    sram1: sram-reserved@20040000 {
      compatible = "mmio-sram";
      #address-cells = <1>;
      #size-cells = <1>;
      reg = <0x20040000 0x40000>;
      ranges = <0 0x20040000 0x40000>; /*256KiB*/
    };
```

## Documentation/devicetree/bindings/misc/adi,sram-mmap.yaml
```yaml
# SPDX-License-Identifier: (GPL-2.0-only OR BSD-2-Clause)
%YAML 1.2
---
$id: http://devicetree.org/schemas/misc/adi,sram-mmap.yaml#
$schema: http://devicetree.org/meta-schemas/core.yaml#

title: Analog Devices SRAM Access Driver for SC5XX Processor Family

maintainers:
  - Nathan Barrett-Morrison <nathan.morrison@timesys.com>
  - Greg Malysa <greg.malysa@timesys.com>

description: |
  Exposes SRAM memory regions for mapping through /dev/sram_mmap

properties:
  compatible:
    enum:
      - adi,sram-mmap

  "adi,sram":
    minItems: 1
    description: SRAM memory regions

required:
  - compatible
  - "adi,sram"

additionalProperties: false

examples:
  - |
    sram_mmap: sram-mmap@0 { /* mmap from sram1 pool*/
      compatible = "adi,sram-mmap";
      adi,sram = <&sram1>;
      status = "okay";
    };

    sram1: sram-reserved@20040000 {
      compatible = "mmio-sram";
      #address-cells = <1>;
      #size-cells = <1>;
      reg = <0x20040000 0x40000>;
      ranges = <0 0x20040000 0x40000>; /*256KiB*/
    };
```

## Documentation/devicetree/bindings/misc/adi,tru.yaml
```yaml
# SPDX-License-Identifier: (GPL-2.0 OR BSD-2-Clause)
%YAML 1.2
---
$id: http://devicetree.org/schemas/misc/adi,tru.yaml#
$schema: http://devicetree.org/meta-schemas/core.yaml#

title: Analog Devices Trigger Routing Unit (TRU)

maintainers:
  - Jie Zhang <jie.zhang@analog.com>

properties:
  compatible:
    const: adi,tru

  reg:
    maxItems: 1

  adi,tru-last-source-id:
    description: |
      The last TRU trigger source ID
    minimum: 0
    maximum: 0xff

  adi,tru-last-target-id:
    description: |
      The last TRU trigger target ID
    minimum: 0
    maximum: 0xffffffff

  adi,tru-connections-preset:
    description: |
      Preset connections between TRU sources and targets

  adi,tru-connections-preset-locked:
    description: |
      The preset connections between TRU sources and targets are locked.

additionalProperties: false

required:
  - compatible
  - reg
  - adi,tru-last-source-id
  - adi,tru-last-target-id

examples:
  - |
    #define TRU_BASE  0x20052000

     tru0: tru@TRU_BASE_UADDR {
       compatible = "adi,tru";
       reg = <TRU_BASE 0x800>;
       /* TODO replace 100 with actual last trigger source ID */
       adi,tru-last-source-id = <100>;
       adi,tru-last-target-id = <79>;
       /* each connection is <source target> */
       /*
       adi,tru-connections-preset = <1 2>,
                                    <25 32>,
                                    <3 4>;
       adi,tru-connections-preset-locked;
       */
     };
...
```
