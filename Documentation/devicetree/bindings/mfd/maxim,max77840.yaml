## Documentation/devicetree/bindings/mfd/maxim,max77840.yaml
```yaml
# SPDX-License-Identifier: GPL-2.0-only
%YAML 1.2
---
$id: http://devicetree.org/schemas/mfd/maxim,max77840.yaml#
$schema: http://devicetree.org/meta-schemas/core.yaml#

title: Maxim MAX77840 PMIC

maintainers:
  - Joan Na <joan.na@analog.com>


properties:
  compatible:
    const: maxim,max77840

  reg:
    maxItems: 1

  interrupts:
    maxItems: 1

  interrupt-controller: true

patternProperties:
  "^regulator(@.*)?$":
    type: object
    additionalProperties: true

  "^charger(@.*)?$":
    type: object
    $ref: /schemas/power/supply/maxim,max77840-charger.yaml#

  "^fuelgauge(@.*)?$":
    type: object
    $ref: /schemas/power/supply/maxim,max77840-fuelgauge.yaml#

  "^charger-detect(@.*)?$":
    type: object
    properties:
      compatible:
        const: maxim,max77840-charger-detect

    additionalProperties: false

required:
  - compatible
  - reg
  - interrupt-parent
  - interrupts
  - interrupt-controller

additionalProperties: false

examples:
  - |
    #include <dt-bindings/interrupt-controller/irq.h>

    i2c@0 {
      #address-cells = <1>;
      #size-cells = <0>;

      max77840@66 {
        compatible = "maxim,max77840";
        reg = <0x66>;
        interrupt-parent = <&gpio>;
        interrupts = <16 IRQ_TYPE_LEVEL_LOW>;
        interrupt-controller;
        #interrupt-cells = <1>;
        status = "okay";

        regulator {
          SAFEOUT1 {
            regulator-boot-on;
            regulator-always-on;
          };
        };

        charger {
          compatible = "maxim,max77840-charger";
          status = "disabled";
          fast_charge_timer = <0>;                  // disable
          fast_charge_current = <1500>;             // mA
          charge_termination_voltage = <4350>;      // mV
          topoff_timer = <30>;                      // min
          topoff_current = <150>;                   // mA
          restart_threshold = <150>;                // mV
          input_current_limit = <500>;              // mA
        };

        charger-detect {
          compatible = "maxim,max77840-charger-detect";
          status = "disabled";
        };

        fuelgauge {
          compatible = "maxim,max77840-fuelgauge";
          fuelgauge,fuel_alert_soc = <2>;
        };
      };
    };
```

## Documentation/devicetree/bindings/mfd/maxim,max96752.yaml
```yaml
# SPDX-License-Identifier: (GPL-2.0-only OR BSD-2-Clause)
%YAML 1.2
---
$id: http://devicetree.org/schemas/mfd/maxim,max96752.yaml#
$schema: http://devicetree.org/meta-schemas/core.yaml#

title: Maxim MAX96752 deserializer chip

maintainers:
  - Laurentiu Palcu <laurentiu.palcu@oss.nxp.com>

description: |
  The MAX96752/MAX96754 deserializers convert a single or dual-link GMSL serial input to single or
  dual OLDI. They also send and receive side-channel and peripheral control data, enabling
  full-duplex, single-wire transmission of video and bidirectional data, like I2S stereo audio
  channels.

properties:
  compatible:
    enum:
      - maxim,max96752

  '#address-cells':
    const: 1

  '#size-cells':
    const: 0

  reg:
    description: |
      The deserializer default I2C address can be overwritten to avoid collisions when more of the
      same deserializers are used.
    minItems: 1
    maxItems: 2

  maxim,gmsl2-link-speed:
    description: |
      Specifies the link speed for the GMSL2 links:
        3 - 3Gbps GMSL2 link speed
        6 - 6Gbps GMSL2 link speed
      If omitted, pin configuration will be used.
    $ref: /schemas/types.yaml#/definitions/int32
    enum: [3, 6]

  maxim,gmsl2-dual-link:
    description: |
      Activate dual-link mode. This is useful if both GMSL connections go to the same remote device
      and we want to benefit from the increased GMSL bandwidth for transmiting higher resolution
      video streams.
    type: boolean

  gpio-config:
    description: |
      The MAX96752 can replicate the transitions on a local GPIO input pin to a remote GPIO output
      pin on the serializer chip or a remote GPIO input pin to a local GPIO output pin. Hence,
      each GPIO pin will be a port with a remote-endpoint that will point to the remote chip GPIO
      pin.
    type: object

    properties:
      "#address-cells":
        const: 1

      "#size-cells":
        const: 0

    patternProperties:
      "^port@[0-9a-f]+$":
        $ref: /schemas/graph.yaml#/$defs/port-base
        unevaluatedProperties: false
        description: This is a GPIO tunnel.

        properties:
          "#address-cells":
            const: 1

          "#size-cells":
            const: 0

          reg:
            maxItems: 1

          maxim,pin_config:
            $ref: /schemas/types.yaml#/definitions/uint32-array
            description: GPIO pin configuration
            items:
              - description: Pin direction (0 - output, 1 - input)
              - description: Pull resistor type (0 - no pull resistor, 1 - pull-up, 2 - pull-down)
              - description: Pull strength (0 - 40Kohm, 1 - 1Mohm)

          endpoint:
            $ref: /schemas/graph.yaml#/properties/endpoint
            description: |
              Serializer GPIO pin that the local pin is linked to. If missing, the GPIO is just
              a local driven GPIO.

        additionalProperties: false

        required:
          - "#address-cells"
          - "#size-cells"
          - reg
          - maxim,pin_config

    required:
      - "#address-cells"
      - "#size-cells"

    additionalProperties: false

  i2c-gate:
    description: |
      The deserializer can cut-off the local I2C bus to avoid address collision in dual-display
      configurations when a serializer connects to 2 deserializers which have the same peripherals
      connected on the same I2C bus.
    $ref: /schemas/i2c/i2c-gate.yaml#
    unevaluatedProperties: false

  max96752_lvds_bridge:
    description: The LVDS video bridge.
    type: object
    $ref: /schemas/display/bridge/maxim,max96752-lvds-bridge.yaml
    unevaluatedProperties: false

required:
  - compatible
  - '#address-cells'
  - '#size-cells'
  - i2c-gate

additionalProperties: false

examples:
  - |
    i2c-mux {
      #address-cells = <1>;
      #size-cells = <0>;

      i2c@0 {
        #address-cells = <1>;
        #size-cells = <0>;

        reg = <0>;

        max96752: mipi_dsi_deserializer@48 {

          #address-cells = <1>;
          #size-cells = <0>;

          compatible = "maxim,max96752";
          reg = <0x48>, <0x49>;

          maxim,gmsl2-link-speed = <6>;
          maxim,gmsl2-dual-link;

          max96752_lvds_bridge {
            #address-cells = <1>;
            #size-cells = <0>;

            compatible = "maxim,max96752-lvds";

            port {
              #address-cells = <1>;
              #size-cells = <0>;

              max96752_video_in: endpoint@0 {
                reg = <0>;
                remote-endpoint = <&max96789_video_out>;
              };

              max96752_lvds_a_out: endpoint@1 {
                reg = <1>;
                remote-endpoint = <&it6263_in>;
              };
            };
          };

          i2c-gate {
            #address-cells = <1>;
            #size-cells = <0>;

            lvds-to-hdmi-bridge@4c {
              compatible = "ite,it6263";
              reg = <0x4c>;

              port {
                it6263_in: endpoint {
                  remote-endpoint = <&max96752_lvds_a_out>;
                };
              };
            };
          };
        };
      };
    };
```

## Documentation/devicetree/bindings/mfd/maxim,max96789.yaml
```yaml
# SPDX-License-Identifier: (GPL-2.0-only OR BSD-2-Clause)
%YAML 1.2
---
$id: http://devicetree.org/schemas/mfd/maxim,max96789.yaml#
$schema: http://devicetree.org/meta-schemas/core.yaml#

title: Maxim MAX96789 serializer chip

maintainers:
  - Laurentiu Palcu <laurentiu.palcu@oss.nxp.com>

description: |
  The MAX96789/MAX96791 family of serializers convert dual MIPI DSI, four-lane input port data to
  dual Maxim Integrated’s GMSL 1 or 2 high-speed serial link protocol. They also send and receive
  side-channel and peripheral control data, enabling full-duplex, single-wire, transmission of video
  and bidirectional data, like I2S stereo audio channels.

properties:
  compatible:
    enum:
      - maxim,max96789

  '#address-cells':
    const: 1

  '#size-cells':
    const: 0

  reg:
    maxItems: 1

  v12p0-supply:
    description: Regulator that provides 12V power supply.

  maxim,gmsl-links-types:
    description: |
      Specifies the link types for each of the 2 GMSL ports. The device supports GMSL links of type
      1 and 2. If ommited, the pin configuration will be used instead.
    $ref: /schemas/types.yaml#/definitions/uint32-array
    items:
      - enum: [1, 2]
      - enum: [1, 2]

  maxim,gmsl2-link-speed:
    description: |
      Specifies the link speed for the GMSL2 links:
        3 - 3Gbps GMSL2 link speed
        6 - 6Gbps GMSL2 link speed
      If omitted, pin configuration will be used.
    $ref: /schemas/types.yaml#/definitions/int32
    enum: [3, 6]

  maxim,gmsl2-dual-link:
    description: |
      Activate dual-link mode. This is useful if both GMSL connections go to the same remote device
      and we want to benefit from the increased GMSL bandwidth for transmiting higher resolution
      video streams.
    type: boolean

  gpio-config:
    description: |
      The MAX96789 can replicate the transitions on a local GPIO input pin to a remote GPIO output
      pin on the deserializer chip or a remote GPIO input pin to a local GPIO output pin. Hence,
      each GPIO pin will be a port with a remote-endpoint that will point to the remote chip GPIO
      pin.
    type: object

    properties:
      "#address-cells":
        const: 1

      "#size-cells":
        const: 0

    patternProperties:
      "^port@[0-9a-f]+$":
        $ref: /schemas/graph.yaml#/$defs/port-base
        unevaluatedProperties: false
        description: This is a GPIO tunnel.

        properties:
          "#address-cells":
            const: 1

          "#size-cells":
            const: 0

          reg:
            maxItems: 1

          maxim,pin_config:
            $ref: /schemas/types.yaml#/definitions/uint32-array
            description: GPIO pin configuration
            items:
              - description: Pin direction (0 - output, 1 - input)
              - description: Pull resistor type (0 - no pull resistor, 1 - pull-up, 2 - pull-down)
              - description: Pull strength (0 - 40Kohm, 1 - 1Mohm)

          endpoint:
            $ref: /schemas/graph.yaml#/properties/endpoint
            description: |
              Deserializer GPIO pin that the local pin is linked to. If missing, the GPIO is just
              a local driven GPIO.

        additionalProperties: false

        required:
          - "#address-cells"
          - "#size-cells"
          - reg
          - maxim,pin_config

    required:
      - "#address-cells"
      - "#size-cells"

    additionalProperties: false

  i2c-mux:
    description: |
      Each GMSL link is modelled as a child bus of an i2c bus multiplexer/switch as the device
      extends the I2C bus to the remote deserializer chip.
    type: object
    $ref: /schemas/i2c/i2c-mux.yaml#
    unevaluatedProperties: false

    patternProperties:
      '^i2c@[01]$':
        type: object
        description: |
          Child node of the I2C bus multiplexer that represents a GMSL link to a deserializer
          device. The MAX96789 chip supports up to 2 GMSL links.

        properties:
          reg:
            description: The index of the GMSL channel.
            maxItems: 1

          '#address-cells':
            const: 1

          '#size-cells':
            const: 0

        required:
          - reg
          - '#address-cells'
          - '#size-cells'

        additionalProperties: true

patternProperties:
  '^max96789_dsi_bridge@[01]$':
    description: The DSI video bridge.
    type: object
    $ref: /schemas/display/bridge/maxim,max96789-dsi-bridge.yaml
    unevaluatedProperties: false

required:
  - compatible
  - '#address-cells'
  - '#size-cells'
  - i2c-mux

additionalProperties: false

examples:
  - |
    i2c@57226000 {
      #address-cells = <1>;
      #size-cells = <0>;

      reg = <0x57226000 0x1000>;

      max96789: mipi_dsi_serializer@40 {
        #address-cells = <1>;
        #size-cells = <0>;

        compatible = "maxim,max96789";
        reg = <0x40>;
        status = "okay";

        maxim,gmsl-links-types = <2 2>;
        maxim,gmsl2-link-speed = <6>;
        maxim,gmsl2-dual-link;

        /* DSI port 1 */
        max96789_dsi_bridge@1 {
          #address-cells = <1>;
          #size-cells = <0>;

          reg = <1>;

          compatible = "maxim,max96789-dsi";

          port {
            #address-cells = <1>;
            #size-cells = <0>;

            max96789_dsi_b_in: endpoint@0 {
              reg = <0>;

              remote-endpoint = <&mipi0_out>;
                data-lanes = <1 2 3 4>;
            };

            max96789_video_out: endpoint@1 {
              reg = <1>;

              remote-endpoint = <&max96752_video_in>;
            };
          };
        };

        gpio-config {
          #address-cells = <1>;
          #size-cells = <0>;

          port@a {
            #address-cells = <1>;
            #size-cells = <0>;

            reg = <10>;

            /* input, pull-down, 1Mohm */
            maxim,pin_config = <1 2 1>;

            max96789_dsi_b_pwm: endpoint {
              remote-endpoint = <&max96752_lvds_a_pwm>;
            };
          };
        };

        i2c-mux {
          #address-cells = <1>;
          #size-cells = <0>;

          /* gmsl a */
          i2c@0 {
            #address-cells = <1>;
            #size-cells = <0>;
            reg = <0>;

            max96752: mipi_dsi_deserializer@48 {
              #address-cells = <1>;
              #size-cells = <0>;

              compatible = "maxim,max96752";
              reg = <0x48>;

              i2c-gate {
              };
            };
          };
        };
      };
    };
```
