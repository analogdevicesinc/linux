## Documentation/devicetree/bindings/phy/fsl,lynx-10g.yaml
```yaml
# SPDX-License-Identifier: (GPL-2.0-only OR BSD-2-Clause)
%YAML 1.2
---
$id: http://devicetree.org/schemas/phy/fsl,lynx-10g.yaml#
$schema: http://devicetree.org/meta-schemas/core.yaml#

title: Freescale Lynx 10G SerDes PHY

description:
  The Lynx 10G is a multi-protocol SerDes block which handles networking, PCIe,
  SATA, USB and other high-speed interfaces. It is present on most QorIQ and
  Layerscape SoCs. The integration is SoC-specific, with the differences
  consisting in register endianness, the number of lanes, protocol converters
  available per lane and their location in the PCCR registers. Some SoCs have
  multiple SerDes blocks and even those differ in their protocol configuration.

maintainers:
  - Vladimir Oltean <vladimir.oltean@nxp.com>

properties:
  compatible:
    items:
      - enum:
          - fsl,ls1028a-serdes
          - fsl,ls1046a-serdes1
          - fsl,ls1046a-serdes2
          - fsl,ls1088a-serdes1
          - fsl,ls2088a-serdes1
          - fsl,ls2088a-serdes2
      - const: fsl,lynx-10g

  reg:
    maxItems: 1

  "#phy-cells":
    const: 1
    description:
      Encodes lane number from consumer's perspective (lane A corresponds to 0).
      This number corresponds to the lane as visible in the SerDes IP's
      registers (such as LNaPSSR0), and this may not be necessarily identical
      to the lane numbering scheme from the SoC's pinout.

  fsl,dcfg-handle:
    description:
      Should be a phandle to the DCFG block of the SoC. On some SoC
      integrations, major reconfiguration of the networking SerDes protocol
      requires an RCW override procedure, which is handled by the DCFG.
      The RCW override procedure requires hardware validation for each SoC and
      is currently not implemented.
    $ref: /schemas/types.yaml#/definitions/phandle

required:
  - compatible
  - reg
  - "#phy-cells"

additionalProperties: false

examples:
  - |
    soc {
      #address-cells = <2>;
      #size-cells = <2>;

      serdes_1: phy@1ea0000 {
        compatible = "fsl,ls1028a-serdes", "fsl,lynx-10g";
        reg = <0x0 0x1ea0000 0x0 0xffff>;
        #phy-cells = <1>;
      };
    };
```

## Documentation/devicetree/bindings/phy/fsl,lynx-28g.yaml
```yaml
# SPDX-License-Identifier: (GPL-2.0-only OR BSD-2-Clause)
%YAML 1.2
---
$id: http://devicetree.org/schemas/phy/fsl,lynx-28g.yaml#
$schema: http://devicetree.org/meta-schemas/core.yaml#

title: Freescale Lynx 28G SerDes PHY

maintainers:
  - Ioana Ciornei <ioana.ciornei@nxp.com>

properties:
  compatible:
    oneOf:
      - items:
          - const: fsl,lynx-28g
      - items:
          - enum:
              - fsl,lx2160a-serdes1
              - fsl,lx2160a-serdes2
              - fsl,lx2160a-serdes3
              - fsl,lx2162a-serdes1
              - fsl,lx2162a-serdes2
          - const: fsl,lynx-28g

  reg:
    maxItems: 1

  "#phy-cells":
    const: 1

required:
  - compatible
  - reg
  - "#phy-cells"

additionalProperties: false

examples:
  - |
    soc {
      #address-cells = <2>;
      #size-cells = <2>;
      serdes_1: phy@1ea0000 {
        compatible = "fsl,lx2160a-serdes1", "fsl,lynx-28g";
        reg = <0x0 0x1ea0000 0x0 0x1e30>;
        #phy-cells = <1>;
      };
    };
```

## Documentation/devicetree/bindings/phy/inphi,in112525.yaml
```yaml
# SPDX-License-Identifier: (GPL-2.0-only OR BSD-2-Clause)
%YAML 1.2
---
$id: http://devicetree.org/schemas/phy/inphi,in112525.yaml#
$schema: http://devicetree.org/meta-schemas/core.yaml#

title: Inphi IN112525 Retimer PHY binding

maintainers:
  - Ioana Ciornei <ioana.ciornei@nxp.com>

properties:
  compatible:
    enum:
      - inphi,in112525

  reg:
    maxItems: 1

  "#phy-cells":
    const: 1

required:
  - compatible
  - reg
  - "#phy-cells"

additionalProperties: false

examples:
  - |

    &emdio2 {
      status = "okay";

      inphi_retimer: retimer@0 {
        compatible = "inphi,in112525";
        reg = <0x0>;
        #phy-cells = <1>;
      };
    };
```

## Documentation/devicetree/bindings/phy/mixel,lvds-combo-phy.txt
```
Mixel LVDS combo PHY

Required properties:
- compatible: must be "mixel,lvds-combo-phy".
- reg: offset and length of the register block.
- #phy-cells: see phy-bindings.txt in the same directory, must be <0>.
- clocks: clock phandle and specifier pair.
- clock-names: string, clock input name, must be "phy".
- power-domains: phandle pointing to power domain.

Example:
	ldb1_phy: ldb_phy@56221000 {
		compatible = "mixel,lvds-combo-phy";
		reg = <0x0 0x56221000 0x0 0x100>, <0x0 0x56228000 0x0 0x1000>;
		#phy-cells = <0>;
		clocks = <&clk IMX8QXP_MIPI0_LVDS_PHY_CLK>;
		clock-names = "phy";
		power-domains = <&pd_mipi_dsi0>;
		status = "disabled";
	};
```

## Documentation/devicetree/bindings/phy/mixel,mipi-dsi-phy.txt
```
Mixel DSI DPHY for MX8

The MIPI-DSI DPHY IP block found on MX8 platforms comes along the MIPI-DSI
IP from Northwest Logic and represents the physical layer for the electrical
signals for DSI.

Required properties:
- compatible: 		"mixel,<soc>-mipi-dsi-phy"
- reg:			the register range of the PHY controller
- #phy-cells:		number of cells in PHY, as defined in
			Documentation/devicetree/bindings/phy/phy-bindings.txt
			this must be <0>

Optional properties:
- power-domains: 	phandle to power domain

Example:
	mipi0_phy: mipi0_phy@56228300 {
                compatible = "mixel,imx8qm-mipi-dsi-phy";
                reg = <0x0 0x56228300 0x0 0x100>;
                power-domains = <&pd_mipi0>;
                #phy-cells = <0>;
        };
```

## Documentation/devicetree/bindings/phy/phy-mixel-lvds-combo.txt
```
Mixel LVDS combo PHY

Required properties:
- compatible: must be "mixel,lvds-combo-phy".
- reg: offset and length of the register block.
- #phy-cells: see phy-bindings.txt in the same directory, must be <0>.
- clocks: clock phandle and specifier pair.
- clock-names: string, clock input name, must be "phy".
- power-domains: phandle pointing to power domain.

Example:
	ldb_phy@56221000 {
		compatible = "mixel,lvds-combo-phy";
		reg = <0x0 0x56221000 0x0 0x100>, <0x0 0x56228000 0x0 0x1000>;
		#phy-cells = <0>;
		clocks = <&clk IMX_LVDS0_PHY_CLK>;
		clock-names = "phy";
		power-domains = <&pd IMX_SC_R_LVDS_0>;
	};
```

## Documentation/devicetree/bindings/phy/phy-mixel-lvds.txt
```
Mixel LVDS PHY

This LVDS PHY supports two LVDS channels.

Required properties:
- compatible: must be "mixel,lvds-phy".
- reg: offset and length of the register block.
- #address-cells: number of address cells for the LVDS channel subnodes, must
		  be <1>.
- #size-cells: number of size cells for the LVDS channel subnodes, must be <0>.
- clocks: clock phandle and specifier pair.
- clock-names: string, clock input name, must be "phy".
- power-domains: phandle pointing to power domain.

The LVDS PHY device tree node should have the subnodes corresponding to the two
LVDS channels. These subnodes must contain the following properties:
- reg: the PHY ID.
- #phy-cells: see phy-bindings.txt in the same directory, must be <0>.

Example:
	ldb_phy@56241000 {
		#address-cells = <1>;
		#size-cells = <0>;
		compatible = "mixel,lvds-phy";
		reg = <0x0 0x56241000 0x0 0x100>;
		clocks = <&clk IMX_LVDS0_PHY_CLK>;
		clock-names = "phy";
		power-domains = <&pd IMX_SC_R_LVDS_0>;

		ldb1_phy1: port@0 {
			reg = <0>;
			#phy-cells = <0>;
		};

		ldb1_phy2: port@1 {
			reg = <1>;
			#phy-cells = <0>;
		};
	};
```

## Documentation/devicetree/bindings/phy/ti,ds125df111.yaml
```yaml
# SPDX-License-Identifier: (GPL-2.0-only OR BSD-2-Clause)
%YAML 1.2
---
$id: http://devicetree.org/schemas/phy/ti,ds125df111.yaml#
$schema: http://devicetree.org/meta-schemas/core.yaml#

title: TI DS125DF111 Retimer PHY binding

maintainers:
  - Ioana Ciornei <ioana.ciornei@nxp.com>

properties:
  compatible:
    enum:
      - ti,ds125df111

  reg:
    maxItems: 1

  "#phy-cells":
    const: 1

required:
  - compatible
  - reg
  - "#phy-cells"

additionalProperties: false

examples:
  - |

    &i2c_bus {
      status = "okay";

      ti_retimer: retimer@18 {
        compatible = "ti,ds125df111";
        reg = <0x18>;
        #phy-cells = <1>;
      };
    };
```

## Documentation/devicetree/bindings/pinctrl/adi,adrv906x-pinctrl.txt
```
* Analog Devices Inc. (ADI) - Pinmux Controller for the ADRV906X SoC

The ADRV906X SoC integrates many internal function blocks (UART, SPI, I2C, GPIO, among others) 
which can be optionally enabled by the end user. To conserve the number of pins, and  
reduce overall package size, a Pinmux Controller is utilzed. This Pinmux Controller 
allows for several of these function blocks to share a single Input/Output pin. 
The number of configurable pins, number of sources per pin, their mappings is 
described in the referenced header file (pinctrl-adi-adrv906x-io-pad.h). This
readme describes how to setup the ADRV906X SoC's configurable I/O mapping.  See the
SoC documentation for more information.

Please refer to pinctrl-bindings.txt in this directory for details of the
common pinctrl bindings used by client devices, including the meaning of the
phrase "pin configuration node".

ADI ADRV906X pin configuration node is a node of a group of pins which can be
used for a specific device or function. This node represents the pin number,
source mux, and config of the pins in that group. The 'source mux' selects the 
function that connects to specified pin. This pin can work on and the 'config' 
configures various pad settings such as pull-up, open drain, drive strength, etc.

Required properties for pinmux controller:
- compatible: "adi,adrv906x-pinctrl"

Pin Configuration:
- adi,pins: each pinmux entry consists of 3 32-bit integers representing:
     <PIN_NUMBER>  <SOURCE_MUX>   <CONFIG_WORD>
     1. Pin Number
     2. Source Mux Value
     3. Configuration Word

A header file is provided, include/dt-bindings/pinctrl/pinctrl-adi-adrv906x-io-pad.h 
This header provides SoC specifiec pin controller info such as 
   1. Total configurable I/O
   2. Maximum pinmux sources per pin
   3. Maximum pinmux sources available

Also provided pre configured descriptive Pin IDs (which contain Pin Number and Source Mux) 
for all possible I/O configurations.  Below illustrate these Pin IDs.  See the above referenced 
header for up-to-date PIN ID values.

PIN-ID table example from pinctrl-adi-adrv906x-io-pad.h:

              PIN-ID                        PIN_NUMBER            MUX_SRC
----------------------------------------------------------------------------------------              
    #define   UART4_CTSIN_PIN               ADI_ADRV906X_PIN_51     ADI_PINMUX_SRC_SEL_1
    #define   UART4_RTSOUT_PIN              ADI_ADRV906X_PIN_50     ADI_PINMUX_SRC_SEL_4
    #define   UART4_RXSIN_PIN               ADI_ADRV906X_PIN_30     ADI_PINMUX_SRC_SEL_3
    #define   UART4_TXSOUT_PIN              ADI_ADRV906X_PIN_31     ADI_PINMUX_SRC_SEL_1


Configuration Word 32-BIT Description:
BIT(s)      Name             Description
----------------------------------------------------------------------------------------
31:7        unused                   N/A
6           PULLUP_ENABLE            Setting this bit to '1' enables pullup of selected pin, '0' 
                                     for pulldown.
5           PULL_ENABLEMENT          Setting this bit to '1' enables the pull (up/down) capability 
                                     of the selected pin.
4           SCHMITT_TRIGGER_ENABLE   Setting this bit to a '1' enables the schmitt trigger input
                                     capability
3:0         DRIVE_STRENGTH           This 4-bit field specifies the drive strength (0-15) of the
                                     selected output signal.  See the SoC documentation for 
                                     more detail.

The referenced helper file also contains configuration word helper macros that can be utilized
within the device tree descriptions.  See these helper macros in pinctrl-adi-adrv906x-io-pad.h, also
see usage examples below.

NOTE:
Some requirements for using adi,adrv906x-pinctrl binding:

1. We have pin function node defined under the controller node to represent
   what pinmux functions this SoC supports.
2. The driver can use the function node's name and pin configuration node's
   name describe the pin function and group hierarchy.
   For example, Linux adrv906x-pinctrl driver takes the function node's name
   as the function name and pin configuration node's name as group name to
   create the map table.
3. Each pin configuration node should have a phandle, devices can set pins
   configurations by referring to the phandle of that pin configuration node.
4. The gpio controller must be describe in the pinctrl simple-bus.

Examples:
&spi0 {
	storage,flash-handle = <&flash>;
	pinctrl-names = "default";
	pinctrl-0 = <&pinctrl_spi0>;

	flash: mt25q@0 {
		compatible = "n25q128a11", "jedec,spi-nor";
		spi-max-frequency = <100000000>;
		reg = <0>;
		spi-tx-bus-width = <4>;
		spi-rx-bus-width = <4>;

		#include "adrv906x-nor-flash-part.dtsi"
	};
};

&pinctrl0 {
	pinctrl_spi0: spi0-grp {
		adi,pins = <
			QSPI_FLASH_CLK_PIN		 (ADI_CONFIG_NO_PULL)
			QSPI_FLASH_SELB_PIN		 (ADI_CONFIG_ENABLE_PULLUP | ADI_CONFIG_DRIVE_STRENGTH_4)
			QSPI_FLASH_D0_PIN		    (ADI_CONFIG_NO_PULL       | ADI_CONFIG_DRIVE_STRENGTH_4)
			QSPI_FLASH_D1_PIN		    (ADI_CONFIG_NO_PULL       | ADI_CONFIG_DRIVE_STRENGTH_4)
			QSPI_FLASH_D2_PIN		    (ADI_CONFIG_NO_PULL       | ADI_CONFIG_DRIVE_STRENGTH_4)
			QSPI_FLASH_D3_PIN		    (ADI_CONFIG_NO_PULL       | ADI_CONFIG_DRIVE_STRENGTH_4)
			QSPI_FLASH_RESETN_PIN    (ADI_CONFIG_ENABLE_PULLUP | ADI_CONFIG_DRIVE_STRENGTH_4)
			QSPI_FLOW_READY_PIN		 (ADI_CONFIG_NO_PULL)
		>;
	};
	....
};
```
