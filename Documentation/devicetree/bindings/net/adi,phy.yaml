## Documentation/devicetree/bindings/pinctrl/adi,adrv906x-pinctrl.yaml
```yaml
# SPDX-License-Identifier: (GPL-2.0-only OR BSD-2-Clause)
%YAML 1.2
---
$id: http://devicetree.org/schemas/pinctrl/adi,adrv906x-pinctrl.yaml#
$schema: http://devicetree.org/meta-schemas/core.yaml#

title: Analog Devices ADRV906X SoC Pinmux Controller

maintainers:
  - Woodrow Barlow <woodrow.barlow@analog.com>

description: |
  The ADRV906X SoC integrates many internal function blocks (UART, SPI, I2C,
  GPIO, among others) which can be optionally enabled by the end user. To
  conserve the number of pins and reduce overall package size, a Pinmux
  Controller is utilized. This Pinmux Controller allows for several of these
  function blocks to share a single Input/Output pin.

  The number of configurable pins, number of sources per pin, and their
  mappings is described in the referenced header file
  (include/dt-bindings/pinctrl/pinctrl-adi-adrv906x-io-pad.h).

  Pin configuration nodes represent a group of pins which can be used for a
  specific device or function. Each node specifies the pin number, source mux,
  and configuration of the pins in that group. The 'source mux' selects the
  function that connects to the specified pin, and the 'config' configures
  various pad settings such as pull-up, open drain, drive strength, etc.

  The header file provides SoC specific pin controller information such as:
    - Total configurable I/O
    - Maximum pinmux sources per pin
    - Maximum pinmux sources available
    - Pre-configured descriptive Pin IDs (which contain Pin Number and Source
      Mux) for all possible I/O configurations

  Configuration Word 32-bit Description:
    Bit(s)  Name                     Description
    31:7    unused                   N/A
    6       PULLUP_ENABLE            Setting to 1 enables pullup of selected pin,
                                     0 for pulldown
    5       PULL_ENABLEMENT          Setting to 1 enables the pull (up/down)
                                     capability of the selected pin
    4       SCHMITT_TRIGGER_ENABLE   Setting to 1 enables the schmitt trigger
                                     input capability
    3:0     DRIVE_STRENGTH           This 4-bit field specifies the drive
                                     strength (0-15) of the selected output
                                     signal

  The referenced header file also contains configuration word helper macros
  that can be utilized within the device tree descriptions.

properties:
  compatible:
    const: adi,adrv906x-pinctrl

  reg:
    maxItems: 1

patternProperties:
  '-grp$':
    type: object
    additionalProperties: false
    description:
      Pin configuration node describing a group of pins and their configuration.

    properties:
      adi,pins:
        $ref: /schemas/types.yaml#/definitions/uint32-matrix
        description: |
          Each entry consists of 3 32-bit integers representing:
            PIN_NUMBER   - The pin number
            SOURCE_MUX   - The source mux value
            CONFIG_WORD  - The configuration word

          Pre-configured Pin IDs from the header file can be used for PIN_NUMBER
          and SOURCE_MUX. Configuration word helper macros from the header can
          be used for CONFIG_WORD.
        items:
          items:
            - description: Pin number
            - description: Source mux value
            - description: Configuration word (pull settings, drive strength, etc.)

allOf:
  - $ref: pinctrl.yaml#

required:
  - compatible
  - reg

additionalProperties:
  type: object

examples:
  - |
    #include <dt-bindings/pinctrl/pinctrl-adi-adrv906x-io-pad.h>

    pinctrl0: pinctrl@20000000 {
      compatible = "adi,adrv906x-pinctrl";
      reg = <0x20000000 0x1000>;

      pinctrl_spi0: spi0-grp {
        adi,pins = <QSPI_FLASH_CLK_PIN (ADI_CONFIG_NO_PULL)
                    QSPI_FLASH_SELB_PIN (ADI_CONFIG_ENABLE_PULLUP | ADI_CONFIG_DRIVE_STRENGTH_4)
                    QSPI_FLASH_D0_PIN (ADI_CONFIG_NO_PULL | ADI_CONFIG_DRIVE_STRENGTH_4)
                    QSPI_FLASH_D1_PIN (ADI_CONFIG_NO_PULL | ADI_CONFIG_DRIVE_STRENGTH_4)
                    QSPI_FLASH_D2_PIN (ADI_CONFIG_NO_PULL | ADI_CONFIG_DRIVE_STRENGTH_4)
                    QSPI_FLASH_D3_PIN (ADI_CONFIG_NO_PULL | ADI_CONFIG_DRIVE_STRENGTH_4)
                    QSPI_FLASH_RESETN_PIN (ADI_CONFIG_ENABLE_PULLUP | ADI_CONFIG_DRIVE_STRENGTH_4)
                    QSPI_FLOW_READY_PIN (ADI_CONFIG_NO_PULL)>;
      };
    };

    spi@30000000 {
      pinctrl-names = "default";
      pinctrl-0 = <&pinctrl_spi0>;
    };

...
```

## Documentation/devicetree/bindings/pinctrl/adi,sc5xx-pinctrl.yaml
```yaml
# SPDX-License-Identifier: (GPL-2.0-only OR BSD-2-Clause)
%YAML 1.2
---
$id: http://devicetree.org/schemas/pinctrl/adi,sc5xx-pinctrl.yaml#
$schema: http://devicetree.org/meta-schemas/core.yaml#

title: Analog Devices Pinmuxing Control for SC5XX Processor Family

maintainers:
  - Arturs Artamonovs <arturs.artamonovs@analog.com>
  - Utsav Agarwal <Utsav.Agarwal@analog.com>

description: |
  Pinmuxing Control Driver for Configuring Processor Pins/Pads

properties:
  compatible:
    enum:
      - adi,sc5xx-pinctrl
  reg:
    maxItems: 1

  "#address-cells":
    const: 1

  "#size-cells":
    const: 1

  "adi,port-sizes":
    $ref: /schemas/types.yaml#/definitions/uint32-array
    maxItems: 9
    description: Space delimited integer list denoting number of pins per port
      Ports A-I exist, so this is up to 9 items long

  "adi,no-drive-strength":
    type: boolean
    description: Indicate missing drive strength registers

  "adi,no-pull-up-down":
    type: boolean
    description: Indicate missing pull up/down enable registers

patternProperties:
  '-pins$':
    type: object
    additionalProperties: false

    properties:
      pins:
        type: object
        description: |
          A pinctrl node should contain a pin property, specifying the actual
          pins to use.

        properties:
          pinmux:
            $ref: /schemas/types.yaml#/definitions/uint32-array
            description: |
              pinmux is used to specify which of the available functionalities
              for a given pin are actually used.

        additionalProperties: false

required:
  - compatible
  - reg
  - "#address-cells"
  - "#size-cells"
  - adi,port-sizes

additionalProperties: false

examples:
  - |
    pinctrl@31004600 {
      compatible = "adi,sc5xx-pinctrl";
      #address-cells = <1>;
      #size-cells = <1>;
      reg = <0x31004600 0x400>;
      adi,port-sizes = <16 16 16 16 16 16 16 16 7>;
    };
```

## Documentation/devicetree/bindings/pinctrl/adsp,sru-ctrl.txt
```
Binding for Analog SRU Controller

Required properties:
- compatible: "adi,adsp-sru-ctrl"
- reg: Offset and length of SRU controller
- aliases: indexed via sru<0...N>

Optional properties:
- has-extended: Enables extended selection codes for 598/594

Required properties for pinmux nodes are:
 - sru-routing: A list of pinmux groups.

Example:

	aliases {
		sru0 = &sru_ctrl_dai0;
		sru1 = &sru_ctrl_dai1;
	};

	sru_ctrl_dai0: sru-ctrl-dai0@0x310C9000 {
		compatible = "adi,adsp-sru-ctrl";
		#address-cells = <1>;
		#size-cells = <1>;
		reg = <0x310C9000 0x224>;
		status = "disabled";
	};

	sru_ctrl_dai1: sru-ctrl-dai1@0x310CB000 {
		compatible = "adi,adsp-sru-ctrl";
		#address-cells = <1>;
		#size-cells = <1>;
		reg = <0x310CB000 0x224>;
		status = "disabled";
	};


	&sru_ctrl_dai0 {
		status = "okay";
		has-extended;
	};

	&sru_ctrl_dai1 {
		status = "okay";
		has-extended;

		sru_dai1: sru_dai1_mux {
			route {
				sru-routing =
					<DAI1_LOW_F          DAI1_PBEN02_I>,  /* set DAI1_PIN02 to input */
					<DAI1_PB02_O_ABCDE   SPT4_ACLK_I>,    /* route DAI1_PIN02 to SPT4_ACLK */
					<DAI1_LOW_F          DAI1_PBEN04_I>,  /* set DAI1_PIN04 to input */
					<DAI1_PB04_O_ABCDE   SPT4_AFS_I>,     /* route DAI1_PIN04 to SPT4_AFS */
					<DAI1_HIGH_F         DAI1_PBEN01_I>,  /* set DAI1_PIN01 to output */
					<SPT4_AD0_O_BD       DAI1_PB01_I>,    /* route SPT4_AD0 to DAI1_PIN01 */
					<DAI1_LOW_F          DAI1_PBEN12_I>,  /* set DAI1_PIN12 to input */
					<DAI1_PB12_O_ABCDE   SPT4_BCLK_I>,    /* route DAI1_PIN12 to SPT4_BCLK */
					<DAI1_LOW_F          DAI1_PBEN20_I>,  /* set DAI1_PIN20 to input */
					<DAI1_PB20_O_ABCDE   SPT4_BFS_I>,     /* route DAI1_PIN20 to SPT4_BFS */
					<DAI1_LOW_F          DAI1_PBEN06_I>,  /* set DAI1_PIN06 to input */
					<DAI1_PB06_O_ABCDE   SPT4_BD0_I>;     /* route DAI1_PIN06 to SPT4_BD0 */
			};
		};
	};

	&i2s {
		pinctrl-names = "default";
		pinctrl-0 = <&sru_dai1>;
	}
```
