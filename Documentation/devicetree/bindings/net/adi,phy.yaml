## Documentation/devicetree/bindings/net/open-alliance.yaml
```yaml
// SPDX-License-Identifier: (GPL-2.0+ OR BSD-3-Clause)
%YAML 1.2
---
$id: http://devicetree.org/schemas/net/open-alliance.yaml#
$schema: http://devicetree.org/meta-schemas/core.yaml#

title: Open Alliance Generic Binding

maintainers:
  - Alexandru Tachici <alexandru.tachici@analog.com>

description:
  Generic Open Alliance TC6-10BASE-T1x MACPHY Serial Interface
  bindings.

properties:
  $nodename:
    pattern: "^ethernet(@.*)?$"

  "#address-cells":
    const: 1

  "#size-cells":
    const: 0

  open-alliance-chunk-size:
    description:
      Data chunk payload size in bytes.
    $ref: /schemas/types.yaml#/definitions/uint32
    enum: [8, 16, 32, 64]
    default: 64

  open-alliance-protected:
    description:
      Enable Open Alliance protected control headers. Control reads
      and writes are checked by the host and devices but will take
      more SPI cycles.
    type: boolean

examples:
  - |
    ethernet@0 {
      compatible = "adi,adin1110";
      reg = <0>;
      spi-max-frequency = <1000000>;

      open-alliance;
      open-alliance-protected;

      #address-cells = <1>;
      #size-cells = <0>;

      interrupt-parent = <&gpio>;
      interrupts = <25 2>;
      mac-address = [ CA 2F B7 10 23 63 ];

      phy@0 {
        compatible = "ethernet-phy-id0283.bc91";
        reg = <0x0>;
      };
    };
```

## Documentation/devicetree/bindings/net/wireless/nxp,wifi-wake-host.yaml
```yaml
# SPDX-License-Identifier: (GPL-2.0-only OR BSD-2-Clause)
%YAML 1.2
---
$id: http://devicetree.org/schemas/net/wireless/nxp,wifi-wake-host.yaml#
$schema: http://devicetree.org/meta-schemas/core.yaml#

title: NXP 89xx wireless devices

maintainers:
  - Sherry Sun <sherry.sun@nxp.com>

description:
  This node provides properties for controlling the NXP 89XX wireless device.
  The node is expected to be specified as a child node to the PCIE/SDIO
  controller that connects the device to the system.

properties:
  compatible:
    const: nxp,wifi-wake-host

  interrupts:
    maxItems: 1
    description: |
      Specifies attributes for the out-of-band interrupt (host-wake).

  interrupt-names:
    const: host-wake
    description: |
      Name of the out-of-band interrupt, which must be set to "host-wake".

required:
  - compatible
  - interrupts
  - interrupt-names

additionalProperties: false

examples:
  - |
    #include <dt-bindings/clock/imx8mq-clock.h>

    pcie1 {
      pinctrl-names = "default";
      pinctrl-0 = <&pinctrl_pcie1>;
      disable-gpio = <&gpio5 10 1>;
      reset-gpio = <&gpio5 12 1>;
      clocks = <&clk IMX8MQ_CLK_PCIE2_ROOT>,
               <&clk IMX8MQ_CLK_PCIE2_AUX>,
               <&clk IMX8MQ_CLK_PCIE2_PHY>,
               <&pcie1_refclk>;
      clock-names = "pcie", "pcie_aux", "pcie_phy", "pcie_bus";
      assigned-clocks = <&clk IMX8MQ_CLK_PCIE2_AUX>,
                        <&clk IMX8MQ_CLK_PCIE1_PHY>,
                        <&clk IMX8MQ_CLK_PCIE1_CTRL>;
      assigned-clock-rates = <10000000>, <100000000>, <250000000>;
      assigned-clock-parents = <&clk IMX8MQ_SYS2_PLL_50M>,
                               <&clk IMX8MQ_SYS2_PLL_100M>,
                               <&clk IMX8MQ_SYS2_PLL_250M>;
      vph-supply = <&vgen5_reg>;
      status = "okay";

      wifi_wake_host {
        compatible = "nxp,wifi-wake-host";
        interrupt-parent = <&gpio5>;
        interrupts = <11 8>;
        interrupt-names = "host-wake";
      };
    };
```

## Documentation/devicetree/bindings/nvmem/adi,axi-sysid.yaml
```yaml
# SPDX-License-Identifier: (GPL-2.0-only OR BSD-2-Clause)
%YAML 1.2
---
$id: http://devicetree.org/schemas/nvmem/adi,axi-sysid.yaml#
$schema: http://devicetree.org/meta-schemas/core.yaml#

title: Analog Devices AXI System ID

maintainers:
  - Michael Hennerich <michael.hennerich@analog.com>

description:
  The AXI System ID core provides a unique system identification for FPGA
  designs, accessible via NVMEM.

allOf:
  - $ref: nvmem.yaml#

properties:
  compatible:
    enum:
      - adi,axi-sysid-1.00.a

  reg:
    maxItems: 1

required:
  - compatible
  - reg

unevaluatedProperties: false

examples:
  - |
    axi_sysid_0: axi-sysid-0@45000000 {
        compatible = "adi,axi-sysid-1.00.a";
        reg = <0x45000000 0x10000>;
    };
...
```

## Documentation/devicetree/bindings/nvmem/adi_axi_sysid.txt
```
* Analog Devices AXI System ID Support

Required properties:
  - compatible: Should be "adi,axi-sysid-1.00.a"
  - reg: Must contain an entry with the physical base address and lenght

See nvmem.txt for more information.

Example:
	axi_sysid_0: axi-sysid-0@45000000 {
		compatible = "adi,axi-sysid-1.00.a";
		reg = <0x45000000 0x10000>;
	};
```

## Documentation/devicetree/bindings/pci/fsl,imx6q-pcie.txt
```
* Freescale i.MX6 PCIe interface

This PCIe host controller is based on the Synopsys DesignWare PCIe IP
and thus inherits all the common properties defined in designware-pcie.txt.

Required properties:
- compatible:
	- "fsl,imx6q-pcie"
	- "fsl,imx6sx-pcie",
	- "fsl,imx6qp-pcie"
	- "fsl,imx7d-pcie"
	- "fsl,imx8qm-pcie"
	- "fsl,imx8mq-pcie"
- reg: base address and length of the PCIe controller
- interrupts: A list of interrupt outputs of the controller. Must contain an
  entry for each entry in the interrupt-names property.
- interrupt-names: Must include the following entries:
	- "msi": The interrupt that is asserted when an MSI is received
- clock-names: Must include the following additional entries:
	- "pcie_phy"
- ext_osc: use the external oscillator or not.

Optional properties:
- fsl,tx-deemph-gen1: Gen1 De-emphasis value. Default: 0
- fsl,tx-deemph-gen2-3p5db: Gen2 (3.5db) De-emphasis value. Default: 0
- fsl,tx-deemph-gen2-6db: Gen2 (6db) De-emphasis value. Default: 20
- fsl,tx-swing-full: Gen2 TX SWING FULL value. Default: 127
- fsl,tx-swing-low: TX launch amplitude swing_low value. Default: 127
- fsl,max-link-speed: Specify PCI gen for link capability. Must be '2' for
  gen2, otherwise will default to gen1. Note that the IMX6 LVDS clock outputs
  do not meet gen2 jitter requirements and thus for gen2 capability a gen2
  compliant clock generator should be used and configured.
- reset-gpio: Should specify the GPIO for controlling the PCI bus device reset
  signal. It's not polarity aware and defaults to active-low reset sequence
  (L=reset state, H=operation state).
- reset-gpio-active-high: If present then the reset sequence using the GPIO
  specified in the "reset-gpio" property is reversed (H=reset state,
  L=operation state).
- vpcie-supply: Should specify the regulator in charge of PCIe port power.
  The regulator will be enabled when initializing the PCIe host and
  disabled either as part of the init process or when shutting down the
  host.

Additional required properties for imx6sx-pcie:
- clock names: Must include the following additional entries:
	- "pcie_inbound_axi"

Additional required properties for imx7d-pcie:
- power-domains: Must be set to a phandle pointing to PCIE_PHY power domain
- resets: Must contain phandles to PCIe-related reset lines exposed by SRC
  IP block
- reset-names: Must contain the following entires:
	       - "pciephy"
	       - "apps"

Additional required properties for imx8 pcie:
- hsio : should be <&hsio>.
   The phandle points to the hsio region containing the hsio
   such as the pcie and sata control registers.
- hsio-cfg: hsio configration mode when the pcie node is supported.
  mode 1: pciea 2 lanes and one sata ahci port.
  mode 2: pciea 1 lane, pcieb 1 lane and one sata ahci port.
  mode 3: pciea 2 lanes, pcieb 1 lane.
- ctrl-id: used to distinguish pciea or pcieb.
  0: pciea, 1: pcieb.
- cpu-base-addr: the base cpu address mapped from hsio address.
	Example:
		hsio-cfg = <PCIEAX1PCIEBX1SATA>;
		hsio = <&hsio>;
		ctrl-id = <0>; /* pciea */
		cpu-base-addr = <0x40000000>;

Example:

	pcie@0x01000000 {
		compatible = "fsl,imx6q-pcie", "snps,dw-pcie";
		reg = <0x01ffc000 0x04000>,
		      <0x01f00000 0x80000>;
		reg-names = "dbi", "config";
		#address-cells = <3>;
		#size-cells = <2>;
		device_type = "pci";
		ranges = <0x00000800 0 0x01f00000 0x01f00000 0 0x00080000
			  0x81000000 0 0          0x01f80000 0 0x00010000
			  0x82000000 0 0x01000000 0x01000000 0 0x00f00000>;
		num-lanes = <1>;
		interrupts = <GIC_SPI 120 IRQ_TYPE_LEVEL_HIGH>;
		interrupt-names = "msi";
		#interrupt-cells = <1>;
		interrupt-map-mask = <0 0 0 0x7>;
		interrupt-map = <0 0 0 1 &intc GIC_SPI 123 IRQ_TYPE_LEVEL_HIGH>,
		                <0 0 0 2 &intc GIC_SPI 122 IRQ_TYPE_LEVEL_HIGH>,
		                <0 0 0 3 &intc GIC_SPI 121 IRQ_TYPE_LEVEL_HIGH>,
		                <0 0 0 4 &intc GIC_SPI 120 IRQ_TYPE_LEVEL_HIGH>;
		clocks = <&clks 144>, <&clks 206>, <&clks 189>;
		clock-names = "pcie", "pcie_bus", "pcie_phy";
	};
```

## Documentation/devicetree/bindings/perf/adi,dmc-pmu.yaml
```yaml
# SPDX-License-Identifier: (GPL-2.0-only OR BSD-2-Clause)
%YAML 1.2
---
$id: http://devicetree.org/schemas/perf/adi,dmc-pmu.yaml#
$schema: http://devicetree.org/meta-schemas/core.yaml#

title: Analog Devices DMC+PMU driver for SC59x 64-bit Family Processors

maintainers:
  - Nathan Barrett-Morrison <nathan.morrison@timesys.com>
  - Greg Malysa <greg.malysa@timesys.com>

description: |
  Performance Monitor Driver (PMU) to expose
  Dynamic Memory Controller (DMC) statistics to the kernel

properties:
  compatible:
    enum:
      - adi,dmc-pmu

  reg:
    maxItems: 1

required:
  - compatible
  - reg

additionalProperties: false

examples:
  - |
    dmc_pmu: dmc-pmu@31070000 {
      compatible = "adi,dmc-pmu";
      reg = <0x31070000 0x200>;
      status = "okay";
    };
```

## Documentation/devicetree/bindings/phy/fsl,imx8mp-lvds-phy.yaml
```yaml
# SPDX-License-Identifier: GPL-2.0
# Copyright 2020 NXP
%YAML 1.2
---
$id: http://devicetree.org/schemas/phy/fsl,imx8mp-lvds-phy.yaml#
$schema: http://devicetree.org/meta-schemas/core.yaml#

title: Freescale i.MX8MP LVDS PHY Device Tree Bindings

maintainers:
  - Liu Ying <victor.liu@nxp.com>

description: |
  LVDS PHY found on i.MX8MP, i.MX93 and i.MX95 SoCs.  i.MX8MP LVDS PHY IP contains
  two PHYs, each of which supports a four data lane LVDS channel.  i.MX93
  LVDS PHY IP contains one PHY. i.MX95 LVDS PHY IP contains two PHYs
  and the two PHYs have different registers offset.

properties:
  compatible:
    enum:
      - fsl,imx8mp-lvds-phy
      - fsl,imx93-lvds-phy
      - fsl,imx95-lvds0-phy
      - fsl,imx95-lvds1-phy

  "#address-cells":
    const: 1

  "#size-cells":
    const: 0

  gpr:
    $ref: /schemas/types.yaml#/definitions/phandle
    description: phandle to block control syscon

  clocks:
    maxItems: 1

  clock-names:
    items:
      - const: apb

  power-domains:
    maxItems: 1

  port@0:
    type: object
    description: A port node pointing to the PHY instance0's port node
    properties:
      reg:
        maxItems: 1
        description: PHY instance number.
      "#phy-cells":
        const: 0

    required:
      - reg
      - "#phy-cells"

  port@1:
    type: object
    description: A port node pointing to the PHY instance1's port node
    properties:
      reg:
        maxItems: 1
        description: PHY instance number
      "#phy-cells":
        const: 0

    required:
      - reg
      - "#phy-cells"

required:
  - compatible
  - "#address-cells"
  - "#size-cells"
  - gpr
  - clocks
  - clock-names
  - power-domains
  - port@0

allOf:
  - if:
      properties:
        compatible:
          contains:
            const: fsl,imx8mp-lvds-phy
    then:
      required:
        - port@1

  - if:
      properties:
        compatible:
          contains:
            enum:
              - fsl,imx93-lvds-phy
              - fsl,imx95-lvds0-phy
              - fsl,imx95-lvds1-phy
    then:
      properties:
        port@1: false

additionalProperties: false

examples:
  - |
    #include <dt-bindings/clock/imx8mp-clock.h>
    ldb_phy: phy@32ec0128 {
        compatible = "fsl,imx8mp-lvds-phy";
        #address-cells = <1>;
        #size-cells = <0>;
        gpr = <&mediamix_blk_ctl>;
        clocks = <&clk IMX8MP_CLK_MEDIA_APB_ROOT>;
        clock-names = "apb";
        power-domains = <&mediamix_pd>;

        ldb_phy1: port@0 {
            reg = <0>;
            #phy-cells = <0>;
        };

        ldb_phy2: port@1 {
            reg = <1>;
            #phy-cells = <0>;
        };
    };

...
```

## Documentation/devicetree/bindings/phy/fsl,imx93-mipi-dphy.yaml
```yaml
# SPDX-License-Identifier: (GPL-2.0 OR BSD-2-Clause)
%YAML 1.2
---
$id: http://devicetree.org/schemas/phy/fsl,imx93-mipi-dphy.yaml#
$schema: http://devicetree.org/meta-schemas/core.yaml#

title: Freescale i.MX93 Synopsys DesignWare MIPI DPHY

maintainers:
  - Liu Ying <victor.liu@nxp.com>

properties:
  compatible:
    items:
      - enum:
        - fsl,imx93-mipi-dphy
        - fsl,imx95-dphy-rx
        - fsl,imx95-combo-rx

  "#phy-cells":
    const: 0

  clocks:
    items:
      - description: PHY configuration clock
      - description: PHY reference clock

  clock-names:
    items:
      - const: phy_cfg
      - const: phy_ref

  power-domains:
    maxItems: 1

  assigned-clocks:
    maxItems: 1

  assigned-clock-parents:
    maxItems: 1

  assigned-clock-rates:
    maxItems: 1

  fsl,csis:
    description:
      Must be the device tree identifier of the CSI memory map. This is required only
      for the i.MX95 CSI standalone dphy-rx driver.
    maxItems: 1

  fsl,reg-offset:
    description:
      Register offset, in hex, in the register map, where the driver can access its
      relevant registers.
    maxItems: 1

  fsl,dsi:
    description:
      Must be the device tree identifier of the DSI memory map. This is required only
      for the CSI/DSI combo driver, where CSI shares the same combo phy with the DSI.
    maxItems: 1

required:
  - compatible
  - "#phy-cells"
  - clocks
  - clock-names
  - power-domains

additionalProperties: false

examples:
  - |
    #include <dt-bindings/clock/imx93-clock.h>
    #include <dt-bindings/power/fsl,imx93-power.h>

    dphy: dphy {
        compatible = "fsl,imx93-mipi-dphy";
        clocks = <&clk IMX93_CLK_MIPI_PHY_CFG>, <&clk IMX93_CLK_24M>;
        clock-names = "phy_cfg", "phy_ref";
        assigned-clocks = <&clk IMX93_CLK_MIPI_PHY_CFG>;
        assigned-clock-parents = <&clk IMX93_CLK_24M>;
        assigned-clock-rates = <24000000>;
        #phy-cells = <0>;
        power-domains = <&media_blk_ctrl IMX93_MEDIABLK_PD_MIPI_DSI>;
    };

...
```
