## Documentation/devicetree/bindings/net/adi,phy.yaml
```yaml
# SPDX-License-Identifier: GPL-2.0-or-later
%YAML 1.2
---
$id: http://devicetree.org/schemas/net/adi,phy.yaml#
$schema: http://devicetree.org/meta-schemas/core.yaml#

title: Analog Devices 10/25Gigabit Ethernet PHY

maintainers:
  - Slawomir Kulig <slawomir.kulig@analog.com>

description:
  Bindings for Analog Devices 10/25Gigabit Ethernet PHYs

allOf:
  - $ref: mdio.yaml#

properties:
  compatible:
    const: adi,adrv906x-mdio
  reg:
    description: The register range of the pseudo MDIO controller instance

required:
  - compatible
  - reg
  - "#address-cells"
  - "#size-cells"

patternProperties:
  "^ethernet-phy@[0-9a-f]+$":
    type: object

    properties:
      reg:
        minimum: 0
        maximum: 31
        description:
          The ID number for the device.

      compatible:
        const: ethernet-phy-ieee802.3-c45
        description:
          PHY implements IEEE802.3 clause 45

    required:
      - reg
      - compatible

unevaluatedProperties: false

examples:
  - |
	adi_mdio: mdio@EMAC_PCS_0_BASE_UADDR {
		#address-cells = <1>;
		#size-cells = <0>;
		compatible = "adi,adrv906x-mdio";
		reg = <EMAC_PCS_0_BASE 0x350 EMAC_PCS_1_BASE 0x350>;
		adi_phy0: ethernet-phy@0 {
			compatible = "ethernet-phy-ieee802.3-c45";
			reg = <0>;
		};
		adi_phy1: ethernet-phy@1 {
			compatible = "ethernet-phy-ieee802.3-c45";
			reg = <1>;
		};
	};
```

## Documentation/devicetree/bindings/net/corundum,mqnic.yaml
```yaml
# SPDX-License-Identifier: BSD-2-Clause-Views
# Copyright (c) 2019-2024 The Regents of the University of California
%YAML 1.2
---
$id: "http://devicetree.org/schemas/net/corundum,mqnic.yaml#"
$schema: http://devicetree.org/meta-schemas/core.yaml#

title: Corundum mqnic Ethernet controller

maintainers:
  - Alex Forencich <alex@alexforencich.com>

description: |
  The Corundum mqnic is an open-source multi-queue network interface controller
  for FPGA platforms.

properties:
  compatible:
    enum:
      - corundum,mqnic

  reg:
    description: >
      Address and length of the "control" register set. Optionally a second and
      third range, the "app" and "ram" register sets may be added.

  reg-names:
    description: >
      Names for each register region in 'reg'.

  interrupts:
    minItems: 1
    description: >
      Should contain mqnic interrupt(s)

  nvmem-cells:
    description: >
      Phandle of nvmem cell containing the base MAC address

  nvmem-cell-names:
    const: mac-address
    description: >
      Should be "mac-address"

  mac-address-increment-byte:
    $ref: /schemas/types.yaml#/definitions/uint32
    description: >
      Index of base MAC address byte to increment (default: 0x5)

  mac-address-increment:
    $ref: /schemas/types.yaml#/definitions/uint32
    description: >
      Number to add to the chosen base MAC address byte (default: 0x0)

  mac-address-local:
    type: boolean
    description: >
      Boolean, mark derived MAC addresses as "locally administrated"
      (default: false)

  module-eeproms:
    $ref: /schemas/types.yaml#/definitions/phandle
    description: >
      Array of phandles to SFP module EEPROM node(s)

required:
  - compatible
  - reg
  - interrupts

additionalProperties: false

examples:
  - |
    mqnic0: ethernet@a0000000 {
      compatible = "corundum,mqnic";
      reg = <0x0 0xa0000000 0x0 0x1000000>,
            <0x0 0xb0000000 0x0 0x1000000>;
      reg-names = "csr", "app";
      interrupt-parent = <&gic>;
      interrupts = <0x0 0x59 0x1>;

      nvmem-cells = <&macaddress>;
      nvmem-cell-names = "mac-address";

      mac-address-increment = <0x1>;
      mac-address-local;

      module-eeproms = <&module_eeprom_sfp0>;
    };

    eeprom {
      #address-cells = <1>;
      #size-cells = <1>;

      macaddress: macaddress@20 {
        reg = <0x20 0x06>;
      };
    };
```

## Documentation/devicetree/bindings/net/fsl,netc.yaml
```yaml
# SPDX-License-Identifier: (GPL-2.0-only OR BSD-2-Clause)
%YAML 1.2
---
$id: http://devicetree.org/schemas/net/fsl,netc.yaml#
$schema: http://devicetree.org/meta-schemas/core.yaml#

title: NXP Ethernet controller (NETC)

maintainers:
  - Wei Fang <wei.fang@nxp.com>
  - Clark Wang <xiaoning.wang@nxp.com>
  - Shawn Guo <shawnguo@kernel.org>
  - NXP Linux Team <linux-imx@nxp.com>

description: |
  NETC is a TSN capable Ethernet IP, which enables a comprehensive portfolio
  of Ethernet solutions. The NIC functionality in NETC is known as EtherNET
  Controller (ENETC). ENETC supports virtualization/isolation based on PCIe
  Single Root IO Virtualization (SR-IOV), advanced QoS with 8 traffic classes
  and 4 discard resilience levels, and a full range of TSN standards and NIC
  offload capabilities.

  NETC presents itself as a multi-function PCIe Root Complex Integrated Endpoint
  (RCiEP) for easy software discovery of peripheral functions. As such, it
  contains multiple PCIe functions. NETC also hosts PCIe functions for other
  related Ethernet functions, such as the Timer (IEEE 1588 and 802.1AS-2020)
  and MDIO (for managing external Ethernet PHY devices via an MDIO interface).
  NETC also connects to the Root Complex Event Collector (RCEC) to convey power
  management and error messages.

  In addition, there are two 64KB register blocks in NETC, one is Integrated
  Endpoint Register Block(IERB), the other is Privileged Register Block (PRB).
  IERB is used for pre-boot initialization, debug and non-customer configuration.
  PRB is used for reset control and error handling during functional operation.

  Notice that, this schema file only applies to NETC V4.1 and later versions,
  and is currently not applicable to NETC V1.0.

properties:
  compatible:
    oneOf:
      - items:
          - const: fsl,imx95-enetc
      - items:
          - const: fsl,imx95-netc-timer
      - items:
          - const: fsl,imx95-netc-emdio
      - items:
          - const: fsl,imx95-netc-prb-ierb

required:
  - compatible
  - reg

allOf:
  - if:
      properties:
        compatible:
          contains:
            const: fsl,imx95-enetc
    then:
        $ref: ethernet-controller.yaml#
        properties:
          reg:
            maxItems: 1
            description: |
              PCI address of the ENETC instance. As defined in the PCI Bus Binding
              reference, the reg property is a five-cell address encoded as (phys.hi
              phys.mid phys.lo size.hi size.lo). phys.hi should contain the device's
              BDF as 0b00000000 bbbbbbbb dddddfff 00000000. The other cells should be
              zero. See Documentation/devicetree/bindings/pci/pci.txt

          clocks:
            minItems: 1
            items:
             - description: NETC system clock
             - description: RGMII/RMII interface reference clock

          clock-names:
            minItems: 1
            items:
              - const: ipg_clk
              - const: enet_ref_clk

          phy-mode: true

          phy-handle: true

          fixed-link: true

          managed: true

          mdio:
            $ref: mdio.yaml#
            unevaluatedProperties: false
            description: |
              optional node for ENETC instance, otherwise use NETC EMDIO.

        required:
          - clocks

  - if:
      properties:
        compatible:
          contains:
            const: fsl,imx95-netc-timer
    then:
      properties:
        reg:
          maxItems: 1
          description: |
            PCI address of the NETC PTP Timer. As defined in the PCI Bus Binding
            reference, the reg property is a five-cell address encoded as (phys.hi
            phys.mid phys.lo size.hi size.lo). phys.hi should contain the device's
            BDF as 0b00000000 bbbbbbbb dddddfff 00000000. The other cells should be
            zero. See Documentation/devicetree/bindings/pci/pci.txt

        clocks:
          maxItems: 1

        clock-names:
          maxItems: 1
          items:
            enum:
              - ptp_clk

        fsl,clk-select:
          $ref: /schemas/types.yaml#/definitions/uint32
          description: |
            The NETC PTP Timer has three 1588 reference clocks, two are from
            internal PLL, and one is from external crystal oscillator. So this
            property is used to set TMR_CTRL[CK_SEL] field to select expected
            reference clock.
            0 indicates the reference clock comes from enet_timer1_clk_root.
            1 indicates the reference clock comes from enet_clk_root/2.
            2 indicates the reference clock comes from external crystal oscillator.
            If this property is not presented, the driver will use the default
            reference clock which comes from enet_clk_root.
          enum: [0, 1, 2]

        fsl,oclk-prsc:
          $ref: /schemas/types.yaml#/definitions/uint32
          description: |
            The NETC PTP Timer has the capability to generate output FIPER pulse
            clock (TMR_GCLK), and its frequency is by dividing the timer input
            clock by TMR_PRSC[PRSC_OCK]. Therefore, this property is used to
            set the output clock division prescale factor, namely the value of
            TMR_PRSC[PRSC_OCK]. Notice that, the factor must be an even value.
            If this property is not presented, the default factor is 2.

        fsl,clk-cfg:
          $ref: /schemas/types.yaml#/definitions/uint32-array
          minItems: 3
          maxItems: 3
          description: |
            This property is an array with three elements and provides the period
            information of the reference clock, the first element indicates the
            frequency of the clock, the unit is MHz, the second element indicates
            the integral part of the clock period, and the third elemet indicates
            the fractional part of the clock period.
            If this property is not presented, then the NETC PTP timer is assumed
            to be using enet_clk_root/2 as the reference clock, and the related
            clock information will be gotten from NETCCLKFR and NETCCLKCR of IERB.

  - if:
      properties:
        compatible:
          contains:
            const: fsl,imx95-netc-emdio
    then:
      $ref: mdio.yaml#
      properties:
        reg:
          maxItems: 1
          description: |
            PCI address of the NETC external MDIO. As defined in the PCI Bus Binding
            reference, the reg property is a five-cell address encoded as (phys.hi
            phys.mid phys.lo size.hi size.lo). phys.hi should contain the device's
            BDF as 0b00000000 bbbbbbbb dddddfff 00000000. The other cells should be
            zero. See Documentation/devicetree/bindings/pci/pci.txt

  - if:
      properties:
        compatible:
          contains:
            const: fsl,imx95-netc-prb-ierb
    then:
      properties:
        reg:
          minItems: 2
          maxItems: 2

        reg-names:
          items:
            - const: ierb_base
            - const: prb_base

        power-domains:
          maxItems: 1

      required:
        - reg-names

unevaluatedProperties: false

examples:
  - |
    pcie0 {
      #address-cells = <3>;
      #size-cells = <2>;

      enetc_port0: ethernet@0,0 {
        compatible = "fsl,imx95-enetc";
        reg = <0x000000 0 0 0 0>;
        clocks = <&clk 98>,
                 <&clk 102>;
        clock-names = "ipg_clk", "enet_ref_clk";
        pinctrl-names = "default";
        pinctrl-0 = <&pinctrl_enetc0>;
        phy-handle = <&ethphy0>;
        phy-mode = "rgmii";
      };

      enetc_port2: ethernet@10,0 {
        compatible = "fsl,imx95-enetc";
        reg = <0x008000 0 0 0 0>;
        clocks = <&clk 98>;
        clock-names = "ipg_clk";
        phy-handle = <&ethphy2>;
        phy-mode = "usxgmii";
        managed = "in-band-status";
      };

      ethernet@18,0 {
        compatible = "fsl,imx95-netc-timer";
        reg = <0x00c000 0 0 0 0>;
        fsl,clk-select = <1>;
        fsl,oclk-prsc = <2>;
        fsl,clk-cfg = <0x14d 0x3 0xcece07>;
      };
    };
  - |
    pcie1 {
      #address-cells = <3>;
      #size-cells = <2>;

      netc_emdio: mdio@0,0 {
        compatible = "fsl,imx95-netc-emdio";
        reg = <0x010000 0 0 0 0>;
        #address-cells = <1>;
        #size-cells = <0>;

        ethphy0: ethernet-phy@1 {
          reg = <1>;
          eee-broken-1000t;
          reset-gpios = <&i2c5_gpio_expander_21 2 1>;
          reset-assert-us = <10000>;
          reset-deassert-us = <80000>;
        };

        ethphy2: ethernet-phy@8 {
          reg = <8>;
        };
      };
    };
  - |
    netc_prb_ierb@4cde0000 {
      compatible = "fsl,imx95-netc-prb-ierb";
      reg = <0x4cde0000 0x10000>, <0x4cdf0000 0x10000>;
      reg-names = "ierb_base", "prb_base";
      power-domains = <&scmi_devpd 18>;
    };
```

## Documentation/devicetree/bindings/net/ieee802154/adf7242.txt
```
* Analog Devices ADF7242 IEEE 802.15.4 radio *

Required properties:
	- compatible: should be "adi,adf7242"
	- reg: SPI chip select number for the device
	- spi-max-frequency: Max SPI frequency to use (< 10000000)
	- interrupts: The interrupt number to the cpu. The interrupt specifier format
	              depends on the interrupt controller.

Optional properties:
	- adi,hw-aack-mode-enable: Enable automatic packet acknowledgement
	- adi,auto-csma-ca-mode-enable: Enable automatic CSMA-CA Tx mode
	- adi,promiscuous-mode-enable: Enable promiscuous mode
	- adi,report-ack-frames-enable: Report Ack frames
	- adi,max-frame-retries: Specifies the number of attempts to retransmit
	                         unacknowledged frames while in automatic CSMA-CA
	                         Tx mode (valid: [0-15], default: 4)
	- adi,max-cca-retries: Specifies the number of attempts to repeat CSMA-CA
	                       algorithm prior to cancellation of RC_TX command
	                       (valid: [0-5], default: 4, disable CSMA-CA: 7)
	- adi,max-csma-back-off-exponent: Specifies the maximum back-off exponent
	                                  used in the CSMA-CA algorithm
	                                  (valid: [4-8], default: 6)
	- adi,min-csma-back-off-exponent: Specifies the minimum back-off exponent
	                                  used in the CSMA-CA algorithm
	                                  (valid: [0-max], default: 1)

Example:

	adf7242@0 {
		compatible = "adi,adf7242";
		reg = <0>;
		spi-max-frequency = <10000000>;
		interrupts = <0x62 IRQ_TYPE_LEVEL_HIGH>;

		adi,hw-aack-mode-enable;
		adi,auto-csma-ca-mode-enable;
	};
```

## Documentation/devicetree/bindings/net/imx-shmem-net.txt
```
i.MX SHMEM-NET implementations

A network device to communicate with another domain.
Communication is done through shared memory
 and synchronized by Mailbox Units of imx.
Use Mailbox Units side A to communicate with side B.

Required properties:
- compatible : "fsl,imx-shmem-net".
- rxfirst: The flag that indicates the position of the RX buffer,
  one of the two partitions must set it.
- mub-partition: The id number of the remote processors,
  used on i.mx8qm for partition reset. The default
  value is 3 in driver without this property.
- mbox-names: the mailbox channel names.
- mboxes: the mailboxes list containing:
  MU name, channel type (0 for TX, 1 for RX) and channel id.
- memory-region: the coherent memory shared across domains.

=====================================================================

Example:

imx_shmem_net: imx_shmem_net {
	compatible = "fsl,imx-shmem-net";
	mub-partition = <1>;
	mbox-names = "tx", "rx";
	mboxes = <&lsio_mu8b 0 1
			  &lsio_mu8b 1 1>;
	status = "disabled";
};

&imx_shmem_net{
	memory-region = <&shmem_dma_reserved>;
	status = "okay";
};
```
