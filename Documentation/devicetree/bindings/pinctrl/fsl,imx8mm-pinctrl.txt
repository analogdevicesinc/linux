## Documentation/devicetree/bindings/power/supply/maxim,max1720x.yaml
```yaml
# SPDX-License-Identifier: (GPL-2.0-only OR BSD-2-Clause)
%YAML 1.2
---
$id: "http://devicetree.org/schemas/power/supply/maxim,max1720x.yaml#"
$schema: "http://devicetree.org/meta-schemas/core.yaml#"

title: Maxim ModelGauge m5 Fuel Gauge family (MAX17201/5, MAX1733x series)

maintainers:
  - "Joan Na <joan.na@analog.com>"

description: |
  Bindings for Maxim Integrated ModelGauge m5 stand-alone fuel gauge ICs.
  This includes MAX17201, MAX17205, MAX17300/1/2/3, MAX17320, MAX17330/32/35.

properties:
  compatible:
    enum:
      - "maxim,max17201"
      - "maxim,max17205"
      - "maxim,max17300"
      - "maxim,max17301"
      - "maxim,max17302"
      - "maxim,max17303"
      - "maxim,max17320"
      - "maxim,max17330"
      - "maxim,max17332"
      - "maxim,max17335"

  reg:
    description: I2C address of the device
    maxItems: 1

  maxim,rsense:
    description: Rsense register value in milliohms
    $ref: /schemas/types.yaml#/definitions/uint32

  maxim,talrt-min:
    description: Lower temperature limit (in degree Celsius) to trigger ALRT1
    $ref: /schemas/types.yaml#/definitions/int32

  maxim,talrt-max:
    description: Upper temperature limit (in degree Celsius) to trigger ALRT1
    $ref: /schemas/types.yaml#/definitions/int32

  maxim,valrt-min:
    description: Lower voltage limit (in mV) to trigger ALRT1
    $ref: /schemas/types.yaml#/definitions/uint32

  maxim,valrt-max:
    description: Upper voltage limit (in mV) to trigger ALRT1
    $ref: /schemas/types.yaml#/definitions/uint32

  maxim,salrt-min:
    description: Lower SOC (State of Charge) limit (in %) to trigger ALRT1
    $ref: /schemas/types.yaml#/definitions/uint32

  maxim,salrt-max:
    description: Upper SOC (State of Charge) limit (in %) to trigger ALRT1
    $ref: /schemas/types.yaml#/definitions/uint32

  maxim,ialrt-min:
    description: Lower current limit (in mA) to trigger ALRT1
    $ref: /schemas/types.yaml#/definitions/int32

  maxim,ialrt-max:
    description: Upper current limit (in mA) to trigger ALRT1
    $ref: /schemas/types.yaml#/definitions/int32

  status:
    enum: [ "okay", "disabled" ]

required:
  - compatible
  - reg
  
additionalProperties: false

examples:
  - |
    fuel-gauge@36 {
      compatible = "maxim,max17335";
      status = "okay";
      reg = <0x36>;
      interrupt-parent = <&gpio>;
      interrupts = <16 0>;
      maxim,rsense = <5>;
      maxim,talrt-min = <0>;
      maxim,talrt-max = <50>;
      maxim,valrt-min = <3000>;
      maxim,valrt-max = <4500>;
      maxim,salrt-min = <1>;
      maxim,salrt-max = <99>;
      maxim,ialrt-min = <(-5000)>;
      maxim,ialrt-max = <5000>;
    };
```

## Documentation/devicetree/bindings/power/supply/maxim,max77840-charger-detect.yaml
```yaml
# SPDX-License-Identifier: GPL-2.0
%YAML 1.2
---
$id: http://devicetree.org/schemas/power/supply/maxim,max77840-charger-detect.yaml#
$schema: http://devicetree.org/meta-schemas/core.yaml#

title: Maxim MAX77840 Charger Detect

maintainers:
  - Joan Na <joan.na@analog.com>

properties:
  compatible:
    const: maxim,max77840-charger-detect

required:
  - compatible

additionalProperties: false

examples:
  - |
        charger {
                compatible = "maxim,max77840-charger-detect";
        };
```

## Documentation/devicetree/bindings/power/supply/maxim,max77840-charger.yaml
```yaml
# SPDX-License-Identifier: GPL-2.0
%YAML 1.2
---
$id: http://devicetree.org/schemas/power/supply/maxim,max77840-charger.yaml#
$schema: http://devicetree.org/meta-schemas/core.yaml#

title: Maxim MAX77840 Charger

maintainers:
  - Joan Na <joan.na@analog.com>s

properties:
  compatible:
    const: maxim,max77840-charger

  fast_charge_timer:
    description: Fast charge timer in hours
    $ref: /schemas/types.yaml#/definitions/uint32

  fast_charge_current:
    description: Fast charge current in milliamps
    $ref: /schemas/types.yaml#/definitions/uint32

  charge_termination_voltage:
    description: Charge termination (CV) voltage in millivolts
    $ref: /schemas/types.yaml#/definitions/uint32

  topoff_timer:
    description: Top-off timer in minutes
    $ref: /schemas/types.yaml#/definitions/uint32

  topoff_current:
    description: Top-off current in milliamps (mA)
    $ref: /schemas/types.yaml#/definitions/uint32

  restart_threshold:
    description: Restart threshold in millivolts (mV)
    $ref: /schemas/types.yaml#/definitions/uint32

  input_current_limit:
    description: Input current limit in milliamps (mA)
    $ref: /schemas/types.yaml#/definitions/uint32

required:
  - compatible

additionalProperties: false

examples:
  - |
        charger {
                compatible = "maxim,max77840-charger";
                fast_charge_timer = <5>;
                fast_charge_current = <1500>;
                charge_termination_voltage = <4200>;
                topoff_timer = <20>;
                topoff_current = <100>;
                restart_threshold = <100>;
                input_current_limit = <500>;
        };
```

## Documentation/devicetree/bindings/power/supply/maxim,max77840-fuelgauge.yaml
```yaml
# SPDX-License-Identifier: (GPL-2.0-only OR BSD-2-Clause)
%YAML 1.2
---
$id: http://devicetree.org/schemas/power/supply/maxim,max77840-fuelgauge.yaml#
$schema: http://devicetree.org/meta-schemas/core.yaml#

title: Maxim MAX77840 Fuel Gauge

maintainers:
  - Joan Na <joan.na@analog.com>

properties:
  compatible:
    const: maxim,max77840-fuelgauge

required:
  - compatible

additionalProperties: false

examples:
  - |
    fuelgauge {
      compatible = "maxim,max77840-fuelgauge";
    };
```

## Documentation/devicetree/bindings/powerpc/fsl/pmc.txt
```
* Power Management Controller

Properties:
- compatible: "fsl,<chip>-pmc".

  "fsl,mpc8349-pmc" should be listed for any chip whose PMC is
  compatible.  "fsl,mpc8313-pmc" should also be listed for any chip
  whose PMC is compatible, and implies deep-sleep capability.

  "fsl,mpc8548-pmc" should be listed for any chip whose PMC is
  compatible.  "fsl,mpc8536-pmc" should also be listed for any chip
  whose PMC is compatible, and implies deep-sleep capability and
  wake on user defined packet(wakeup on ARP).

  "fsl,p1022-pmc" should be listed for any chip whose PMC is
  compatible, and implies lossless Ethernet capability during sleep.

  "fsl,mpc8641d-pmc" should be listed for any chip whose PMC is
  compatible; all statements below that apply to "fsl,mpc8548-pmc" also
  apply to "fsl,mpc8641d-pmc".

  Compatibility does not include bit assignments in SCCR/PMCDR/DEVDISR; these
  bit assignments are indicated via the clock nodes.  Device which has a
  controllable clock source should have a "fsl,pmc-handle" property pointing
  to the clock node.

- reg: For devices compatible with "fsl,mpc8349-pmc", the first resource
  is the PMC block, and the second resource is the Clock Configuration
  block.

  For devices compatible with "fsl,mpc8548-pmc", the first resource
  is a 32-byte block beginning with DEVDISR.

- interrupts: For "fsl,mpc8349-pmc"-compatible devices, the first
  resource is the PMC block interrupt.

- fsl,mpc8313-wakeup-timer: For "fsl,mpc8313-pmc"-compatible devices,
  this is a phandle to an "fsl,gtm" node on which timer 4 can be used as
  a wakeup source from deep sleep.

Clock nodes:
The clock nodes are to describe the masks in PM controller registers for each
soc clock.
- fsl,pmcdr-mask: For "fsl,mpc8548-pmc"-compatible devices, the mask will be
  ORed into PMCDR before suspend if the device using this clock is the wake-up
  source and need to be running during low power mode; clear the mask if
  otherwise.

- fsl,sccr-mask: For "fsl,mpc8349-pmc"-compatible devices, the corresponding
  bit specified by the mask in SCCR will be saved and cleared on suspend, and
  restored on resume.

- fsl,devdisr-mask: Contain one or two cells, depending on the availability of
  DEVDISR2 register.  For compatible devices, the mask will be ORed into DEVDISR
  or DEVDISR2 when the clock should be permenently disabled.

Example:

	power@e0070 {
		compatible = "fsl,mpc8536-pmc", "fsl,mpc8548-pmc";
		reg = <0xe0070 0x20>;

		etsec1_clk: soc-clk@24 {
			fsl,pmcdr-mask = <0x00000080>;
		};
		etsec2_clk: soc-clk@25 {
			fsl,pmcdr-mask = <0x00000040>;
		};
		etsec3_clk: soc-clk@26 {
			fsl,pmcdr-mask = <0x00000020>;
		};
	};
```

## Documentation/devicetree/bindings/ptp/ptp-adrv906x-soc.yaml
```yaml
# SPDX-License-Identifier: (GPL-2.0 OR BSD-2-Clause)
%YAML 1.2
---
$id: http://devicetree.org/schemas/ptp/ptp-adrv906x-soc.yaml#
$schema: http://devicetree.org/meta-schemas/core.yaml#

title: ADRV906x SoC PTP Clock Device Tree
maintainers:
  - Kim Holdt <kim.holdt@analog.com>

properties:
  compatible:
    const: adi,adrv906x-ptp

  "#address-cells":
    const: 1

  "#size-cells":
    const: 1

  reg:
    minItems: 1
    maxItems: 2
    description: Base address and size of the register set for the device.
      The second pair is optional and is used for two-chip instances.

  clock-names:
    items:
      - const: lc_clk
      - const: gc_clk

  clocks:
    items:
      - description: Clock phandle for ToD counter local clock,
          refer to common clock bindings.
      - description: Clock phandle for Golden Counter clock.

  interrupts:
    items:
      - description: ToD PPS interrupt

  interrupt-names:
    items:
      - const: pps

  adi,ppsx-pulse-width-ns:
    description: Value of PPSX pulse width in nanoseconds. Default is 10000000
      (10ms). Range is 1 to 99999999 ns.

  adi,external-pps:
    type: boolean
    description:
      This property is only for debugging or special use cases.
      If present, the PPS (not PPSX) output signal and trigger for the /dev/ppsX
      device(s) will be sourced from the input PPS signal.

  adi,pps-in-pulse-width-ms:
    description:
      The expected pulse width of the input PPS signal in milliseconds.
      Range is 0 to 1000 ms.

  adrv906x-tod:
    type: object
    properties:
      adi,default-tod-counter:
        $ref: /schemas/types.yaml#/definitions/uint32
        description:
          Default selected ToD counter for the local ToD and CDC output.

      adi,cdc-delay-value:
        $ref: /schemas/types.yaml#/definitions/uint32-array
        description:
          this property is only for debugging or special use cases.
          Instead, for normal operation, we need to configure this on the basis
          of the Ethernet interface speed (which dictates the frequency for
          the Ethernet Subsystem) and the 'devclk' frequency.
          Default is 0.
        minimum: 0
        maximum: 31

      "#address-cells":
        const: 1

      "#size-cells":
        const: 0
    patternProperties:
      "tod-counter@[0-2]+$":
        type: object
        description: ADRV906x ToD counter(s). Each ToD node declares a
          counter that can be synchronized to an external source, and will
          be represented by a /dev/ptpX and /dev/ppsX.
        properties:
          reg:
            description: The index of the ToD counter.
            minimum: 0
            maximum: 2

          adi,pps-mode:
            type: boolean
            description:
              The read and write trigger mode of the ToD counter.
              If present, the ToD counter runs in the 1PPS trigger mode,
              otherwise, the counter runs in the GC trigger mode.

          adi,trigger-delay-tick:
            $ref: /schemas/types.yaml#/definitions/uint32
            description:
              The trigger delay for the GC trigger mode in clock cycles.
              Default is 491520.
            minimum: 0
            maximum: 0xFFFFFFFF
        required:
          - reg
        additionalProperties: false

    additionalProperties: false

  adi,max-adj:
    $ref: /schemas/types.yaml#/definitions/uint32
    description:
      The maximum possible frequency adjustment, in parts per billion
    minimum: 0
    maximum: 1000000000

  clock-pll:
    type: object
    properties:
      adi,i2c-clk:
        $ref: /schemas/types.yaml#/definitions/phandle
        description: The reference to the i2c connected clock node when
          use the i2c connecting to the clock chip directly.

additionalProperties: false

required:
  - compatible
  - reg
  - interrupts
  - interrupt-names
  - clock-names
  - clocks
  - adrv906x-tod
  - clock-pll

examples:
  - |
    #include <dt-bindings/interrupt-controller/arm-gic.h>
    #include <dt-bindings/gpio/gpio.h>
    #define EMAC_TOD_BASE   0x2B380000
    #define EMAC_TOD_BASE_UADDR   2B380000
    #define TOD_IRQ 201

    ptpclk: ptpclk@EMAC_TOD_BASE_UADDR {
      compatible = "adi,adrv906x-ptp";
      reg = <EMAC_TOD_BASE 0xff>;
      interrupts = <GIC_SPI TOD_IRQ IRQ_TYPE_LEVEL_HIGH>;
      interrupt-names = "pps";
      clocks = <&sysclk>, <&sysclk>;
      clock-names = "lc_clk", "gc_clk";
      adi,max-adj = <50>;
      pinctrl-names = "default";
      pinctrl-0 = <&pinctrl_one_pps>;

      adrv906x-tod {
        adi,default-tod-counter = <0>;
        #address-cells = <1>;
        #size-cells = <0>;
        tod-counter@0 {
          reg = <0>;
          adi,pps-mode;
          adi,trigger-delay-tick = <491520>;
        };
      };
      clock-pll {
        adi,i2c-clk = <&ad9545>;
      };
    };
```
