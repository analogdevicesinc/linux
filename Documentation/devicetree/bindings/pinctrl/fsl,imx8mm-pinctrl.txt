## Documentation/devicetree/bindings/regulator/adi,lt8722-regulator.yaml
```yaml
# SPDX-License-Identifier: (GPL-2.0 OR BSD-2-Clause)
# Copyright (c) 2023 Analog Devices, Inc.
%YAML 1.2
---
$id: http://devicetree.org/schemas/regulator/adi,lt8722-regulator.yaml#
$schema: http://devicetree.org/meta-schemas/core.yaml#

title: Analog Devices LT8722 Ultracompact Full Bridge Driver

maintainers:
  - Ramon Cristopher Calam <ramoncristopher.calam@analog.com>

description: |
  The Analog Devices LT8722 is a high performance, high efficiency, 15V input,
  4A monolithic full bridge DC/DC converter. This converter has 92.5% efficiency
  with high power output of 54W for fine control TEC driving applications.

properties:
  compatible:
    enum:
      - adi,lt8722

  reg:
    maxItems: 1

  enable-gpios:
    description:
      This pin in used together with the ENABLE_REQ bit in the SPIS_COMMAND
      register to set the state of LT8722. When both the ENABLE_REQ bit and
      the enable GPIO are low, LT8722 is in shutdown mode. When either the
      ENABLE_REQ bit or the enable GPIO is high, LT8722 is active and the
      internal VCC LDO regulator is enabled. The enable GPIO is active high.
    maxItems: 1

  switch-enable-gpios:
    description:
      This pin is used together with the SWEN_REG bit in the SPIS_COMMAND
      register to set the PWM switching behavior of LT8722. When both the
      SWEN_REG bit and the switch enable GPIO are low, LT8722 PWM switching
      is disabled. When both the SWEN_REG bit and the switch enable GPIO are
      high, LT8722 PWM switching is enabled. The switch enable GPIO is active
      high.
    maxItems: 1

  spi-max-frequency:
    maximum: 10000000

  adi,uv-clamp-microvolt:
    description: Maximum negative output voltage clamp in microvolts.
    enum: [
      -20000000,
      -18750000,
      -17500000,
      -16250000,
      -15000000,
      -13750000,
      -12500000,
      -11250000,
      -10000000,
      -8750000,
      -7500000,
      -6250000,
      -5000000,
      -3750000,
      -2500000,
      -1250000
    ]
    default: -20000000

  adi,ov-clamp-microvolt:
    description: Maximum positive output voltage clamp in microvolts.
    enum: [
      1250000,
      2500000,
      3750000,
      5000000,
      6250000,
      7500000,
      8750000,
      10000000,
      11250000,
      12500000,
      13750000,
      15000000,
      16250000,
      17500000,
      18750000,
      20000000
    ]
    default: 20000000

  adi,ilimn-microamp:
    description: Maximum negative output current limit in microamps.
    minimum: -6786000
    maximum: -637440
    default: -6786000

  adi,ilimp-microamp:
    description: Maximum positive output current limit in microamps.
    minimum: 637440
    maximum: 6800000
    default: 6800000

  adi,switch-frequency-hz:
    description: PWM switch frequency.
    enum: [500000, 1000000, 1500000, 2000000, 2500000, 3000000]
    default: 500000

  adi,switch-frequency-adjust:
    description: PWM switch frequency adjustment.
    enum: [0%, 15%, -15%]
    default: 0%

  adi,duty-cycle-range:
    description: PWM duty cycle.
    enum: [20%-80%, 15%-85%, 10%-90%]
    default: 20%-80%

  adi,vcc-vreg-millivolt:
    description: VCC LCO regulation voltage in millivolts.
    $ref: /schemas/types.yaml#/definitions/uint32
    enum: [3100, 3400]
    default: 3400

  adi,peak-inductor-current-milliamp:
    description: Typical peak inductor current in milliamps.
    $ref: /schemas/types.yaml#/definitions/uint32
    enum: [252, 594, 936, 1278, 1620, 1962, 2304, 2646]
    default: 1620

  adi,power-limit-milliwatt:
    description: Linear power stage MOSFET power limit in milliwatts.
    enum: [0, 2000, 3000, 3500]
    default: 0

required:
  - compatible
  - reg
  - enable-gpios
  - switch-enable-gpios

allOf:
  - $ref: regulator.yaml#
  - $ref: /schemas/spi/spi-peripheral-props.yaml#

unevaluatedProperties: false

examples:
  - |
    #include <dt-bindings/gpio/gpio.h>
    spi {
        #address-cells = <1>;
        #size-cells = <0>;

        regulator@0 {
            compatible = "adi,lt8722";
            reg = <0>;
            enable-gpios = <&gpio 23 GPIO_ACTIVE_HIGH>;
            switch-enable-gpios = <&gpio 24 GPIO_ACTIVE_HIGH>;
            spi-max-frequency = <10000000>;
            spi-bits-per-word = <8>;

            adi,uv-clamp-microvolt = <(-20000000)>;
            adi,ov-clamp-microvolt = <20000000>;
            adi,ilimn-microamp = <(-6786000)>;
            adi,ilimp-microamp = <6800000>;
            adi,switch-frequency-hz = <500000>;
            adi,switch-frequency-adjust = "0%";
            adi,duty-cycle-range = "20%-80%";
            adi,vcc-vreg-millivolt = <3400>;
            adi,peak-inductor-current-milliamp = <1620>;
            adi,power-limit-milliwatt = <0>;

            regulator-min-microvolt = <(-20000000)>;
            regulator-max-microvolt = <20000000>;
            regulator-soft-start;
        };
    };
```

## Documentation/devicetree/bindings/regulator/adi,ltc7871-regulator.yaml
```yaml
# SPDX-License-Identifier: (GPL-2.0 OR BSD-2-Clause)
# Copyright (c) 2025 Analog Devices, Inc.
%YAML 1.2
---
$id: http://devicetree.org/schemas/regulator/adi,ltc7871-regulator.yaml#
$schema: http://devicetree.org/meta-schemas/core.yaml#

title: Analog Devices LTC7871 Buck-Boost Voltage Regulator
maintainers:
  - Celine Joy Capua <celinejoy.capua@analog.com>

description:
  The LTC7871 is a high performance bidirectional buck or boost switching
  regulator controller that operates in either buck or boost mode on demand.
  It regulates in buck mode from VHIGH-to-VLOW and boost mode from
  VLOW-to-VHIGH depending on a control signal, making it ideal for 48V/12V
  automotive dual battery systems
properties:
  compatible:
    enum:
      - adi,ltc7871
      - adi,ltc7872

  reg:
    maxItems: 1

  adi,enable-chip-ctrl-wp:
    description: If present, this indicates the use of regulator's
      internal write protection.
    type: boolean

  adi,ra-external-ohms:
    description: External Resistor used to compute the value of
      programmable VLOW in buck mode.
    default: 10000

  adi,rb-external-ohms:
    description: External Resistor used to compute the value of
      programmable VLOW in buck mode.
    default: 107000

  adi,rc-external-ohms:
    description: External Resistor used to compute the value of
      programmable VHIGH in boost mode.
    default: 12700

  adi,rd-external-ohms:
    description: External Resistor used to compute the value of
      programmable VHIGH in boost mode.
    default: 499000

  adi,idac-setcur-microamp:
    description: Adjusts the IDAC_SETCUR to program SETCUR
      pin's sourcing current.
    minimum: -63
    maximum: 64
    default: 0

  adi,freq-spread-percentage:
    description: Sets the range of modulation with respect to the
      switching frequency.
    enum: [+-12%, +-15%, +-10%, +-8%]
    default: +-12%

  adi,switching-freq-divider:
    description: The factor at which the switching frequency is
      divided to get the modulation frequency.
    $ref: /schemas/types.yaml#/definitions/uint32
    enum: [512, 1024, 2048, 4096, 256, 128, 64]
    default: 512

required:
  - compatible
  - reg

allOf:
  - $ref: regulator.yaml#
  - $ref: /schemas/spi/spi-peripheral-props.yaml#

unevaluatedProperties: false

examples:
  - |
    spi {
      #address-cells = <1>;
      #size-cells = <0>;
      regulator@0 {
        compatible = "adi,ltc7871";
        reg = <0>;
        adi,ra-external-ohm = <10000>;
        adi,rb-external-ohm = <107000>;
        adi,rc-external-ohm = <12700>;
        adi,rd-external-ohm = <499000>;
        adi,idac-setcur-microamp = <0>;
        adi,freq-spread-percentage = "+-12%";
        adi,switching-freq-divider = <512>;
      };
    };
```

## Documentation/devicetree/bindings/regulator/adi,max77503-regulator.yaml
```yaml
# SPDX-License-Identifier: (GPL-2.0 OR BSD-2-Clause)
# Copyright (c) 2023 Analog Devices, Inc.
%YAML 1.2
---
$id: http://devicetree.org/schemas/regulator/adi,max77503-regulator.yaml#
$schema: http://devicetree.org/meta-schemas/core.yaml#

title: Analog Devices MAX77503 Buck Converter

maintainers:
  - Gokhan Celik <Gokhan.Celik@analog.com>

description: Analog Devices MAX77503 Buck Converter

properties:
  compatible:
    enum:
      - adi,max77503

  reg:
    description: I2C address of the device
    items:
      - enum: [0x1e, 0x24, 0x37]

  regulator:
    type: object
    $ref: regulator.yaml#
    additionalProperties: false
    description: |
      Buck regulator

    properties:
      regulator-name: true
      regulator-always-on: true
      regulator-boot-on: true
      regulator-min-microvolt:
        minimum: 800000
      regulator-max-microvolt:
        maximum: 5000000

additionalProperties: false

required:
  - compatible
  - reg

examples:
  - |
    i2c {
        #address-cells = <1>;
        #size-cells = <0>;

        max77503@1e {
            compatible = "adi,max77503";
            reg = <0x1e>;
            regulator{
                regulator-name = "max777503-regulator";
                regulator-min-microvolt = <800000>;
                regulator-max-microvolt = <5000000>;
                regulator-boot-on;
            };
        };
    };
```

## Documentation/devicetree/bindings/regulator/adi,max77541-regulator.yaml
```yaml
# SPDX-License-Identifier: GPL-2.0-only OR BSD-2-Clause
%YAML 1.2
---
$id: http://devicetree.org/schemas/regulator/adi,max77541-regulator.yaml#
$schema: http://devicetree.org/meta-schemas/core.yaml#

title: Buck Converter driver for MAX77540/MAX77541

maintainers:
  - Okan Sahin <okan.sahin@analog.com>

description: |
  This is a part of device tree bindings for ADI MAX77540/MAX77541

  The buck convertere is represented as a sub-node of the PMIC node on the device tree.

  The device has two buck regulators.
  See also Documentation/devicetree/bindings/mfd/adi,max77541.yaml for
  additional information and example.

properties:
  compatible:
    enum: 
      -adi,max77540-regulator
      -adi,max77541-regulator

patternProperties:
  "^buck[1-2]$":
    type: object
    $ref: regulator.yaml#
    additionalProperties: false
    description: |
      Buck regulator.

    properties:
      regulator-name: true
      regulator-always-on: true
      regulator-boot-on: true
      regulator-min-microvolt:
        minimum: 300000
      regulator-max-microvolt:
        maximum: 5200000

required:
  - compatible

additionalProperties: false
```
