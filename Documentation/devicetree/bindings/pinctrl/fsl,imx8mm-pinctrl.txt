## Documentation/devicetree/bindings/pinctrl/fsl,imx8mm-pinctrl.txt
```
* Freescale i.MX8M Mini IOMUX Controller

Please refer to fsl,imx-pinctrl.txt in this directory for common binding part
and usage.

Required properties:
- compatible: "fsl,imx8mm-iomuxc" for IOMUXC controller.
- fsl,pins: each entry consists of 6 integers and represents the mux and config
  setting for one pin.  The first 5 integers <mux_reg conf_reg input_reg mux_val
  input_val> are specified using a PIN_FUNC_ID macro, which can be found in
  pins-imx8mm.h under device tree source folder.  The last integer CONFIG is
  the pad setting value like pull-up on this pin.  Please refer to i.MX8M Mini
  Reference Manual for detailed CONFIG settings.

CONFIG bits definition:
PAD_CTL_LVTTL                   (1 << 8)
PAD_CTL_HYS                     (1 << 7)
PAD_CTL_PUE                     (1 << 6)
PAD_CTL_ODE                     (1 << 5)
PAD_CTL_SRE_SLOW                (0 << 3)
PAD_CTL_SRE_MED                 (1 << 3)
PAD_CTL_SRE_FAST                (2 << 3)
PAD_CTL_SRE_MAX                 (3 << 3)
PAD_CTL_DSE_HIZ                 (0 << 0)
PAD_CTL_DSE_255                 (1 << 0)
PAD_CTL_DSE_105                 (2 << 0)
PAD_CTL_DSE_75                  (3 << 0)
PAD_CTL_DSE_85                  (4 << 0)
PAD_CTL_DSE_65                  (5 << 0)
PAD_CTL_DSE_45                  (6 << 0)
PAD_CTL_DSE_40                  (7 << 0)

iomuxc: pinctrl@30330000 {
	compatible = "fsl,imx8mm-iomuxc";
	reg = <0x0 0x30330000 0x0 0x10000>;
};
```

## Documentation/devicetree/bindings/pinctrl/fsl,imx8qxp-pinctrl.txt
```
* Freescale i.MX8QXP IOMUX Controller

Required properties:
- compatible: "fsl,imx8qxp-iomuxc"
- fsl,pins: each entry consists of 2 integers. Its format is
  <pin_id pin_config>.

pin_config definition:
- i.MX8QXP have different pad types, please refer to below pad
  register definitions, the pinctrl driver will just write the
  pin_config into the hardware register.

typedef union _hw_pad_iomux
{
    uint32_t U;
    struct _hw_pad_iomux_bitfields0
    {
        uint32_t GP : 19; /*!< [18:0] GP controls. */
        uint32_t WAKEUP : 3; /*!< [21:19] Wakeup controls. */
        uint32_t WAKEUP_ENB : 1; /*!< [22] Wakeup write enable. */
        uint32_t LPCONFIG : 2; /*!< [24:23] Low-power config. */
        uint32_t CONFIG : 2; /*!< [26:25] Config. */
        uint32_t IFMUX : 3; /*!< [29:27] Mux. */
        uint32_t GP_ENB : 1; /*!< [30] GP write enable. */
        uint32_t IFMUX_ENB : 1; /*!< [31] Mux write enable. */
    } B;
    struct _hw_pad_iomux_28fdsoi
    {
        uint32_t DSE : 3; /*!< [2:0] Drive strength. */
        uint32_t _reserved1 : 2; /*!< [4:3] */
        uint32_t PS : 2; /*!< [6:5] Pull select. */
        uint32_t _reserved2 : 12; /*!< [18:7] */
        uint32_t WAKEUP : 3; /*!< [21:19] Wakeup controls. */
        uint32_t WAKEUP_ENB : 1; /*!< [22] Wakeup write enable. */
        uint32_t LPCONFIG : 2; /*!< [24:23] Low-power config. */
        uint32_t CONFIG : 2; /*!< [26:25] Config. */
        uint32_t IFMUX : 3; /*!< [29:27] Mux. */
        uint32_t GP_ENB : 1; /*!< [30] GP write enable. */
        uint32_t IFMUX_ENB : 1; /*!< [31] Mux write enable. */
    } FDS0I28;
    struct _hw_pad_iomux_28fdsoi_hsic
    {
        uint32_t DSE : 3; /*!< [2:0] Drive strength. */
        uint32_t HYS : 1; /*!< [3] Hysteresis. */
        uint32_t PUS : 2; /*!< [5:4] Pull-up select. */
        uint32_t PKE : 1; /*!< [6] Pad keeper enable. */
        uint32_t PUE : 1; /*!< [7] Pull-up enable. */
        uint32_t _reserved2 : 11; /*!< [18:8] */
        uint32_t WAKEUP : 3; /*!< [21:19] Wakeup controls. */
        uint32_t WAKEUP_ENB : 1; /*!< [22] Wakeup write enable. */
        uint32_t LPCONFIG : 2; /*!< [24:23] Low-power config. */
        uint32_t CONFIG : 2; /*!< [26:25] Config. */
        uint32_t IFMUX : 3; /*!< [29:27] Mux. */
        uint32_t GP_ENB : 1; /*!< [30] GP write enable. */
        uint32_t IFMUX_ENB : 1; /*!< [31] Mux write enable. */
    } FDS0I28_HSIC;
    struct _hw_pad_iomux_28fdsoi_comp
    {
        uint32_t COMPEN : 3; /*!< [2:0] Mode. */
        uint32_t FASTFRZ : 1; /*!< [3] Fast freeze. */
        uint32_t PSW_OVR  : 1; /*!< [4] 2.5 volt override */
        uint32_t RASRCP : 4; /*!< [8:5] PMOS comp. */
        uint32_t RASRCN : 4; /*!< [12:9] NMOS comp. */
        uint32_t NASRC_SEL : 1; /*!< [13] Read NASRC select. */
        uint32_t COMPOK  : 1; /*!< [14] Comp status. */
        uint32_t NASRC : 4; /*!< [18:15] NASRC value. */
        uint32_t _reserved2 : 4; /*!< [22:19] */
        uint32_t LPCONFIG : 2; /*!< [24:23] Low-power config. */
        uint32_t _reserved3 : 5; /*!< [29:25] */
        uint32_t GP_ENB : 1; /*!< [30] GP write enable. */
        uint32_t IFMUX_ENB : 1; /*!< [31] Mux write enable. */
    } FDS0I28_COMP;
} hw_pad_iomux_t;
```

## Documentation/devicetree/bindings/pinctrl/fsl,s32v234-siul2.txt
```
* Freescale SIUL2 iomux controller

See chapter 20 ("System Integration Unit Lite2 (SIUL2)") in the reference
manual[1].

Based on fsl,imx-pincontrol implementation.

Required properties:
- compatible: "fsl,s32v234-siul2"
- fsl,pins: two integers array, represents a group of pins mux and config
  setting. The format is fsl,pins = <PIN_FUNC_ID CONFIG>
  PIN_FUNC_ID - id of MSCR to be modified
  CONFIG - configuration to be written in the MSCR/IMCR register

  Even though IMCR register should be used as input register, it can be
  set and addressed in the same way as MSCR, only instead of passing the
  IMCR index, IMCR_IDX + 512 is passed[1].

[1] https://www.nxp.com/webapp/Download?colCode=S32V234RM
```

## Documentation/devicetree/bindings/power/fsl,imx8m-genpd.txt
```
Device Tree Bindings for Freescale i.MX8M Generic Power Domain
==============================================================
The binding for the i.MX8M Generic power Domain[1].

[1] Documentation/devicetree/bindings/power/power_domain.txt

Required properties:

 - compatible: should be of:
	- "fsl,imx8m-power-domain"
 - #power-domain-cells: Number of cells in a PM domain Specifier, must be 0
 - domain-index: should be the domain index number need to pass to TF-A
 - domain-name: the name of this pm domain

Optional properties:
 - clocks: a number of phandles to clocks that need to be enabled during
   domain power-up sequence to ensure reset propagation into devices
   located inside this power domain
 - power-supply: Power supply used to power the domain
 - parent-domains: the phandle to the parent power domain

example:
	vpu_g1_pd: vpug1-pd {
		compatible = "fsl,imx8mm-pm-domain";
		#power-domain-cells = <0>;
		domain-index = <6>;
		domain-name = "vpu_g1";
		parent-domains = <&vpumix_pd>;
		clocks = <&clk IMX8MM_CLK_VPU_G1_ROOT>;
	};


Specifying Power domain for IP modules
======================================

IP cores belonging to a power domain should contain a 'power-domains'
property that is a phandle for PGC node representing the domain.

Example of a device that is part of the vpu_g1 power domain:
	vpu_g1: vpu_g1@38300000 {
		/* ... */
		interrupts = <GIC_SPI 7 IRQ_TYPE_LEVEL_HIGH>;
		interrupt-names = "irq_hantro";
		/* ... */
		power-domains = <&vpu_g1_pd>;
	};
```

## Documentation/devicetree/bindings/power/reset/adi,max16150.yaml
```yaml
# SPDX-License-Identifier: (GPL-2.0 OR BSD-2-Clause)
%YAML 1.2
---
$id: http://devicetree.org/schemas/power/reset/adi,max16150.yaml#
$schema: http://devicetree.org/meta-schemas/core.yaml#

title: Analog Devices MAX16150/MAX16169 nanoPower Pushbutton On/Off Controller

maintainers:
  - Marc Paolo Sosa <marcpaolo.sosa@analog.com>

description: |
  The MAX16150/MAX16169 is an extremely low-power, pushbutton, on/off controller
  with avswitch debouncer and built-in latch. This device accepts a noisy input
  from a mechanical switch and produces a clean, latched output, as well as a
  one-shot interrupt output, in response to a switch closure exceeding the
  debounce period at PB_IN. A switch closure longer than shutdown period at
  PB_IN results in a longer one-shot interrupt output. The MAX16150 family has
  two set of devices, one in which a longer switch closure greater than the
  shutdown period deasserts the latched output, and another in which the latched
  output stays asserted.

  Specifications about the charger can be found at:
    https://www.analog.com/en/products/max16150.html
    https://www.analog.com/en/products/max16169.html

properties:
  compatible:
    enum:
      - adi,max16150
      - adi,max16169

  reg:
    maxItems: 1

required:
  - compatible
  - adi,variant

additionalProperties: false

examples:
  - |
    gpio {
        max161x_pins: max161x_pins {
            brcm,pins = <17 18 22 23>;
            brcm,function = <0>;
            brcm,pull = <0>;
        };
    };

    max161x@0 {
        compatible = "adi,max16150";
        adi,variant = "A";

        gpio-pb_in = <&gpio 17 1>;
        gpio-out = <&gpio 18 0>;
        gpio-clr = <&gpio 22 1>;
        gpio-int = <&gpio 23 0>;

        status = "okay";
    };
```

## Documentation/devicetree/bindings/power/supply/adi,lt8491.yaml
```yaml
# SPDX-License-Identifier: (GPL-2.0 OR BSD-2-Clause)
%YAML 1.2
---
$id: http://devicetree.org/schemas/power/supply/adi,lt8491.yaml#
$schema: http://devicetree.org/meta-schemas/core.yaml#

title: Linear Technology (Analog Devices) LT8491 Battery Charger

maintainers:
  - John Erasmus Mari Geronimo <johnerasmusmari.geronimo@analog.com>

description: |
  The LT8491 is a buck-boost switching regulator battery charger that implements
  a constant-current constant-voltage (CCCV) charging profile used for most
  battery types, including sealed lead-acid (SLA), flooded, gel and lithium-ion.

  Specifications about the charger can be found at:
    https://www.analog.com/en/products/lt8491.html

properties:
  compatible:
    enum:
      - adi,lt8491

  reg:
    maxItems: 1

  adi,rsense1-micro-ohms:
    description: Resistance value of RSENSE1 in micro ohms.

  adi,rimon-out-ohms:
    description: Resistance value of RIMON_OUT in ohms.

  adi,rsense2-micro-ohms:
    description: Resistance value of RSENSE2 in micro ohms.

  adi,rdaco-ohms:
    description: Resistance value of RDACO1 + RDACO2 in ohms.

  adi,rfbout1-ohms:
    description: Resistance value of RFBOUT1 in ohms.

  adi,rfbout2-ohms:
    description: Resistance value of RFBOUT2 in ohms.

  adi,rdaci-ohms:
    description: Resistance value of RDACI1 + RDACI2 in ohms.

  adi,rfbin2-ohms:
    description: Resistance value of RFBIN2 in ohms.

  adi,rfbin1-ohms:
    description: Resistance value of RFBIN1 in ohms.

required:
  - compatible
  - reg
  - adi,rsense1-micro-ohms
  - adi,rimon-out-ohms
  - adi,rsense2-micro-ohms
  - adi,rdaco-ohms
  - adi,rfbout1-ohms
  - adi,rfbout2-ohms
  - adi,rdaci-ohms
  - adi,rfbin2-ohms
  - adi,rfbin1-ohms

additionalProperties: false

examples:
  - |
    i2c {
        #address-cells = <1>;
        #size-cells = <0>;

        battery-charger@10 {
            compatible = "adi,lt8491";
            reg = <0x10>;
            adi,rsense1-micro-ohms = <5000>;
            adi,rimon-out-ohms = <124000>;
            adi,rsense2-micro-ohms = <3000>;
            adi,rdaco-ohms = <64900>;
            adi,rfbout1-ohms = <113000>;
            adi,rfbout2-ohms = <10000>;
            adi,rdaci-ohms = <7000>;
            adi,rfbin2-ohms = <3480>;
            adi,rfbin1-ohms = <102000>;
        };
    };
```

## Documentation/devicetree/bindings/power/supply/adp5061.txt
```
Analog Devices ADP5061 Programmable Linear Battery Charger Driver

Required properties:
  - compatible:		should be "adi,adp5061"
  - reg:		i2c address of the device

The node for this driver must be a child node of a I2C controller, hence
all mandatory properties described in
Documentation/devicetree/bindings/i2c/i2c.txt
must be specified.

Example:

	adp5061@14 {
		    compatible = "adi,adp5061";
		    reg = <0x14>;
	};
```

## Documentation/devicetree/bindings/power/supply/ltc4162-l.yaml
```yaml
# SPDX-License-Identifier: (GPL-2.0 OR BSD-2-Clause)
# Copyright (C) 2020 Topic Embedded Products
%YAML 1.2
---
$id: http://devicetree.org/schemas/power/supply/ltc4162-l.yaml#
$schema: http://devicetree.org/meta-schemas/core.yaml#

title: Linear Technology (Analog Devices) LTC4162 and LTC4015 Charger

maintainers:
  - Mike Looijmans <mike.looijmans@topic.nl>

description: |
  The LTC ® 4162-L is an advanced monolithic synchronous step-down switching
  battery charger and PowerPath (TM) manager that seamlessly manages power
  distribution between input sources such as wall adapters, backplanes, solar
  panels, etc., and a rechargeable Lithium-Ion/Polymer battery.

  Specifications about the charger can be found at:
    https://www.analog.com/en/products/ltc4162-l.html
    https://www.analog.com/en/products/ltc4162-f.html
    https://www.analog.com/en/products/ltc4162-s.html
    https://www.analog.com/en/products/ltc4015.html

properties:
  compatible:
    enum:
      - adi,ltc4162-l
      - adi,ltc4162-f
      - adi,ltc4162-s
      - adi,ltc4015

  reg:
    maxItems: 1
    description: I2C address of the charger.

  adi,rsnsb-micro-ohms:
    description: Battery sense resistor in microohm.
    minimum: 1000

  adi,rsnsi-micro-ohms:
    description: Input current sense resistor in microohm.
    minimum: 1000

  adi,cell-count:
    $ref: /schemas/types.yaml#/definitions/uint32
    description: |
      Number of battery cells. If not provided, will be obtained from the chip
      once the external power is applied. Omit this when the number of cells
      is somewhat dynamic. Without it, several measurements will return 0 until
      the charger is connected to an external supply.

required:
  - compatible
  - reg
  - adi,rsnsb-micro-ohms
  - adi,rsnsi-micro-ohms

additionalProperties: false

examples:
  - |
    i2c0 {
      #address-cells = <1>;
      #size-cells = <0>;
      charger: battery-charger@68 {
              compatible = "adi,ltc4162-l";
              reg = <0x68>;
              adi,rsnsb-micro-ohms = <10000>;
              adi,rsnsi-micro-ohms = <16000>;
              adi,cell-count = <2>;
      };
    };
```

## Documentation/devicetree/bindings/power/supply/max77659-charger.yaml
```yaml
# SPDX-License-Identifier: GPL-2.0
%YAML 1.2
---
$id: http://devicetree.org/schemas/power/supply/max77659-charger.yaml#
$schema: http://devicetree.org/meta-schemas/core.yaml#

title: Battery charger driver for MAX77659 PMIC from Maxim Integrated.

maintainers:
  - Nurettin Bolucu <Nurettin.Bolucu@analog.com>
  - Zeynep Arslanbenzer <Zeynep.Arslanbenzer@analog.com>

description: |
  This module is part of the MAX77659 MFD device. For more details
  see Documentation/devicetree/bindings/mfd/max77659.yaml.

  The charger is represented as a sub-node of the PMIC node on the device tree.

properties:
  compatible:
    const: adi,max77659-charger

  fast-charge-timer:
    description:
      Fast-charge safety timer value (in hours).

  fast-charge-current:
    description:
      Fast-charge constant current value (in microamps).

  topoff-timer:
    description:
      Top-Off timer value (in minutes).

required:
  - compatible

additionalProperties: false

...
```
