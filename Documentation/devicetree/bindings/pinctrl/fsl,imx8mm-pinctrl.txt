## Documentation/devicetree/bindings/ptp/ptp-adrv906x-tod.yaml
```yaml
# SPDX-License-Identifier: (GPL-2.0 OR BSD-2-Clause)
%YAML 1.2
---
$id: http://devicetree.org/schemas/ptp/ptp-adrv906x-tod.yaml#
$schema: http://devicetree.org/meta-schemas/core.yaml#

title: ADRV906x PTP Clock ToD Device Tree Bindings

maintainers:
  - Kim Holdt <kim.holdt@analog.com>

properties:
  compatible:
    const: adi,adrv906x-tod

  reg:
    maxItems: 1

  clock-names:
      items:
      - const: lc_clk
      - const: gc_clk
  clocks:
    items:
      - description: Clock phandle for ToD counter local clock, refer to common clock bindings.
      - description: Clock phandle for Golden Counter clock.

  interrupts:
    items:
    - description: ToD PPS interrupt
  interrupt-names:
    items:
    - description: pps

  adi,ppsx-pulse-width-ns:
    description: Value of PPSX pulse width in nanoseconds. Default is 10000000 (10ms).
    minimum: 1
    maximum: 99999999

  adi,external-pps:
    type: boolean
    description:
      This property is only for debugging or special use cases.
      If present, the PPS (not PPSX) output signal and trigger for the /dev/ppsX
      device(s) will be sourced from the input PPS signal.

  adrv906x-tod:
    adi,default-tod-counter:
    description:
      Default selected ToD counter for the local ToD and CDC output.

    adi,cdc-delay-value:
      description:
        this property is only for debugging or special use cases.
        Instead, for normal operation, we need to configure this on the basis of the Ethernet interface speed
        (which dictates the frequency for the Ethernet Subsystem) and the 'devclk' frequency.
        Default is 0.
      minimum: 0
      maximum: 31

    "tod-counter@[0-2]+$":
      type: object
      description: ADRV906x ToD counter(s)
      properties:
        reg:
          maxItems: 1
          description: The index of the ToD counter.
          minimum: 0
          maximum: 2

        adi,pps-mode:
          type: boolean
          description:
            The read and write trigger mode of the ToD counter.
            If present, the ToD counter runs in the 1PPS trigger mode, otherwise,  
            the counter runs in the GC trigger mode.

        adi,trigger-delay-tick:
          description:
            The trigger delay for the GC trigger mode in clock cycles. 
            Default is 491520.
          minimum: 0
          maximum: 0xFFFFFFFF

required:
  - compatible
  - reg
  - interrupts
  - interrupt-names
  - clock-names
  - clocks
  - adrv906x-tod

additionalProperties: false

examples:
  - |
    ptpclk: ptpclk {
      compatible = "adi,adi-tod";
      reg = <EMAC_TOD_BASE 0xff>;
      interrupts = <GIC_SPI TOD_IRQ IRQ_TYPE_LEVEL_HIGH>;
      interrupt-names = "pps";
      clocks = <&sysclk>, <&sysclk>; 
      clock-names = "lc_clk", "gc_clk";

      adrv906x-tod {
        adi,default-tod-counter = <0>;
        tod-counter@0 {
          reg = <0>;
          adi,trigger-delay-tick = <491520>;
        };
      };  
    };
  - |
    ptpclk: ptpclk {
      compatible = "adi,adi-tod";
      reg = <EMAC_TOD_BASE 0xff>;
      interrupts = <GIC_SPI TOD_IRQ IRQ_TYPE_LEVEL_HIGH>;
      interrupt-names = "pps";
      clocks = <&sysclk>, <&sysclk>; 
      clock-names = "lc_clk", "gc_clk";
      adi,ppsx-pulse-width-ns = <10000000>;        
      adi,external-pps;

      adrv906x-tod {
        adi,default-tod-counter = <0>;
        adi,cdc-delay-value = <0 0 0 0>;
        tod-counter@0 {
          reg = <0>;
          adi,pps-mode;
          adi,trigger-delay-tick = <491520>;
        };
      };
    };
```

## Documentation/devicetree/bindings/pwm/nxp,tpm-pwm.txt
```
NXP TPM PWM controller

Required properties:
- compatible: should be "nxp,tpm-pwm"
- reg: physical base address and length of the controller's registers
- #pwm-cells: should be 2. See pwm.txt in this directory for a description of
  the cells format.
- nxp,pwm-number: the number of PWM devices

Example:

pwm0: tpm@40250000 {
	compatible = "nxp,tpm-pwm";
	reg = <0x40250000 0x1000>;
	nxp,pwm-number = <6>;
	#pwm-cells = <2>;
};
```

## Documentation/devicetree/bindings/pwm/pwm-axi-pwmgen.yaml
```yaml
# SPDX-License-Identifier: (GPL-2.0-only OR BSD-2-Clause)
%YAML 1.2
---
$id: http://devicetree.org/schemas/pwm/pwm-axi-pwmgen.yaml#

title: Analog devices AXI PWM controller

maintainers:
  - Sergiu Cuciurean <sergiu.cuciurean@analog.com>

properties:
  compatible:
    enum:
      - adi,axi-pwmgen

  reg:
    maxItems: 1

  "#pwm-cells":
    const: 2

  clocks:
    description: Clock used as reference when generating the pwm

required:
  - compatible
  - reg
  - "#pwm-cells"
  - clocks

additionalProperties: false

examples:
  - |
    axi-pwmgen@44b00000 {
            compatible = "adi,axi-pwmgen";
            reg = <0x44b00000 0x1000>;
            label = "pwm_out1";
            #pwm-cells = <2>;
            clocks = <&ref_clk>;

    };
```

## Documentation/devicetree/bindings/pwm/pwm-rpmsg-imx.yaml
```yaml
# SPDX-License-Identifier: (GPL-2.0-only OR BSD-2-Clause)
%YAML 1.2
---
$id: http://devicetree.org/schemas/pwm/pwm-rpmsg-imx.yaml#
$schema: http://devicetree.org/meta-schemas/core.yaml#

title: NXP i.MX PWM over RPMSG driver

maintainers:
  - Clark Wang <xiaoning.wang@nxp.com>

description: |
  Acore may need to use some TPM resources of Mcore on some SoC platforms.
  This driver provide a protocol to send pwm request through RPMSG to
  Mcore and control the TPM modules on Mcore.
  Mcore will operate its TPM modules according to the Acore request.

properties:
  "#pwm-cells":
    const: 3

  compatible:
    enum:
      - fsl,pwm-rpchip

  fsl,pwm-channel-number:
    maxItems: 1

required:
  - "#pwm-cells"
  - compatible
  - fsl,pwm-channel-number

additionalProperties: false

examples:
  - |
    tpm_rpchip_0: pwm {
        compatible = "fsl,pwm-rpchip";
        fsl,pwm-channel-number = <6>;
        #pwm-cells = <3>;
        status = "okay";
    };
```

## Documentation/devicetree/bindings/regulator/adi,adp5055-regulator.yaml
```yaml
# SPDX-License-Identifier: (GPL-2.0 OR BSD-2-Clause)
%YAML 1.2
---
$id: http://devicetree.org/schemas/regulator/adi,adp5055-regulator.yaml#
$schema: http://devicetree.org/meta-schemas/core.yaml#

title: Analog Devices ADP5055 Triple Buck Regulator

maintainers:
  - Alexis Czezar Torreno <alexisczezar.torreno@analog.com>

description: |
  The ADP5055 combines three high performance buck regulators.
  The device enables direct connection to high input voltages
  up to 18 V with no preregulators.
  https://www.analog.com/media/en/technical-documentation/data-sheets/adp5055.pdf

properties:
  compatible:
    enum:
      - adi,adp5055

  reg:
    enum:
      - 0x70
      - 0x71

  adi,tset-us:
    description:
      Setting time used by the device. This is changed via soldering
      specific resistor values on the CFG2 pin.
    enum: [2600, 20800]
    default: 2600

  adi,hw-en-array-gpios:
    description:
      Asserted during driver probe. Each array entry acts as the
      hardware enable for channels 0-2. Should be marked 0 for active
      low. Requires all three channels to be initialized. Not adding
      the property turns the system to a software only enable mode.
    minItems: 3
    maxItems: 3

  adi,ocp-blanking:
    description:
      If present, the over current protection
      blanking (OCP) for all channels is on.
    type: boolean

  adi,delay-power-good:
    description:
      Configures delay timer of the power good (PWRGD) pin.
      Delay is based on Tset which can be 2.6 ms or 20.8 ms.
    type: boolean

  '#address-cells':
    const: 1

  '#size-cells':
    const: 0

patternProperties:
  "^channel@([0-2])$":
    type: object
    additionalProperties: false

    properties:
      reg:
        description: The channel number representing each buck converter.
        maximum: 2

      adi,power-saving-mode:
        description:
          If present, enables power saving mode for
          individual channels.
        type: boolean

      adi,output-discharge-function:
        description:
          If present, enable output discharge functionality
          for individual channels.
        type: boolean

      adi,disable-delay-us:
        description:
          Configures the disable delay for each channel. Dependent on Tset.
        enum: [0, 5200, 10400, 15600, 20800, 26000, 31200, 36400]
        default: 0

      adi,enable-delay-us:
        description:
          Configures the disable delay for each channel. Dependent on Tset.
        enum: [0, 2600, 5200, 7800, 10400, 13000, 15600, 18200]
        default: 0

      adi,dvs-limit-upper-microvolt:
        description:
          Configure the allowable upper side limit of the
          voltage output of each channel in microvolt.
          Voltages are in 12mV steps, value is autoadjusted.
          Vout_high = Vout + DVS_upper_limit.
        minimum: 12000
        maximum: 192000
        default: 192000

      adi,dvs-limit-lower-microvolt:
        description:
          Configure the allowable lower side limit of the
          voltage output of each channel in microvolt.
          Voltages are in 12mV steps, value is autoadjusted.
          Vout_low = Vout + DVS_lower_limit.
        minimum: -190500
        maximum: -10500
        default: -190500

      adi,fast-transient:
        description:
          Configures the fast transient sensitivity for each channel.
          "none"    - No fast transient.
          "3G_1.5%" - 1.5% window with 3*350uA/V
          "5G_1.5%" - 1.5% window with 5*350uA/V
          "5G_2.5%" - 2.5% window with 5*350uA/V
        enum: [none, 3G_1.5%, 5G_1.5%, 5G_2.5%]
        default: 5G_2.5%

      adi,mask-power-good:
        description:
          If present, masks individual channels to the external
          PWRGD hardware pin.
        type: boolean

    required:
      - reg

allOf:
  - $ref: regulator.yaml#

  - if:
      properties:
        adi,tset-us:
          contains:
            enum:
              - 20800
    then:
      properties:
        adi,disable-delay-us:
          enum: [0, 41600, 83200, 124800, 166400, 208000, 249600, 291200]

        adi,enable-delay-us:
          enum: [0, 20800, 41600, 62400, 83200, 104000, 124800, 145600]

required:
  - compatible
  - reg

unevaluatedProperties: false

examples:
  - |
    i2c {
        #address-cells = <1>;
        #size-cells = <0>;

        regulator@70 {
            compatible = "adi,adp5055";
            reg = <0x70>;
            #address-cells = <1>;
            #size-cells = <0>;

            adi,tset-us = <2600>;
            adi,hw-en-array-gpios = <&gpio 17 0>,
                                    <&gpio 18 0>,
                                    <&gpio 19 0>;

            adi,ocp-blanking;
            adi,delay-power-good;

            channel@0 {
                reg = <0>;
                adi,power-saving-mode;
                adi,output-discharge-function;
                adi,disable-delay-us = <0>;
                adi,enable-delay-us = <0>;
                adi,dvs-limit-upper-microvolt = <192000>;
                adi,dvs-limit-lower-microvolt = <(-190500)>;
                adi,fast-transient = "5G_2.5%";
                adi,mask-power-good;
            };

            channel@1 {
                reg = <1>;
                adi,power-saving-mode;
                adi,output-discharge-function;
                adi,disable-delay-us = <0>;
                adi,enable-delay-us = <0>;
                adi,dvs-limit-upper-microvolt = <192000>;
                adi,dvs-limit-lower-microvolt = <(-190500)>;
                adi,fast-transient = "5G_2.5%";
                adi,mask-power-good;
            };

            channel@2 {
                reg = <2>;
                adi,power-saving-mode;
                adi,output-discharge-function;
                adi,disable-delay-us = <0>;
                adi,enable-delay-us = <0>;
                adi,dvs-limit-upper-microvolt = <192000>;
                adi,dvs-limit-lower-microvolt = <(-190500)>;
                adi,fast-transient = "5G_2.5%";
                adi,mask-power-good;
            };
        };
    };
```
