## Documentation/devicetree/bindings/soc/adi/adi,reset-controller.yaml
```yaml
# SPDX-License-Identifier: (GPL-2.0-only OR BSD-2-Clause)
%YAML 1.2
---
$id: http://devicetree.org/schemas/soc/adi/adi,reset-controller.yaml#
$schema: http://devicetree.org/meta-schemas/core.yaml#

title: Analog Devices Reset Controller for SC5XX processor family

maintainers:
  - Arturs Artamonovs <arturs.artamonovs@analog.com>
  - Utsav Agarwal <Utsav.Agarwal@analog.com>

description:
  SHARC and ARM core reset control unit for starting/stopping/resetting
  processors

properties:
  compatible:
    items:
      - const: syscon
      - const: adi,reset-controller

  reg:
    maxItems: 1

  "#reset-cells":
    const: 2
    description:
      Two cells are required, the SHARC core ID and the reset function
      (0 = full core reset pulse, 1 = start/stop via MSG register).

  adi,sharc-min:
    $ref: /schemas/types.yaml#/definitions/uint32
    description: Minimum valid SHARC core ID/count
    minimum: 1
    maximum: 2

  adi,sharc-max:
    $ref: /schemas/types.yaml#/definitions/uint32
    description: Maximum valid SHARC core ID/count
    minimum: 1
    maximum: 2

  adi,core-stop-irqs:
    $ref: /schemas/types.yaml#/definitions/uint32-array
    description:
      SEC interrupt IDs used to signal each SHARC core to stop, ordered
      by core ID starting from core 1.
    items:
      - description: SEC interrupt ID for SHARC core 1
      - description: SEC interrupt ID for SHARC core 2

  adi,enable-reboot:
    type: boolean
    description:
      If present, register the RCU as the system restart handler.

required:
  - compatible
  - reg
  - "#reset-cells"
  - adi,sharc-min
  - adi,sharc-max
  - adi,core-stop-irqs

additionalProperties: false

examples:
  - |
    rcu: rcu@3108c000 {
      compatible = "syscon", "adi,reset-controller";
      reg = <0x3108c000 0x1000>;
      #reset-cells = <2>;
      adi,sharc-min = <1>;
      adi,sharc-max = <2>;
      adi,core-stop-irqs = <106 107>;
      adi,enable-reboot;
    };
```

## Documentation/devicetree/bindings/soc/adi/adi,sc846-miscreg.yaml
```yaml
# SPDX-License-Identifier: (GPL-2.0-only OR BSD-2-Clause)
%YAML 1.2
---
$id: http://devicetree.org/schemas/soc/adi/adi,sc846-miscreg.yaml#
$schema: http://devicetree.org/meta-schemas/core.yaml#

title: Analog Devices SC84x miscellaneous system registers (MISCREG)

maintainers:
  - Nuno Sá <nuno.sa@analog.com>

description: |
  MISCREG is the integration register file of the Analog Devices ADSP-SC84x.
  It gathers glue registers belonging to several otherwise unrelated hardware
  blocks:

    - tie-off ("bootstrap") inputs and reset masks for the two xSPI
      controllers and their PHYs
    - low power mode and soft reset requests for the two CAN-FD controllers
    - clock multiplexer selections for the timers, PWM, PCG and PTP inputs,
      and the Frac-N PLL output divider stage
    - RGMII pad skew for the two Ethernet MACs
    - DDR prefetch window selection for the SHARC-FX cores

properties:
  compatible:
    items:
      - const: adi,sc846-miscreg
      - const: simple-mfd
      - const: syscon

  reg:
    maxItems: 1

  reset-controller:
    $ref: /schemas/reset/adi,sc846-miscreg-reset.yaml#

required:
  - compatible
  - reg

additionalProperties: false

examples:
  - |
    syscon@310a9000 {
        compatible = "adi,sc846-miscreg", "simple-mfd", "syscon";
        reg = <0x310a9000 0x1000>;

        reset-controller {
            compatible = "adi,sc846-miscreg-reset";
            #reset-cells = <1>;
        };
    };
```

## Documentation/devicetree/bindings/sound/adi,adsp-sport.yaml
```yaml
# SPDX-License-Identifier: (GPL-2.0-only OR BSD-2-Clause)
%YAML 1.1
---
$id: http://devicetree.org/schemas/sound/adi,adsp-sport.yaml#
$schema: http://devicetree.org/meta-schemas/core.yaml#

title: Analog Devices ADSP SPORT (Serial Port) audio controller

maintainers:
  - Alvin Šipraga <alvin.sipraga@analog.com>

description:
  Analog Devices SPORT audio interface controller found on ADSP SoCs. A SPORT
  consists of two half-duplex serial audio interfaces capable of operating in
  common I2S/TDM modes.

allOf:
  - $ref: dai-common.yaml#

properties:
  compatible:
    oneOf:
      - items:
          - enum:
              - adi,adsp-sc571-sport
              - adi,adsp-sc573-sport
              - adi,adsp-sc584-sport
              - adi,adsp-sc589-sport
              - adi,adsp-sc594-sport
              - adi,adsp-sc846-sport
          - const: adi,adsp-sc598-sport
      - const: adi,adsp-sc598-sport

  reg:
    maxItems: 1

  interrupts:
    items:
      - description: Half A status/error interrupt
      - description: Half B status/error interrupt

  interrupt-names:
    items:
      - const: hsport-a
      - const: hsport-b

  dmas:
    items:
      - description: Half A DMA channel
      - description: Half B DMA channel

  dma-names:
    items:
      - const: hsport-a
      - const: hsport-b

  clocks:
    maxItems: 1

  clock-names:
    items:
      - const: sclk

  '#sound-dai-cells':
    const: 1

required:
  - compatible
  - reg
  - interrupts
  - interrupt-names
  - dmas
  - dma-names
  - clocks
  - '#sound-dai-cells'

unevaluatedProperties: false

examples:
  - |
    #include <dt-bindings/interrupt-controller/arm-gic.h>

    i2s@31002000 {
        compatible = "adi,adsp-sc598-sport";
        reg = <0x31002000 0x100>;
        interrupts = <GIC_SPI 82 IRQ_TYPE_LEVEL_HIGH>,
                     <GIC_SPI 84 IRQ_TYPE_LEVEL_HIGH>;
        interrupt-names = "hsport-a", "hsport-b";
        dmas = <&scb1_dma 0>, <&scb1_dma 1>;
        dma-names = "hsport-a", "hsport-b";
        clocks = <&clk 42>;
        clock-names = "sclk";
        #sound-dai-cells = <1>;
        sound-name-prefix = "SPORT0";
    };
```

## Documentation/devicetree/bindings/sound/cix,sky1-i2s-mc.yaml
```yaml
# SPDX-License-Identifier: (GPL-2.0-only OR BSD-2-Clause)
%YAML 1.2
---
$id: http://devicetree.org/schemas/sound/cix,sky1-i2s-mc.yaml#
$schema: http://devicetree.org/meta-schemas/core.yaml#

title: Cadence I2S-MC controller

maintainers:
  - Joakim Zhang <joakim.zhang@cixtech.com>

description: |
  The Cadence I2S-MC multi-channel controller integrated in the CIX SKY1
  audio subsystem. It provides up to 8-channel playback and capture through
  a configurable number of I2S data pins, and exposes two DAIs: a transmit
  DAI and a receive DAI.

allOf:
  - $ref: dai-common.yaml#

properties:
  compatible:
    const: cix,sky1-i2s-mc

  reg:
    maxItems: 1

  interrupts:
    maxItems: 1

  clocks:
    maxItems: 4

  clock-names:
    items:
      - const: hst
      - const: i2s
      - const: audio-clk0
      - const: audio-clk2

  resets:
    maxItems: 1

  dmas:
    minItems: 1
    maxItems: 2
    description:
      One DMA channel for instances wired for a single direction, either
      "tx" or "rx", or two channels for both transmit and receive.

  dma-names:
    minItems: 1
    items:
      - enum: [ tx, rx ]
      - const: rx

  "#sound-dai-cells":
    const: 1
    description:
      Cell selects the DAI, 0 for the transmit DAI (i2s-mc-aif1) and
      1 for the receive DAI (i2s-mc-aif2).

  cix,pin-out-num:
    $ref: /schemas/types.yaml#/definitions/uint8
    minimum: 1
    maximum: 8
    description:
      Number of I2S data output pins wired on this instance. Which of
      the 8 controller data pins are wired out is fixed by the board
      design and can be any subset.

  cix,pin-rx-mask:
    $ref: /schemas/types.yaml#/definitions/uint8
    description:
      Bit mask of I2S data pins used for capture, bit N selects data
      pin N.

  cix,pin-tx-mask:
    $ref: /schemas/types.yaml#/definitions/uint8
    description:
      Bit mask of I2S data pins used for playback, bit N selects data
      pin N. The rx and tx masks must not overlap, and the number of
      set bits must not exceed cix,pin-out-num.

required:
  - compatible
  - reg
  - interrupts
  - clocks
  - clock-names
  - resets
  - dmas
  - dma-names
  - "#sound-dai-cells"
  - cix,pin-out-num
  - cix,pin-rx-mask
  - cix,pin-tx-mask

unevaluatedProperties: false

examples:
  - |
    #include <dt-bindings/interrupt-controller/arm-gic.h>

    i2s@7050000 {
        compatible = "cix,sky1-i2s-mc";
        reg = <0x7050000 0x10000>;
        interrupts = <GIC_SPI 222 IRQ_TYPE_LEVEL_HIGH>;
        clocks = <&audss_cru 17>, <&audss_cru 27>,
                 <&scmi_clk 100>, <&scmi_clk 101>;
        clock-names = "hst", "i2s", "audio-clk0", "audio-clk2";
        resets = <&audss_cru 1>;
        dmas = <&audss_dmac 2>, <&audss_dmac 3>;
        dma-names = "tx", "rx";
        #sound-dai-cells = <1>;
        cix,pin-out-num = /bits/ 8 <2>;
        cix,pin-rx-mask = /bits/ 8 <0x1>;
        cix,pin-tx-mask = /bits/ 8 <0x2>;
    };
```

## Documentation/devicetree/bindings/sound/cix,sky1-i2s-sc.yaml
```yaml
# SPDX-License-Identifier: (GPL-2.0-only OR BSD-2-Clause)
%YAML 1.2
---
$id: http://devicetree.org/schemas/sound/cix,sky1-i2s-sc.yaml#
$schema: http://devicetree.org/meta-schemas/core.yaml#

title: Cadence I2S-SC controller

maintainers:
  - Joakim Zhang <joakim.zhang@cixtech.com>

description: |
  The Cadence I2S-SC controller integrated in the CIX SKY1 audio subsystem.
  It supports full-duplex stereo playback and capture in standard I2S,
  left/right-justified and DSP modes, as well as TDM operation with up to
  16 slots. The transmitter and receiver are started and stopped together
  by the controller.

allOf:
  - $ref: dai-common.yaml#

properties:
  compatible:
    const: cix,sky1-i2s-sc

  reg:
    maxItems: 1

  interrupts:
    maxItems: 1

  clocks:
    maxItems: 4

  clock-names:
    items:
      - const: hst
      - const: i2s
      - const: audio-clk0
      - const: audio-clk2

  resets:
    maxItems: 1

  dmas:
    minItems: 1
    maxItems: 2
    description:
      One DMA channel for instances wired for a single direction, either
      "tx" or "rx", or two channels for both transmit and receive.

  dma-names:
    minItems: 1
    items:
      - enum: [ tx, rx ]
      - const: rx

  "#sound-dai-cells":
    const: 0

required:
  - compatible
  - reg
  - interrupts
  - clocks
  - clock-names
  - resets
  - dmas
  - dma-names
  - "#sound-dai-cells"

unevaluatedProperties: false

examples:
  - |
    #include <dt-bindings/interrupt-controller/arm-gic.h>

    i2s@7020000 {
        compatible = "cix,sky1-i2s-sc";
        reg = <0x7020000 0x10000>;
        interrupts = <GIC_SPI 219 IRQ_TYPE_LEVEL_HIGH>;
        clocks = <&audss_cru 16>, <&audss_cru 26>,
                 <&scmi_clk 100>, <&scmi_clk 101>;
        clock-names = "hst", "i2s", "audio-clk0", "audio-clk2";
        resets = <&audss_cru 0>;
        dmas = <&audss_dmac 0>, <&audss_dmac 1>;
        dma-names = "tx", "rx";
        #sound-dai-cells = <0>;
    };
```

## Documentation/devicetree/bindings/sound/everest,es7202.yaml
```yaml
# SPDX-License-Identifier: (GPL-2.0-only OR BSD-2-Clause)
%YAML 1.2
---
$id: http://devicetree.org/schemas/sound/everest,es7202.yaml#
$schema: http://devicetree.org/meta-schemas/core.yaml#

title: Everest ES7202 2 channel PDM analog to digital converter

maintainers:
  - Jun Yan <jerrysteve1101@gmail.com>

properties:
  compatible:
    enum:
      - everest,es7202

  reg:
    maxItems: 1

  reset-gpios:
    maxItems: 1
    description: GPIO connected to the reset pin (active low)

  vdd-supply:
    description: Main power supply, 1.8 V or 3.3 V. Optional; defaults to 3.3 V

  "#sound-dai-cells":
    const: 0

required:
  - compatible
  - reg
  - "#sound-dai-cells"

allOf:
  - $ref: dai-common.yaml#

unevaluatedProperties: false

examples:
  - |
    #include <dt-bindings/gpio/gpio.h>

    i2c {
        #address-cells = <1>;
        #size-cells = <0>;

        es7202: codec@30 {
            compatible = "everest,es7202";
            reg = <0x30>;
            #sound-dai-cells = <0>;
            reset-gpios = <&gpio0 0 GPIO_ACTIVE_LOW>;
            vdd-supply = <&vcc3v3_sys>;
        };
    };
...
```
