## Documentation/devicetree/bindings/pinctrl/starfive,jhb100-adc0-pinctrl.yaml
```yaml
# SPDX-License-Identifier: GPL-2.0-only OR BSD-2-Clause
%YAML 1.2
---
$id: http://devicetree.org/schemas/pinctrl/starfive,jhb100-adc0-pinctrl.yaml#
$schema: http://devicetree.org/meta-schemas/core.yaml#

title: StarFive JHB100 ADC-0 Pin Controller

description: |
  Pinctrl bindings for JHB100 RISC-V SoC from StarFive Technology Ltd.

  The JHB100 SoC has 13 pinctrl domains - sys0, sys0h, sys1, sys2, per0, per1,
  per2, per2pok, per3, adc0, adc1, emmc, and vga.
  This document provides an overview of the "adc0" pinctrl domain.

  The "adc0" domain has a pin controller which provides
  - function selection for GPIO pads.
  - GPIO pad configuration.
  - GPIO interrupt handling.

  In the ADC-0 Pin Controller, there are 8 multi-function GPIO_PADs. Each of
  them can be multiplexed to several peripherals through function selection.
  Each iopad has a maximum of up to 4 functions - 0, 1, 2, and 3. Function 0
  is the default function which is generally the GPIO function. Function 1,
  2, and 3 are the alternate functions or peripheral signals that can be
  routed to an iopad. The function selection can be carried out by writing
  the function number to the iopad function select register.

  Each iopad is configurable with parameters such as input-enable, internal
  pull-up/pull-down bias, drive strength, schmitt trigger, slew rate, input
  debounce nanoseconds.

maintainers:
  - Changhuang Liang <changhuang.liang@starfivetech.com>

properties:
  compatible:
    items:
      - const: starfive,jhb100-adc0-pinctrl

  reg:
    maxItems: 1

  clocks:
    maxItems: 1

  resets:
    items:
      - description: ADC0 IOMUX
      - description: ADC0 core

  interrupts:
    maxItems: 1

  interrupt-controller: true

  '#interrupt-cells':
    const: 2

  gpio-controller: true

  '#gpio-cells':
    const: 2

  gpio-ranges: true

  gpio-line-names: true

patternProperties:
  '-grp$':
    type: object
    additionalProperties: false
    patternProperties:
      '-pins$':
        type: object
        description: |
          A pinctrl node should contain at least one subnode representing the
          pinctrl groups available in the domain. Each subnode will list the
          pins it needs, and how they should be configured, with regard to
          function selection, bias, input enable/disable, input schmitt
          trigger enable/disable, slew-rate, input debounce and
          drive-strength.
        allOf:
          - $ref: /schemas/pinctrl/pincfg-node.yaml
          - $ref: /schemas/pinctrl/pinmux-node.yaml
        additionalProperties: false

        properties:
          pins:
            description:
              The list of IOs that properties in the pincfg node apply to.

          function:
            description:
              A string containing the name of the function to mux for these
              pins.
            enum: [ adc, gpio, host0_port80, smbalert ]

          bias-disable: true

          bias-pull-down:
            type: boolean

          bias-pull-up:
            type: boolean

          drive-strength:
            enum: [ 2, 5, 8, 10, 14, 16, 18, 20 ]

          drive-strength-microamp:
            enum: [ 2000, 5000, 8000, 10000, 14000, 16000, 18000, 20000 ]

          input-debounce-ns:
            minimum: 0
            maximum: 10485680
            description:
              Debounce time in nanoseconds. The hardware counts in 80 ns
              stages with a 17-bit counter, so the maximum is 10485680 ns.

          input-disable: true

          input-enable: true

          input-schmitt-enable: true

          input-schmitt-disable: true

          slew-rate:
            enum: [ 0, 1 ]
            default: 0
            description: |
                0: slow
                1: fast

required:
  - compatible
  - reg
  - clocks
  - resets
  - interrupts
  - interrupt-controller
  - '#interrupt-cells'
  - gpio-controller
  - '#gpio-cells'
  - gpio-ranges

additionalProperties: false

examples:
  - |
    soc {
        #address-cells = <2>;
        #size-cells = <2>;

        pinctrl_adc0: pinctrl@11bc2800 {
            compatible = "starfive,jhb100-adc0-pinctrl";
            reg = <0x0 0x11bc2800 0x0 0x400>;
            clocks = <&per2crg 67>;
            resets = <&per2crg 10>,
                     <&per2crg 11>;
            interrupts = <147>;
            interrupt-controller;
            #interrupt-cells = <2>;
            gpio-controller;
            #gpio-cells = <2>;
            gpio-ranges = <&pinctrl_adc0 0 0 8>;
        };
    };
```

## Documentation/devicetree/bindings/pinctrl/starfive,jhb100-emmc-pinctrl.yaml
```yaml
# SPDX-License-Identifier: GPL-2.0-only OR BSD-2-Clause
%YAML 1.2
---
$id: http://devicetree.org/schemas/pinctrl/starfive,jhb100-emmc-pinctrl.yaml#
$schema: http://devicetree.org/meta-schemas/core.yaml#

title: StarFive JHB100 eMMC Pin Controller

description: |
  Pinctrl bindings for JHB100 RISC-V SoC from StarFive Technology Ltd.

  The JHB100 SoC has 13 pinctrl domains - sys0, sys0h, sys1, sys2, per0, per1,
  per2, per2pok, per3, adc0, adc1, emmc, and vga.
  This document provides an overview of the "emmc" pinctrl domain.

  The "emmc" domain has a pin controller which provides
  - function selection for GPIO pads.
  - GPIO pad configuration.
  - GPIO interrupt handling.

  In the eMMC Pin Controller, there are 12 multi-function GPIO_PADs. Each of
  them can be multiplexed to several peripherals through function selection.
  Each iopad has a maximum of up to 2 functions - 0 and 1. Function 0
  is the default function which is generally the GPIO function. Function 1
  is the alternate functions or peripheral signals that can be routed to an
  iopad. The function selection can be carried out by writing the function
  number to the iopad function select register.

  Each iopad is configurable with parameters such as input debounce
  nanoseconds.

maintainers:
  - Changhuang Liang <changhuang.liang@starfivetech.com>

properties:
  compatible:
    items:
      - const: starfive,jhb100-emmc-pinctrl

  reg:
    maxItems: 1

  clocks:
    maxItems: 1

  resets:
    maxItems: 1

  interrupts:
    maxItems: 1

  interrupt-controller: true

  '#interrupt-cells':
    const: 2

  gpio-controller: true

  '#gpio-cells':
    const: 2

  gpio-ranges: true

  gpio-line-names: true

patternProperties:
  '-grp$':
    type: object
    additionalProperties: false
    patternProperties:
      '-pins$':
        type: object
        description: |
          A pinctrl node should contain at least one subnode representing the
          pinctrl groups available in the domain. Each subnode will list the
          pins it needs, and how they should be configured, with regard to
          function selection and input debounce.
        allOf:
          - $ref: /schemas/pinctrl/pincfg-node.yaml
          - $ref: /schemas/pinctrl/pinmux-node.yaml
        additionalProperties: false

        properties:
          pins:
            description:
              The list of IOs that properties in the pincfg node apply to.

          function:
            description:
              A string containing the name of the function to mux for these
              pins.
            enum: [ emmc, gpio ]

          input-debounce-ns:
            minimum: 0
            maximum: 10485680
            description:
              Debounce time in nanoseconds. The hardware counts in 80 ns
              stages with a 17-bit counter, so the maximum is 10485680 ns.

required:
  - compatible
  - reg
  - interrupts
  - interrupt-controller
  - '#interrupt-cells'
  - gpio-controller
  - '#gpio-cells'
  - gpio-ranges

additionalProperties: false

examples:
  - |
    soc {
        #address-cells = <2>;
        #size-cells = <2>;

        pinctrl_emmc: pinctrl@11b42800 {
            compatible = "starfive,jhb100-emmc-pinctrl";
            reg = <0x0 0x11b42800 0x0 0x800>;
            interrupts = <119>;
            interrupt-controller;
            #interrupt-cells = <2>;
            gpio-controller;
            #gpio-cells = <2>;
            gpio-ranges = <&pinctrl_emmc 0 0 12>;
        };
    };
```

## Documentation/devicetree/bindings/pwm/nxp,pca9685-pwm.yaml
```yaml
# SPDX-License-Identifier: (GPL-2.0-only OR BSD-2-Clause)
%YAML 1.2
---
$id: http://devicetree.org/schemas/pwm/nxp,pca9685-pwm.yaml#
$schema: http://devicetree.org/meta-schemas/core.yaml#

title: NXP PCA9685 16-channel 12-bit PWM LED controller

maintainers:
  - Uwe Kleine-König <ukleinek@kernel.org>

allOf:
  - $ref: pwm.yaml#

properties:
  compatible:
    const: nxp,pca9685-pwm

  reg:
    maxItems: 1

  "#pwm-cells":
    const: 2
    description:
      The first cell is the PWM channel index, from 0 to 15, or 16 for the
      ALLCALL channel, which sets all PWM channels at the same time. The
      second cell is the PWM period in nanoseconds.

  invert:
    type: boolean
    description:
      Invert the logic state of all outputs (INVRT bit in the MODE2
      register). The setting applies to the whole chip, not to individual
      channels, and is typically used when the outputs drive an external
      driver stage.

  open-drain:
    type: boolean
    description:
      Configure all outputs with an open-drain structure (OUTDRV bit in the
      MODE2 register). If omitted, the outputs use a totem-pole structure.

required:
  - compatible
  - reg

unevaluatedProperties: false

examples:
  - |
    i2c {
        #address-cells = <1>;
        #size-cells = <0>;

        pwm@41 {
            compatible = "nxp,pca9685-pwm";
            reg = <0x41>;
            #pwm-cells = <2>;
            invert;
            open-drain;
        };
    };
```

## Documentation/devicetree/bindings/regulator/qcom,pm8150l-lcdb.yaml
```yaml
# SPDX-License-Identifier: GPL-2.0-only OR BSD-2-Clause
%YAML 1.2
---
$id: http://devicetree.org/schemas/regulator/qcom,pm8150l-lcdb.yaml#
$schema: http://devicetree.org/meta-schemas/core.yaml#

title: Qualcomm LCDB (LCD Bias) regulator

maintainers:
  - Dmitry Baryshkov <dmitry.baryshkov@oss.qualcomm.com>

description:
  LCDB is the LCD panel bias supply found on Qualcomm PMICs such as PMI632,
  PM6150L and PM8150L. It consists of a boost converter feeding an LDO, which
  provides the positive bias rail, and an inverting charge pump (NCP), which
  provides the negative one. Both rails are switched together by a single
  module enable.

properties:
  compatible:
    oneOf:
      - const: qcom,pm8150l-lcdb
      - items:
          - enum:
              - qcom,pm6150l-lcdb
              - qcom,pmi632-lcdb
          - const: qcom,pm8150l-lcdb

  reg:
    maxItems: 1

  interrupts:
    items:
      - description: short circuit on one of the outputs

  ldo:
    type: object
    $ref: regulator.yaml#
    unevaluatedProperties: false
    description: Positive bias rail.

  ncp:
    type: object
    $ref: regulator.yaml#
    unevaluatedProperties: false
    description:
      Negative bias rail. The voltage is specified as an absolute value.

required:
  - compatible
  - reg
  - interrupts

additionalProperties: false

examples:
  - |
    #include <dt-bindings/interrupt-controller/irq.h>

    pmic {
        #address-cells = <1>;
        #size-cells = <0>;

        regulator@ec00 {
            compatible = "qcom,pm8150l-lcdb";
            reg = <0xec00>;
            interrupts = <0x5 0xec 0x1 IRQ_TYPE_EDGE_RISING>;

            ldo {
                regulator-min-microvolt = <5500000>;
                regulator-max-microvolt = <5500000>;
            };

            ncp {
                regulator-min-microvolt = <5500000>;
                regulator-max-microvolt = <5500000>;
            };
        };
    };

...
```

## Documentation/devicetree/bindings/reset/adi,sc846-miscreg-reset.yaml
```yaml
# SPDX-License-Identifier: (GPL-2.0-only OR BSD-2-Clause)
%YAML 1.2
---
$id: http://devicetree.org/schemas/reset/adi,sc846-miscreg-reset.yaml#
$schema: http://devicetree.org/meta-schemas/core.yaml#

title: Analog Devices SC84x MISCREG reset controller

maintainers:
  - Nuno Sá <nuno.sa@analog.com>

description:
  Reset lines provided by the MISCREG integration register file of the Analog
  Devices ADSP-SC84x processors, covering the two xSPI controllers and the two
  CAN-FD controllers.

properties:
  compatible:
    const: adi,sc846-miscreg-reset

  '#reset-cells':
    const: 1

required:
  - compatible
  - '#reset-cells'

additionalProperties: false

examples:
  - |
    reset-controller {
        compatible = "adi,sc846-miscreg-reset";
        #reset-cells = <1>;
    };
```

## Documentation/devicetree/bindings/reset/ti,syscon-reset.yaml
```yaml
# SPDX-License-Identifier: (GPL-2.0-only OR BSD-2-Clause)
%YAML 1.2
---
$id: http://devicetree.org/schemas/reset/ti,syscon-reset.yaml#
$schema: http://devicetree.org/meta-schemas/core.yaml#

title: TI Syscon Reset Controller

maintainers:
  - Nishanth Menon <nm@ti.com>

description:
  Reset controller implemented by registers in the parent syscon.

properties:
  compatible:
    oneOf:
      - const: ti,syscon-reset
      - items:
          - enum:
              - ti,k2e-pscrst
              - ti,k2l-pscrst
              - ti,k2hk-pscrst
          - const: ti,syscon-reset

  '#reset-cells':
    const: 1

  ti,reset-bits:
    description: >
      Seven cells per reset, indexed by the reset specifier:

        Cell #1 : offset of the reset assert control register
        Cell #2 : bit position of the reset in the reset assert control register
        Cell #3 : offset of the reset deassert control register
        Cell #4 : bit position of the reset in the reset deassert control register
        Cell #5 : offset of the reset status register
        Cell #6 : bit position of the reset in the reset status register
        Cell #7 : Flags used to control reset behavior, available flags defined
                  in the DT include file <dt-bindings/reset/ti-syscon.h>

required:
  - compatible
  - '#reset-cells'
  - ti,reset-bits

additionalProperties: false

examples:
  - |
    #include <dt-bindings/reset/ti-syscon.h>

    reset-controller {
        compatible = "ti,k2e-pscrst", "ti,syscon-reset";
        #reset-cells = <1>;
        ti,reset-bits = <0xa3c 8 0xa3c 8 0x83c 8
                          (ASSERT_CLEAR | DEASSERT_SET | STATUS_CLEAR)>;
    };
```
