## drivers/crypto/adi/Kconfig
```kconfig
# SPDX-License-Identifier: GPL-2.0-only
config CRYPTO_DEV_ADI_CRC
	tristate "Support for ADI SC5XX CRC hardware"
	depends on ARCH_SC59X_64 || ARCH_SC59X || ARCH_SC58X || ARCH_SC57X || COMPILE_TEST
	depends on HAS_DMA
	select CRYPTO_HASH
	help
	  ADI SC5XX processors have CRC hardware. Select this if you
	  want to use the ADI SC5XX CRC module. It provides the keyed
	  hmac(crc32) hash, where the key is the CRC seed, and is used
	  through the crypto API or cryptodev.

config CRYPTO_DEV_ADI_PKTE
	tristate "Support for the ADI SC59x security packet engine"
	depends on ARCH_SC59X || ARCH_SC59X_64 || COMPILE_TEST
	depends on HAS_DMA
	select CRYPTO_ENGINE
	help
	  This enables the security packet engine (PKTE) found on ADI SC59x
	  processors. Requests are queued through the crypto engine and
	  processed by the PKTE in autonomous ring mode by default. Select
	  the algorithms to offload below.

config CRYPTO_DEV_ADI_HASH
	bool "Support for ADI hash acceleration"
	depends on CRYPTO_DEV_ADI_PKTE
	default y
	select CRYPTO_HASH
	select CRYPTO_MD5
	select CRYPTO_SHA1
	select CRYPTO_SHA256
	help
	  This enables MD5, SHA1, SHA224 and SHA256 hashes and their HMAC
	  variants on the ADI packet engine.

config CRYPTO_DEV_ADI_SKCIPHER
	bool "Support for ADI symmetric ciphers"
	depends on CRYPTO_DEV_ADI_PKTE
	default y
	select CRYPTO_SKCIPHER
	select CRYPTO_LIB_DES
	help
	  This enables AES, DES and 3DES in ECB and CBC modes on the ADI
	  packet engine. Requests are limited to the 8 KiB engine buffer;
	  larger requests are rejected so callers must split them or use
	  a software implementation.
```

## drivers/firmware/arm/Kconfig
```kconfig
# SPDX-License-Identifier: GPL-2.0-only

source "drivers/firmware/arm/ffa/Kconfig"
source "drivers/firmware/arm/psci/Kconfig"
source "drivers/firmware/arm/rmm/Kconfig"
source "drivers/firmware/arm/scmi/Kconfig"
source "drivers/firmware/arm/smccc/Kconfig"

config ARM_SCPI_PROTOCOL
	tristate "ARM System Control and Power Interface (SCPI) Message Protocol"
	depends on ARM || ARM64 || COMPILE_TEST
	depends on MAILBOX
	help
	  System Control and Power Interface (SCPI) Message Protocol is
	  defined for the purpose of communication between the Application
	  Cores(AP) and the System Control Processor(SCP). The MHU peripheral
	  provides a mechanism for inter-processor communication between SCP
	  and AP.

	  SCP controls most of the power management on the Application
	  Processors. It offers control and management of: the core/cluster
	  power states, various power domain DVFS including the core/cluster,
	  certain system clocks configuration, thermal sensors and many
	  others.

	  This protocol library provides interface for all the client drivers
	  making use of the features offered by the SCP.

config ARM_SDE_INTERFACE
	bool "ARM Software Delegated Exception Interface (SDEI)"
	depends on ARM64
	help
	  The Software Delegated Exception Interface (SDEI) is an ARM
	  standard for registering callbacks from the platform firmware
	  into the OS. This is typically used to implement RAS notifications.

config ARM_SDEI_NMI
	bool "SDEI-based cross-CPU NMI service (arm64)"
	depends on ARM_SDE_INTERFACE
	help
	  Provides SDEI-based cross-CPU NMI delivery for hooks that need
	  to reach interrupt-masked CPUs on silicon that lacks FEAT_NMI:

	    - arch_trigger_cpumask_backtrace()  (sysrq-l, RCU stalls,
	      hardlockup_all_cpu_backtrace, soft-lockup secondary dumps,
	      hung-task auxiliary dumps)
	    - smp_send_stop() escalation         (reboot/halt and the
	      panic / kdump crash stop)

	  The driver registers a handler for the SDEI software-signalled
	  event (event 0) and reaches a target CPU by signalling it with
	  SDEI_EVENT_SIGNAL. Firmware delivers the event out of EL3
	  regardless of the target's PSTATE.DAIF -- forced delivery into a
	  CPU wedged with interrupts locally masked.

	  If unsure, say N.
```

## drivers/iio/beamformer/Kconfig
```kconfig
#
# Beamformer drivers
#
# When adding new entries keep the list in alphabetical order

menu "Beamformers"

config ADAR1000
	tristate "Analog Devices ADAR1000 Beamformer driver"
	depends on SPI
	help
	  Say yes here to build support for Analog Devices ADAR1000 beamformer
	  driver.

	  To compile this driver as a module, choose M here: the module will be
	  called adar1000.

config ADAR2001
	tristate "Analog Devices ADAR2001 Frequency Multiplier driver"
	depends on SPI
	select REGMAP_SPI
	help
	  Say yes here to build support for Analog Devices ADAR2001 10GHz to
	  40GHz 1:4 channel frequency multiplier and filter transmitter.

	  To compile this driver as a module, choose M here: the module will be
	  called adar2001.

config ADAR3000
	tristate "Analog Devices ADAR3000 Beamformer driver"
	depends on SPI
	help
	  Say yes here to build support for Analog Devices ADAR3000 beamformer
	  driver.

	  To compile this driver as a module, choose M here: the module will be
	  called adar3000.

endmenu
```

## drivers/iio/logic/Kconfig
```kconfig
#
# Logi Analyzer drivers
#
# When adding new entries keep the list in alphabetical order

menu "Logic Analyzers"

config M2K_LOGIC_ANALYZER
	tristate "M2k Logic Analyzer support"
	help
	  Support for the Logic Analyzer module on the Analog Devices
	  ADALM-2000 (M2k) platform.

endmenu

config AXI_AION_TRIG
	tristate "AXI AION Trigger support"
	help
	  Support for the AXI AION Trigger module HDL IP Core.

config ADSY1100_NYX
	tristate "Analog Devices ADSY1100 Nyx RF front-end controller"
	depends on GPIOLIB && OF
	help
	  Say yes here to support the Nyx RF front-end daughter board on the
	  Analog Devices ADSY1100 Apollo SOM platform.

	  The driver exposes per-channel digital step attenuator settings
	  (in dB), filter band selection, channel powerdown and RX LNA
	  bypass through the IIO sysfs interface, driving the underlying
	  GPIOs as a single high-level device.
```
