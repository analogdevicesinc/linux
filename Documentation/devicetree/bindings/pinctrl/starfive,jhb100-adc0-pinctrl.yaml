## Documentation/devicetree/bindings/sound/nvidia,tegra-audio-complex.yaml
```yaml
# SPDX-License-Identifier: (GPL-2.0-only OR BSD-2-Clause)
%YAML 1.2
---
$id: http://devicetree.org/schemas/sound/nvidia,tegra-audio-complex.yaml#
$schema: http://devicetree.org/meta-schemas/core.yaml#

title: NVIDIA Tegra audio complex

maintainers:
  - Jon Hunter <jonathanh@nvidia.com>
  - Thierry Reding <thierry.reding@gmail.com>
  - Svyatoslav Ryhel <clamor95@gmail.com>

properties:
  compatible:
    oneOf:
      - items:
          - pattern: '^[a-z0-9]+,tegra-audio-max(98088|98089|98090)([-_][a-z0-9]+)+$'
          - enum:
              - nvidia,tegra-audio-max98088
              - nvidia,tegra-audio-max98089
              - nvidia,tegra-audio-max98090
      - items:
          - pattern: '^[a-z0-9]+,tegra-audio-rt(5631|5639|5640|5677)([-_][a-z0-9]+)+$'
          - enum:
              - nvidia,tegra-audio-rt5631
              - nvidia,tegra-audio-rt5640
              - nvidia,tegra-audio-rt5677
      - items:
          - pattern: '^[a-z0-9]+,tegra-audio-wm(8753|8903|8962|8994|9712)([-_][a-z0-9]+)+$'
          - enum:
              - nvidia,tegra-audio-wm8753
              - nvidia,tegra-audio-wm8903
              - nvidia,tegra-audio-wm8962
              - nvidia,tegra-audio-wm8994
              - nvidia,tegra-audio-wm9712
      - items:
          - pattern: '^[a-z0-9]+,tegra-audio-alc5632(-[a-z0-9]+)+$'
          - const: nvidia,tegra-audio-alc5632
      - items:
          - pattern: '^motorola,tegra-audio-cpcap(-[a-z0-9]+)+$'
          - const: nvidia,tegra-audio-cpcap
      - items:
          - pattern: '^nvidia,tegra-audio-max98090-nyan-(big|blaze)+$'
          - const: nvidia,tegra-audio-max98090-nyan
          - const: nvidia,tegra-audio-max98090
      - items:
          - pattern: '^[a-z0-9]+,tegra-audio-sgtl5000([-_][a-z0-9]+)+$'
          - const: nvidia,tegra-audio-sgtl5000
      - items:
          const: nvidia,tegra-audio-trimslice
      - items:
          - pattern: ad,tegra-audio-plutux
          - const: nvidia,tegra-audio-wm8903

  clocks:
    items:
      - description: PLL A clock
      - description: PLL A OUT0 clock
      - description: The Tegra cdev1/extern1 clock, which feeds the card's mclk

  clock-names:
    items:
      - const: pll_a
      - const: pll_a_out0
      - const: mclk

  nvidia,model:
    $ref: /schemas/types.yaml#/definitions/string
    description: The user-visible name of this sound complex.

  nvidia,audio-routing:
    $ref: /schemas/types.yaml#/definitions/non-unique-string-array
    description: |
      A list of the connections between audio components.
      Each entry is a pair of strings, the first being the connection's sink,
      the second being the connection's source. Valid names for sources and
      sinks are the codec pins and the jacks on the board.

  nvidia,ac97-controller:
    $ref: /schemas/types.yaml#/definitions/phandle
    description: The phandle of the AC97 controller

  nvidia,i2s-controller:
    $ref: /schemas/types.yaml#/definitions/phandle
    description: The phandle of the Tegra I2S controller

  nvidia,audio-codec:
    $ref: /schemas/types.yaml#/definitions/phandle
    description: The phandle of audio codec

  nvidia,aux-devs:
    $ref: /schemas/types.yaml#/definitions/phandle-array
    description: List of phandles pointing to auxiliary devices,
      such as amplifiers or dsp, to be added to the sound card.

  nvidia,spkr-en-gpios:
    maxItems: 1
    description: The GPIO that enables the speakers

  nvidia,hp-mute-gpios:
    maxItems: 1
    description: The GPIO that mutes the headphones

  nvidia,hp-det-gpios:
    maxItems: 1
    description: The GPIO that detect headphones are plugged in

  nvidia,mic-det-gpios:
    maxItems: 1
    description: The GPIO that detect microphone is plugged in

  nvidia,ear-sel-gpios:
    maxItems: 1
    description: The GPIO that switch between the microphones

  nvidia,int-mic-en-gpios:
    maxItems: 1
    description: The GPIO that enables the internal microphone

  nvidia,ext-mic-en-gpios:
    maxItems: 1
    description: The GPIO that enables the external microphone

  nvidia,headset:
    type: boolean
    description: The Mic Jack represents state of the headset microphone pin

  nvidia,coupled-mic-hp-det:
    type: boolean
    description: The Mic detect GPIO is viable only if HP detect GPIO is active

oneOf:
  - required:
      - nvidia,i2s-controller
  - required:
      - nvidia,ac97-controller

additionalProperties: false

examples:
  - |
    #include <dt-bindings/clock/tegra20-car.h>
    #include <dt-bindings/gpio/gpio.h>

    sound {
        compatible = "lg,tegra-audio-wm8994-star",
                     "nvidia,tegra-audio-wm8994";
        nvidia,model = "LG Optimus 2X WM8994";

        nvidia,audio-routing =
                "Headphone Jack", "HPOUT1L",
                "Headphone Jack", "HPOUT1R",
                "Int Spk", "SPKOUTLN",
                "Int Spk", "SPKOUTLP",
                "Earpiece", "HPOUT2N",
                "Earpiece", "HPOUT2P",
                "IN2RN", "MICBIAS2",
                "IN2RN", "Mic Jack",
                "IN1LN", "MICBIAS1",
                "IN1LN", "Internal Mic 1",
                "IN1RN", "MICBIAS1",
                "IN1RN", "Internal Mic 2";

        nvidia,i2s-controller = <&tegra_i2s1>;
        nvidia,audio-codec = <&wm8994>;

        nvidia,hp-det-gpios = <&gpio 51 GPIO_ACTIVE_HIGH>;
        nvidia,mic-det-gpios = <&gpio 27 GPIO_ACTIVE_HIGH>;
        nvidia,ext-mic-en-gpios = <&gpio 57 GPIO_ACTIVE_HIGH>;
        nvidia,coupled-mic-hp-det;

        clocks = <&tegra_car TEGRA20_CLK_PLL_A>,
                 <&tegra_car TEGRA20_CLK_PLL_A_OUT0>,
                 <&tegra_car TEGRA20_CLK_CDEV1>;
        clock-names = "pll_a", "pll_a_out0", "mclk";
    };
  - |
    #include <dt-bindings/clock/tegra30-car.h>
    #include <dt-bindings/gpio/gpio.h>
    #include <dt-bindings/soc/tegra-pmc.h>

    sound {
        compatible = "asus,tegra-audio-rt5631-tf700t",
                     "nvidia,tegra-audio-rt5631";
        nvidia,model = "Asus Transformer Infinity TF700T RT5631";

        nvidia,audio-routing =
                "Headphone Jack", "HPOL",
                "Headphone Jack", "HPOR",
                "Int Spk", "SPOL",
                "Int Spk", "SPOR",
                "MIC1", "MIC Bias1",
                "MIC1", "DSP Analog Mic",
                "DSP AMIC", "Mic Jack",
                "DMIC", "DSP Digital Mic",
                "DSP DMIC", "Int Mic";

        nvidia,i2s-controller = <&tegra_i2s1>;
        nvidia,audio-codec = <&rt5631>;
        nvidia,aux-devs = <&fm34ne>;

        nvidia,hp-det-gpios = <&gpio 178 GPIO_ACTIVE_LOW>;
        nvidia,mic-det-gpios = <&gpio 186 GPIO_ACTIVE_LOW>;
        nvidia,coupled-mic-hp-det;

        clocks = <&tegra_car TEGRA30_CLK_PLL_A>,
                 <&tegra_car TEGRA30_CLK_PLL_A_OUT0>,
                 <&tegra_pmc TEGRA_PMC_CLK_OUT_1>;
        clock-names = "pll_a", "pll_a_out0", "mclk";
    };
  - |
    #include <dt-bindings/clock/tegra124-car.h>

    sound {
        compatible = "nvidia,tegra-audio-max98090-venice2",
                     "nvidia,tegra-audio-max98090";
        nvidia,model = "NVIDIA Tegra Venice2";

        nvidia,audio-routing =
                "Headphones", "HPR",
                "Headphones", "HPL",
                "Speakers", "SPKR",
                "Speakers", "SPKL",
                "Mic Jack", "MICBIAS",
                "IN34", "Mic Jack";

        nvidia,i2s-controller = <&tegra_i2s1>;
        nvidia,audio-codec = <&acodec>;

        clocks = <&tegra_car TEGRA124_CLK_PLL_A>,
                 <&tegra_car TEGRA124_CLK_PLL_A_OUT0>,
                 <&tegra_car TEGRA124_CLK_EXTERN1>;
        clock-names = "pll_a", "pll_a_out0", "mclk";
    };
```

## Documentation/devicetree/bindings/spi/adi,spi3.yaml
```yaml
# SPDX-License-Identifier: (GPL-2.0-only OR BSD-2-Clause)
%YAML 1.2
---
$id: http://devicetree.org/schemas/spi/adi,spi3.yaml#
$schema: http://devicetree.org/meta-schemas/core.yaml#

title: ADI ADSP-SC5xx / SC84x SPI3 controller

maintainers:
  - Michael Hennerich <michael.hennerich@analog.com>

description: |
  Enhanced SPI (SPI3) controller found on the ADI ADSP-SC5xx / SC84x
  processor family. Supports PIO and DMA transfers, GPIO chip selects,
  and an optional SPI Offload streaming mode in which hardware-triggered
  transactions run autonomously through dedicated DMA channels
  (trigger routed via the on-chip TRU, e.g. from a data-ready pin).

allOf:
  - $ref: spi-controller.yaml#

properties:
  compatible:
    const: adi,spi3

  reg:
    maxItems: 1

  interrupts:
    maxItems: 1

  clocks:
    maxItems: 1

  clock-names:
    const: spi

  dmas:
    minItems: 1
    maxItems: 4

  dma-names:
    description: |
      Regular "tx"/"rx" channels serve slaves that opt into DMA via
      adi,enable-dma; when absent, non-offload transfers fall back to
      PIO. "offload-tx"/"offload-rx" declare the dedicated SPI Offload
      stream channels handed to the offload consumer; listing
      "offload-rx" (and optionally "offload-tx") advertises the
      corresponding SPI_OFFLOAD_CAP_*_STREAM_DMA capabilities. On
      parts with a single physical DMA channel per direction, a port
      is either regular or offload-only.
    minItems: 1
    maxItems: 4
    items:
      enum: [ tx, rx, offload-tx, offload-rx ]

  trigger-sources:
    description: |
      Phandle to a SPI offload trigger provider (e.g. the TRU-backed
      data-ready trigger, see
      trigger-source/adi,sc59x-spi-offload-trigger.yaml). Presence of
      this property enables the SPI Offload provider on this port.
    maxItems: 1

required:
  - compatible
  - reg
  - interrupts
  - clocks
  - clock-names

unevaluatedProperties: false

examples:
  - |
    #include <dt-bindings/interrupt-controller/arm-gic.h>

    /* Offload-only port streaming an ADEMA127 via hardware triggers */
    spi@3102e000 {
        #address-cells = <1>;
        #size-cells = <0>;
        compatible = "adi,spi3";
        reg = <0x3102e000 0xff>;
        interrupts = <GIC_SPI 233 IRQ_TYPE_LEVEL_HIGH>;
        clocks = <&clk 25>;
        clock-names = "spi";
        dmas = <&spi_cluster 22>, <&spi_cluster 23>;
        dma-names = "offload-tx", "offload-rx";
        trigger-sources = <&adema_dready_trigger>;
    };
...
```

## Documentation/devicetree/bindings/spi/spi-virtio.yaml
```yaml
# SPDX-License-Identifier: (GPL-2.0-only OR BSD-2-Clause)
%YAML 1.2
---
$id: http://devicetree.org/schemas/spi/spi-virtio.yaml#
$schema: http://devicetree.org/meta-schemas/core.yaml#

title: Virtio SPI controller device

maintainers:
  - Francesco Valla <francesco@valla.it>

allOf:
  - $ref: /schemas/spi/spi-controller.yaml#
  - $ref: /schemas/virtio/virtio-device.yaml#

properties:
  compatible:
    const: virtio,device2d

required:
  - compatible

unevaluatedProperties: false

examples:
  - |
    virtio@3000 {
        compatible = "virtio,mmio";
        reg = <0x3000 0x100>;
        interrupts = <41>;

        spi {
            compatible = "virtio,device2d";

            #address-cells = <1>;
            #size-cells = <0>;

            sram@0 {
                compatible = "microchip,mchp23k256";
                reg = <0>;
                spi-max-frequency = <20000000>;
            };
        };
    };

...
```

## Documentation/devicetree/bindings/timer/adi,sc5xx-gptimers.yaml
```yaml
# SPDX-License-Identifier: (GPL-2.0-only OR BSD-2-Clause)
%YAML 1.2
---
$id: http://devicetree.org/schemas/timer/adi,sc5xx-gptimers.yaml#
$schema: http://devicetree.org/meta-schemas/core.yaml#

title: ADI ADSP-SC5xx / SC84x general-purpose timer block

maintainers:
  - Michael Hennerich <michael.hennerich@analog.com>

description: |
  Block of up to 16 general-purpose 32-bit timers. Individual timers are
  described as children and can serve as the system clocksource, the
  clockevent device, userspace counters, or as a TRU trigger generator
  that converts edges on the timer's TMR input pin into trigger pulses
  (EXTCLK mode with PER=1) — the data-ready trigger source for SPI
  offload streaming.

properties:
  compatible:
    const: adi,sc5xx-gptimers

  reg:
    maxItems: 1

  clocks:
    maxItems: 1

  "#address-cells":
    const: 1

  "#size-cells":
    const: 0

patternProperties:
  "^gptimer@[0-9a-f]+$":
    type: object
    additionalProperties: false

    properties:
      reg:
        description: Timer index within the block (0..15).
        maxItems: 1

      interrupts:
        maxItems: 1

      clocks:
        description: The timer block clock (SCLK0), also referenced per
          timer by some SoC device trees.
        maxItems: 1

      adi,offset:
        description: Byte offset of this timer's register group within
          the block.
        $ref: /schemas/types.yaml#/definitions/uint32

      adi,is-clocksource:
        description: Register this timer as the system clocksource.
        type: boolean

      adi,is-clockevent:
        description: Register this timer as the clockevent device.
        type: boolean

      adi,reset-timer:
        description: Reinitialize the timer even if firmware left it
          running.
        type: boolean

      adi,mode-extclk-gen:
        description: |
          Dedicate this timer as a TRU trigger generator: EXTCLK mode
          counting edges on the TMR input pin with PER=1, so every input
          edge fires the timer's TRG output into the Trigger Routing
          Unit. The timer is then a pure trigger source (no clocksource,
          clockevent or counter registration). Requires the TMR pin to be
          pinmuxed to the timer and its pad input buffer enabled.
        type: boolean

      adi,extclk-active-low:
        description: In EXTCLK trigger-generator mode, count falling
          edges of the TMR input instead of rising edges (for active-low
          data-ready strobes).
        type: boolean

    required:
      - reg
      - interrupts
      - adi,offset

required:
  - compatible
  - reg
  - clocks

additionalProperties: false

examples:
  - |
    #include <dt-bindings/interrupt-controller/arm-gic.h>

    timers@31018000 {
        compatible = "adi,sc5xx-gptimers";
        reg = <0x31018000 0x200>;
        clocks = <&clk 19>;
        #address-cells = <1>;
        #size-cells = <0>;

        gptimer@0 {
            reg = <0>;
            interrupts = <GIC_SPI 48 IRQ_TYPE_LEVEL_HIGH>;
            adi,offset = <0x60>;
            adi,mode-extclk-gen;
            adi,extclk-active-low;
        };

        gptimer@1 {
            reg = <1>;
            interrupts = <GIC_SPI 49 IRQ_TYPE_LEVEL_HIGH>;
            adi,offset = <0x80>;
            adi,is-clockevent;
            adi,reset-timer;
        };
    };
...
```
