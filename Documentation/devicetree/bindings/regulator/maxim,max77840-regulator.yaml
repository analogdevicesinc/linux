## Documentation/devicetree/bindings/remoteproc/adi-rproc.txt
```
Remoteproc bindings for SC5xx Analog Devices processors
----------------------------------------

This document describes device tree binding for adi,remoteproc driver
wchich loads and boots firmware on SHARC cores.

Required properties:
- compatible	should be: "adi,remoteproc"
- reg			specifies program memore of the SHARC core
- core-id		core number
- core-irq		irq number to tell firmware to perform shutdown procedure
- firmware-name firmware file to start automactilly
- adi,rcu		phandle to Remote Control Unit
- adi,l1-da		L1 memory region of the core
- adi,l2-da		L2 memory region shared between cores (ARM, SHARC1, SHARC2)
- adi,verify 	set if need to verify loaded firmware before boot


Optional properties:
- adi,rsc-table		phandle to resource table memory region shared with SHARC core
					if specified then interrupts; adi,tru; adi,tru-master-id parameters
					are required the remoteproc driver tries to probe rpmsg bus for the core

- adi,tru 		phandle to Trigger Routing Unit for ICC interrupts

- interrupts	ICC interrupt for rpmsg communication

- adi,tru-master-id ICC interrupt number to notify remote core

- vdev-vring		phadle to reserved memory region for rpmsg vdev0vrings,
					if not specified allocates buffer from DMA pool.

- memory-region		phandle to reserved memory for rpmsg message buffers,
					if not specified allocates buffer from DMA pool.
					(See: ../reserved-memory/reserved-memory.txt)

The size of vdev-vring specifies how many message buffers are allocated
for tx and rx (combined) overriding the default number specified in
MAX_RPMSG_NUM_BUFS. The memory-region size must match (or be larger) selected
number of messages times MAX_RPMSG_BUF_SIZE (default 512).
E.g. for 1024 message buffers (512 for rx and 512 for tx):
	vdev-vring size = 0x0000a000
	memory-region size = 0x00080000

Selection table for MAX_RPMSG_BUF_SIZE=512 (default):

rpmsg   |            |
buffers | vdev-vring | memory-region
---------------------------------
    256 | 0x00004000 | 0x00020000
    512 | 0x00006000 | 0x00040000
   1024 | 0x0000a000 | 0x00080000
   2048 | 0x00010000 | 0x00100000
   4096 | 0x0001e000 | 0x00200000
   8192 | 0x00038000 | 0x00400000
  16384 | 0x0006c000 | 0x00800000
  32768 | 0x000d4000 | 0x01000000
  65536 | 0x001a4000 | 0x02000000
 131072 | 0x00344000 | 0x04000000
 262144 | 0x00684000 | 0x08000000
 524288 | 0x00d04000 | 0x10000000
1048576 | 0x01a04000 | 0x20000000
2097152 | 0x03404000 | 0x40000000
4194304 | 0x06804000 | 0x80000000

Example:

	reserved-memory {
		vdev0vrings: vdev0vring0@20080000 {
			reg = <0x20080000 0x4000>;
			no-map;
		};

		vdev0buffer: vdev0buffer@20084000 {
			compatible = "shared-dma-pool";
			reg = <0x20084000 0x20000>;
			no-map;
		};

		vdev1vrings: vdev0vring0@200A4000 {
			reg = <0x200A4000 0x4000>;
			no-map;
		};

		vdev1buffer: vdev0buffer@200A8000 {
			compatible = "shared-dma-pool";
			reg = <0x200A8000 0x20000>;
			no-map;
		};
	};

	sharc0: core1-rproc@0x28240000 {
		status = "okay";
		compatible = "adi,remoteproc";
		reg = <0x28240000 0x160000>,
				<0x20000000 0x200000>;
		core-id = <1>;
		core-irq = <106>; /* SOFT1 */
		firmware-name = "adi_adsp_core1_fw.ldr";
		interrupts = <GIC_SPI 337 IRQ_TYPE_EDGE_RISING>; /* TRU0_SLV3 */
		adi,rcu = <&rcu>;
		adi,l1-da = <0x240000 0x3a0000>;
		adi,l2-da = <0x20000000 0x20200000>;
		adi,rsc-table = <&rsc_tbl0>;
		adi,verify = <1>;
		adi,tru = <&tru>;
		adi,tru-master-id = <135>; /* trigger master SOFT4 */
		vdev-vring = <&vdev0vrings>;
		memory-region = <&vdev0buffer>;
	};

	sharc1: core2-rproc@0x28a40000 {
		status = "okay";
		compatible = "adi,remoteproc";
		reg = <0x28a40000 0x160000>,
				<0x20000000 0x200000>;
		core-id = <2>;
		core-irq = <107>; /* SOFT2 */
		firmware-name = "adi_adsp_core2_fw.ldr";
		interrupts = <GIC_SPI 337 IRQ_TYPE_EDGE_RISING>; /* TRU0_SLV3 */
		adi,rcu = <&rcu>;
		adi,l1-da = <0x240000 0x3a0000>;
		adi,l2-da = <0x20000000 0x20200000>;
		adi,rsc-table = <&rsc_tbl1>;
		adi,verify = <1>;
		adi,tru = <&tru>;
		adi,tru-master-id = <136>; /* trigger master SOFT5 */
		vdev-vring = <&vdev1vrings>;
		memory-region = <&vdev1buffer>;
	};
```

## Documentation/devicetree/bindings/reset/adi,sc5xx-reset.yaml
```yaml
# SPDX-License-Identifier: (GPL-2.0-only OR BSD-2-Clause)
%YAML 1.2
---
$id: http://devicetree.org/schemas/reset/adi,sc5xx-reset.yaml#
$schema: http://devicetree.org/meta-schemas/core.yaml#

title: Analog Devices Reset Controller for SC5XX processor family

description: SHARC and ARM core reset control unit for starting/stopping/resetting
  processors

maintainers:
  - Arturs Artamonovs <arturs.artamonovs@analog.com>
  - Utsav Agarwal <Utsav.Agarwal@analog.com>

properties:
  compatible:
    enum:
      - adi,sc5xx-reset

  reg:
    maxItems: 1

  "#reset-cells":
    const: 0

required:
  - compatible
  - reg
  - "#reset-cells"

additionalProperties: false

examples:
  - |
    reset-controller@3108c000 {
      compatible = "adi,sc5xx-reset";
      reg = <0x3108c000 0x1000>;
      #reset-cells = <0>;
    };
```

## Documentation/devicetree/bindings/reset/nxp,dispmix-clk-en.txt
```
NXP Display Mix clk-en Reset Controller
=======================================

This binding describes a reset controller device that is used to enable
or disable the internal clocks for all the submodules(such as, LCDIF,
MIPI DSI, MIPI CSI, ISI and etc) included by the Display Mix subsystem
on IMX8MM and IMX8MN platforms. Like sft-rstn, only assert and deassert
functions are required for submodule internal clocks enable or disable,
that means the clk-en can be treated as a real reset controller.

Please also refer to reset.txt in this directory for common reset
controller binding usage.

Required properties:
- compatible: Should be "fsl,imx8mm-dispmix-clk-en" or
			"fsl,imx8mn-dispmix-clk-en".
- reg: should be register base and length as documented in the datasheet.
- clocks: phandle and clock specifier to disp apb clock for register access.
- clock-names: should be "disp-apb".
- power-domains: phandle to dispmix power domain.
- reset-cells: 1, see below.

example:

	dispmix_clk_en: dispmix-clk-en@32e28004 {
		compatible = "fsl,imx8mn-dispmix-clk-en";
		reg = <0x0 0x32e28004 0x0 0x4>;
		clocks = <&clk IMX8MN_CLK_DISP_APB_ROOT>;
		clock-names = "disp-apb";
		power-domains = <&dispmix_pd>;
		#reset-cells = <1>;
	};

Specifying clk-en control of devices
====================================

Device nodes in Display Mix should specify the reset channel required in
their "resets" property, containing a phandle to the clk-en device node
and an index to specify which channel to use, as described in
Documentation/devicetree/bindings/reset/reset.txt.

example:

	lcdif_resets: lcdif-resets {
		#address-cells = <1>;
		#size-cells = <0>;
		#reset-cells = <0>;

		lcdif-clk-enable {
			compatible = "lcdif,clk-enable";
			resets = <&dispmix_clk_en IMX8MN_LCDIF_APB_CLK_EN>,
				 <&dispmix_clk_en IMX8MN_LCDIF_PIXEL_CLK_EN>;
		};
	};

Macro definitions for the supported reset channels can be found in:
include/dt-bindings/reset/imx8mm-dispmix.h and
include/dt-bindings/reset/imx8mn-dispmix.h.
```

## Documentation/devicetree/bindings/reset/nxp,dispmix-mipi-rst.txt
```
NXP Display Mix mipi-rst Reset Controller
=========================================

This binding describes a reset controller device that is used to reset
or de-reset the MIPI DPHY master direction(for MIPI DSI) and slave
direction(for MIPI CSI) included by the Display Mix subsystem on IMX8MM
and IMX8MN platforms. Like sft-rstn, only assert and deassert functions
are required for PHY reset or de-reset.

Please also refer to reset.txt in this directory for common reset
controller binding usage.

Required properties:
- compatible: Should be "fsl,imx8mm-dispmix-mipi-rst" or
			"fsl,imx8mn-dispmix-mipi-rst".
- reg: should be register base and length as documented in the datasheet.
- clocks: phandle and clock specifier to disp apb clock for register access.
- clock-names: should be "disp-apb".
- power-domains: phandle to dispmix power domain.
- reset-cells: 1, see below.

example:

	dispmix_mipi_rst: dispmix-mipi-rst@32e28008 {
		compatible = "fsl,imx8mn-dispmix-mipi-rst";
		reg = <0x0 0x32e28008 0x0 0x4>;
		clocks = <&clk IMX8MN_CLK_DISP_APB_ROOT>;
		clock-names = "disp-apb";
		active_low;
		power-domains = <&dispmix_pd>;
		#reset-cells = <1>;
	};

Specifying mipi-rst control of devices
======================================

Device nodes in Display Mix should specify the reset channel required in
their "resets" property, containing a phandle to the mipi-rst device node
and an index to specify which channel to use, as described in
Documentation/devicetree/bindings/reset/reset.txt.

example:

	mipi_dsi_resets: mipi-dsi-resets {
		#address-cells = <1>;
		#size-cells = <0>;
		#reset-cells = <0>;

		dsi-mipi-reset {
			compatible = "dsi,mipi-reset";
			resets = <&dispmix_mipi_rst IMX8MN_MIPI_M_RESET>;
                };
	};

Macro definitions for the supported reset channels can be found in:
include/dt-bindings/reset/imx8mm-dispmix.h and
include/dt-bindings/reset/imx8mn-dispmix.h.
```

## Documentation/devicetree/bindings/reset/nxp,dispmix-sft-rstn.txt
```
NXP Display Mix sft-rstn Reset Controller
=========================================

This binding describes a reset controller device that is used to reset
or de-reset all the submodules(such as, LCDIF, MIPI DSI, MIPI CSI, ISI
and etc) included by the Display Mix subsystem on IMX8MM and IMX8MN
platforms. Only assert and deassert functions are required for submodule
reset or de-reset.

Please also refer to reset.txt in this directory for common reset
controller binding usage.

Required properties:
- compatible: Should be "fsl,imx8mm-dispmix-sft-rstn" or
			"fsl,imx8mn-dispmix-sft-rstn".
- reg: should be register base and length as documented in the datasheet.
- clocks: phandle and clock specifier to disp apb clock for register access.
- clock-names: should be "disp-apb".
- power-domains: phandle to dispmix power domain.
- reset-cells: 1, see below.

example:

	dispmix_sft_rstn: dispmix-sft-rstn@32e28000 {
		compatible = "fsl,imx8mm-dispmix-sft-rstn";
		reg = <0x0 0x32e28000 0x0 0x4>;
		clocks = <&clk IMX8MM_CLK_DISP_APB_ROOT>;
		clock-names = "disp-apb";
		active_low;
		power-domains = <&dispmix_pd>;
		#reset-cells = <1>;
	};

Specifying sft-rstn control of devices
======================================

Device nodes in Display Mix should specify the reset channel required in
their "resets" property, containing a phandle to the sft-rstn device node
and an index to specify which channel to use, as described in
Documentation/devicetree/bindings/reset/reset.txt.

example:

        lcdif_resets: lcdif-resets {
                #address-cells = <1>;
                #size-cells = <0>;
                #reset-cells = <0>;

                lcdif-soft-resetn {
                        compatible = "lcdif,soft-resetn";
                        resets = <&dispmix_sft_rstn IMX8MN_LCDIF_APB_CLK_RESET>,
                                 <&dispmix_sft_rstn IMX8MN_LCDIF_PIXEL_CLK_RESET>;
                };
        };

Macro definitions for the supported reset channels can be found in:
include/dt-bindings/reset/imx8mm-dispmix.h and
include/dt-bindings/reset/imx8mn-dispmix.h.
```

## Documentation/devicetree/bindings/reset/nxp,imx8ulp-sim-reset.yaml
```yaml
# SPDX-License-Identifier: (GPL-2.0-only OR BSD-2-Clause)
%YAML 1.2
---
$id: http://devicetree.org/schemas/reset/nxp,imx8ulp-sim-reset.yaml#
$schema: http://devicetree.org/meta-schemas/core.yaml#

title: NXP i.MX8ulp System Integration Module Reset Controller

maintainers:
  - Liu Ying <victor.liu@nxp.com>

description: |
  The i.MX8ulp SIM (System Integration Module) may contain reset controller to
  reset peripherals. The reset controller is controlled by the SIM. So, the
  reset controller's device node has to be a child node of the SIM's device
  node. Peripherals that need access to reset lines should specify them as a
  reset phandle in their corresponding device nodes as specified in reset.txt.

properties:
  compatible:
    const: nxp,imx8ulp-avd-sim-reset

  '#reset-cells':
    const: 1

required:
  - compatible
  - '#reset-cells'

additionalProperties: false

examples:
  - |
    #include <dt-bindings/clock/imx8ulp-clock.h>
    syscon@2da50000 {
        compatible = "nxp,imx8ulp-avd-sim", "syscon", "simple-mfd";
        reg = <0x2da50000 0x38>;
        clocks = <&pcc5 IMX8ULP_CLK_AVD_SIM>;

        reset-controller {
            compatible = "nxp,imx8ulp-avd-sim-reset";
            #reset-cells = <1>;
        };

        mux-controller {
            compatible = "mmio-mux";
            #mux-control-cells = <1>;
            mux-reg-masks = <0x8 0x00000200>;
        };
    };
```

## Documentation/devicetree/bindings/reset/socfpga-reset.txt
```
Altera SOCFPGA Reset Manager

Required properties:
- compatible : "altr,rst-mgr", "syscon";
                Note that syscon is invoked for this device to support the FPGA
		bridge driver and possibly other devices in the future.  See
		also Documentation/devicetree/bindings/mfd/syscon.txt
- reg : Should contain 1 register ranges(address and length)
- #reset-cells: 1

Example:
	 rstmgr@ffd05000 {
		#reset-cells = <1>;
		compatible = "altr,rst-mgr", "syscon";
		reg = <0xffd05000 0x1000>;
	};
```

## Documentation/devicetree/bindings/rng/adi,sc5xx-trng.yaml
```yaml
# SPDX-License-Identifier: (GPL-2.0-only OR BSD-2-Clause)
%YAML 1.2
---
$id: http://devicetree.org/schemas/rng/adi,sc5xx-trng.yaml#
$schema: http://devicetree.org/meta-schemas/core.yaml#

title: Analog Devices True Random Number Generator on SC5XX Family Processors

maintainers:
  - Nathan Barrett-Morrison <nathan.morrison@timesys.com>
  - Greg Malysa <greg.malysa@timesys.com>

description: |
  Analog Devices True Random Number Generator on SC5XX Family Processors

properties:
  compatible:
    enum:
      - adi,sc5xx-trng

  reg:
    maxItems: 1

  interrupts:
    maxItems: 1

  interrupt-names:
    maxItems: 1

  startup-cycles:
    maxItems: 1
    description: "Number of samples taken to gather entropy from the FROs during startup"

  minref-cycles:
    maxItems: 1
    description: "Min samples taken to re-generate entropy from the FROs after reading"

  maxref-cycles:
    maxItems: 1
    description: "Max samples taken to re-generate entropy from the FROs after reading"

  alarm-thresh:
    maxItems: 1
    description: "Alarm detection threshold for repeating pattern detector"

  shdn-thresh:
    maxItems: 1
    description: "Generates shutdown overflow interrupt if shutdown count value is exceeded"

  poll-data:
    maxItems: 1
    description: "Poll for TRNG data (1) or use interrupts (0)"

required:
  - compatible
  - reg
  - interrupts
  - interrupt-names
  - startup-cycles
  - minref-cycles
  - maxref-cycles
  - alarm-thresh
  - shdn-thresh
  - poll-data

additionalProperties: false

examples:
  - |
    trng: rng@0x310D0000 {
      compatible = "adi,sc5xx-trng";
      reg = <0x310D0000 0x74>, <0x310D8000 0x14>;
      interrupts = <GIC_SPI 160 IRQ_TYPE_LEVEL_HIGH>;
      interrupt-names = "pkic0_irq";
      startup-cycles = <0xff>;
      minref-cycles = <0x21>;
      maxref-cycles = <0x22>;
      alarm-thresh  = <0xff>;
      shdn-thresh = <0x04>;
      poll-data = <0>; /* Use IRQ for data */
      status = "okay";
    };
```
