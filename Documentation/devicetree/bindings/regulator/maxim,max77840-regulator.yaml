## Documentation/devicetree/bindings/rpmsg/imx-rpmsg.txt
```
i.MX RPMSG platform implementations

Required properties:
- compatible : "fsl,imx7d-rpmsg", "fsl,imx6sx-rpmsg".
  "fsl,rpmsg-bus", "simple-bus", "fsl,imx8qxp-rpmsg".
- vdev-nums : The number of the remote virtual devices.
- reg : The reserved DDR phisical memory used to store
  vring descriptors.


=====================================================================
message unit module for RPMSG

- mu_rpmsg : The message unit module used to do the communications
  between the asymmetric cores.
- compatible : "fsl,imx8-mu", "fsl,imx6sx-mu"
- reg : Should contain MU registers location and length.
- interrupts : interrupt mapping for RPMSG MU IRQ
- interrupt-parent : A single value that points to the interrupt
  parent to which the child domain is being mapped.
  Value must be "&intmux_cm40"

Example:
rpmsg: rpmsg{
	compatible = "fsl,imx6sx-rpmsg";
	status = "disabled";
};

&rpmsg{
	vdev-nums = <1>;
	reg = <0xbfff0000 0x10000>;
	status = "okay";
};

imx_rpmsg: imx_rpmsg {
	compatible = "fsl,rpmsg-bus", "simple-bus";
	#address-cells = <2>;
	#size-cells = <2>;
	ranges;

	mu_rpmsg: mu_rpmsg@37440000 {
		compatible = "fsl,imx8-mu", "fsl,imx6sx-mu";
		reg = <0x0 0x37440000 0x0 0x10000>;
		interrupts = <31 IRQ_TYPE_LEVEL_HIGH>;
		interrupt-parent = <&intmux_cm40>;
		status = "okay";
	};

	rpmsg: rpmsg{
		compatible = "fsl,imx8qxp-rpmsg";
		status = "disabled";
	};
};
```

## Documentation/devicetree/bindings/rtc/adi,max31335.yaml
```yaml
# SPDX-License-Identifier: GPL-2.0-only OR BSD-2-Clause
%YAML 1.2
---
$id: http://devicetree.org/schemas/rtc/adi,max31335.yaml#
$schema: http://devicetree.org/meta-schemas/core.yaml#

title: Analog Devices MAX31335 RTC Device Tree Bindings

allOf:
  - $ref: "rtc.yaml#"

maintainers:
  - Antoniu Miclaus <antoniu.miclaus@analog.com>

description: Analog Devices MAX31335 I2C RTC

properties:
  compatible:
    const: adi,max31335

  reg:
    description: I2C address of the RTC
    maxItems: 1

  interrupts:
    maxItems: 1

  "#clock-cells":
    description:
      RTC can be used as a clock source through its clock output pin.
    const: 0

  trickle-resistor-ohms:
    description: Selected resistor for trickle charger.
    enum: [3000, 6000, 11000]

  trickle-diode-enable: true

required:
  - compatible
  - reg

unevaluatedProperties: false

examples:
  - |
    #include <dt-bindings/interrupt-controller/irq.h>
    i2c {
        #address-cells = <1>;
        #size-cells = <0>;

        rtc@68 {
            compatible = "adi,max31335";
            reg = <0x68>;
            pinctrl-0 = <&rtc_nint_pins>;
            interrupts-extended = <&gpio1 16 IRQ_TYPE_LEVEL_HIGH>;
            trickle-resistor-ohms = <6000>;
            trickle-diode-enable;
        };
    };
...
```

## Documentation/devicetree/bindings/rtc/adi,rtc2.yaml
```yaml
# SPDX-License-Identifier: (GPL-2.0-only OR BSD-2-Clause)
%YAML 1.2
---
$id: http://devicetree.org/schemas/rtc/adi,rtc2.yaml#
$schema: http://devicetree.org/meta-schemas/core.yaml#

title: Analog Devices Real Time Clock on SC5XX Family Processors

maintainers:
  - Nathan Barrett-Morrison <nathan.morrison@timesys.com>
  - Greg Malysa <greg.malysa@timesys.com>

description: |
  Analog Devices Real Time Clock on SC5XX Family Processors

properties:
  compatible:
    enum:
      - adi,rtc2

  reg:
    maxItems: 1

  interrupts:
    maxItems: 1

  calibration:
    maxItems: 1

required:
  - compatible
  - reg
  - interrupts
  - calibration

additionalProperties: false

examples:
  - |
    rtc0: rtc@0x310C8000 {
      compatible = "adi,rtc2";
      reg = <0x310C8000 0x100>;
      interrupts = <GIC_SPI 165 IRQ_TYPE_LEVEL_HIGH>;
      calibration = /bits/ 8 <0>;
    };
```

## Documentation/devicetree/bindings/rtc/fsl,scu-rtc.yaml
```yaml
# SPDX-License-Identifier: (GPL-2.0-only OR BSD-2-Clause)
%YAML 1.2
---
$id: http://devicetree.org/schemas/rtc/fsl,scu-rtc.yaml#
$schema: http://devicetree.org/meta-schemas/core.yaml#

title: i.MX SCU Client Device Node - RTC Based on SCU Message Protocol

maintainers:
  - Dong Aisheng <aisheng.dong@nxp.com>

description: i.MX SCU Client Device Node
  Client nodes are maintained as children of the relevant IMX-SCU device node.

allOf:
  - $ref: rtc.yaml#

properties:
  compatible:
    const: fsl,imx8qxp-sc-rtc
  read-only:
    description:
      For some use cases, like cockpit, one cockpit domain owns it
      while other domain is just a reader. Its needed to provide
      /dev/rtc funtion for applications.

required:
  - compatible

additionalProperties: false

examples:
  - |
    rtc {
        compatible = "fsl,imx8qxp-sc-rtc";
    };
```

## Documentation/devicetree/bindings/serial/adi,sc5xx-uart.yaml
```yaml
# SPDX-License-Identifier: (GPL-2.0-only OR BSD-2-Clause)
%YAML 1.2
---
$id: http://devicetree.org/schemas/serial/adi,sc5xx-uart.yaml#
$schema: http://devicetree.org/meta-schemas/core.yaml#

title: Analog Devices UART Driver for SC5XX-family processors

maintainers:
  - Arturs Artamonovs <arturs.artamonovs@analog.com>
  - Utsav Agarwal <Utsav.Agarwal@analog.com>

description: Analog Devices UART Driver for SC59X-family processors

properties:
  compatible:
    enum:
      - adi,sc5xx-uart

  reg:
    maxItems: 1

  clocks:
    maxItems: 1

  clock-names:
    description: Clock name
    items:
      - const: sclk0

  interrupt-names:
    items:
      - const: tx
      - const: rx
      - const: status

  interrupts:
    minItems: 3
    maxItems: 3
    description: GIC interrupt numbers

  adi,use-edbo:
    type: boolean
    description: Increase by 16 incoming bit sampling rate for better
      granularity and accuracy at high speed rates.

required:
  - compatible
  - reg
  - clocks
  - clock-names
  - interrupt-names
  - interrupts

additionalProperties: false

examples:
  - |
    #include <dt-bindings/interrupt-controller/arm-gic.h>
    #include <dt-bindings/interrupt-controller/irq.h>
    #include <dt-bindings/clock/adi-sc5xx-clock.h>

    serial@31003000 {
      compatible = "adi,sc5xx-uart";
      reg = <0x31003000 0x40>;
      clocks = <&clk ADSP_CLK_CGU0_SCLK0>;
      clock-names = "sclk0";
      interrupt-parent = <&gic>;
      interrupt-names = "tx", "rx", "status";
      interrupts = <GIC_SPI 138 IRQ_TYPE_LEVEL_HIGH>,
                   <GIC_SPI 139 IRQ_TYPE_LEVEL_HIGH>,
                   <GIC_SPI 140 IRQ_TYPE_LEVEL_HIGH>;
      adi,use-edbo;
    };
```

## Documentation/devicetree/bindings/serial/adi,uart4.yaml
```yaml
# SPDX-License-Identifier: (GPL-2.0-only OR BSD-2-Clause)
%YAML 1.2
---
$id: http://devicetree.org/schemas/gpio/adi,uart4.yaml#
$schema: http://devicetree.org/meta-schemas/core.yaml#

title: Analog Devices UART Driver for SC5XX-family processors

maintainers:
  - Nathan Barrett-Morrison <nathan.morrison@timesys.com>
  - Greg Malysa <greg.malysa@timesys.com>

description: |
  Analog Devices UART Driver for SC5XX-family processors

properties:
  compatible:
    enum:
      - adi,uart4

  reg:
    maxItems: 1

  dmas:
    maxItems: 2
    minItems: 2
    description: "TX and RX DMA cluster numbers"

  dma-names:
    maxItems: 2
    minItems: 2
    description: "DMA channel names (tx and rx)"

  clocks:
    maxItems: 1
    description: "Clock being used for UART"

  clock-names:
    maxItems: 1
    description: "Clock name (sclk0)"

  interrupt-names:
    minItems: 3
    maxItems: 3
    description: "Interrupt names (tx + rx + status)"

  interrupts:
    minItems: 3
    maxItems: 3
    description: "GIC interrupt numbers"

  adi,use-edbo:
    type: boolean
    description: "Enable divide by one in divisor"

required:
  - compatible
  - reg
  - dmas
  - dma-names
  - clocks
  - clock-names
  - interrupt-names
  - interrupts

optional:
  - adi,use-edbo

additionalProperties: false

examples:
  - |
    uart0: uart@0x31003000 {
      compatible = "adi,uart4";
      reg = <0x31003000 0x40>;
      dmas = <&dma_cluster2 20>, <&dma_cluster2 21>;
      dma-names = "tx", "rx";
      clocks = <&clk ADSP_SC598_CLK_CGU0_SCLK0>;
      clock-names = "sclk0";
      interrupt-parent = <&gic>;
      interrupt-names = "tx", "rx", "status";
      interrupts = <GIC_SPI 138 IRQ_TYPE_LEVEL_HIGH>,
                   <GIC_SPI 139 IRQ_TYPE_LEVEL_HIGH>,
                   <GIC_SPI 140 IRQ_TYPE_LEVEL_HIGH>;
      adi,use-edbo;
      status = "disabled";
    };
```

## Documentation/devicetree/bindings/serial/fsl-lpuart.txt
```
* Freescale low power universal asynchronous receiver/transmitter (lpuart)

Required properties:
- compatible :
  - "fsl,vf610-lpuart" for lpuart compatible with the one integrated
    on Vybrid vf610 SoC with 8-bit register organization
  - "fsl,ls1021a-lpuart" for lpuart compatible with the one integrated
    on LS1021A SoC with 32-bit big-endian register organization
  - "fsl,imx7ulp-lpuart" for lpuart compatible with the one integrated
    on i.MX7ULP SoC with 32-bit little-endian register organization
  - "fsl,imx8qm-lpuart"for lpuart  compatible with the one integrated
    on i.MX8QM SoC with 32-bit little-endian register organization, which
    is based on i.MX7ULP lpuart IP but add EEOP new feature.
- reg : Address and length of the register set for the device
- interrupts : Should contain uart interrupt
- clocks : phandle + clock specifier pairs, one for each entry in clock-names
- clock-names : should contain: "ipg" - the uart peripheral register accessing
  clock source, if "per" clock missing, the "ipg" clock also is the uart module
  clock.

Optional properties:
- dmas: A list of two dma specifiers, one for each entry in dma-names.
- dma-names: should contain "tx" and "rx".
- clocks : phandle + clock specifier pairs, one for each entry in clock-names
- clock-names : "per" - the uart module clock.
  clock.

Note: Optional properties for DMA support. Write them both or both not.

Example:

uart0: serial@40027000 {
		compatible = "fsl,vf610-lpuart";
		reg = <0x40027000 0x1000>;
		interrupts = <0 61 0x00>;
		clocks = <&clks VF610_CLK_UART0>;
		clock-names = "ipg";
		dmas = <&edma0 0 2>,
			<&edma0 0 3>;
		dma-names = "rx","tx";
	};
```

## Documentation/devicetree/bindings/sim/imx_emvsim.txt
```
* NXP EMVSIM for i.MX8

Required properties:
- compatible :
  - "fsl,imx8-emvsim" for EMVSIM compatible with the one integrated on i.MX8 soc
- reg : address and length of EMVSIM registers
- interrupt : core interrupt controller
- clocks : EMVSIM clock specifier
- power-domains : power domain for EMVSIM

Examples:

emvsim0: sim0@5a0d0000 {
	compatible = "fsl,imx8-emvsim";
	reg = <0x0 0x5a0d0000 0x0 0x10000>;
	interrupts = <GIC_SPI 230 IRQ_TYPE_LEVEL_HIGH>;
	clocks = <&clk IMX8QM_EMVSIM0_CLK>,
	<&clk IMX8QM_EMVSIM0_IPG_CLK>;
	clock-names = "sim", "ipg";
	power-domains = <&pd_ldo1_sim>;
	status = "disabled";
};
```

## Documentation/devicetree/bindings/sim/imx_sim.txt
```
* NXP SIMv2 for i.MX6ul and i.MX7d

Required properties:
- compatible :
  - "fsl,imx7d-sim" for SIMv2 compatible with the one integrated on i.MX7d soc
  - "fsl,imx6ul-sim" for SIMv2 compatible with the one integrated on i.MX6ul soc
- reg : address and length of SIMv2 registers
- interrupt : core interrupt controller
- clocks : SIMv2 clock specifier

Examples:

sim2: sim@021b4000 {
	compatible = "fsl,imx6ul-sim";
	reg = <0x021b4000 0x4000>;
	interrupts = <GIC_SPI 113 IRQ_TYPE_LEVEL_HIGH>;
	clocks = <&clks IMX6UL_CLK_SIM2>;
	clock-names = "sim";
	status = "disabled";
};
```

## Documentation/devicetree/bindings/soc/adi/adi,pads-system-config.yaml
```yaml
# SPDX-License-Identifier: (GPL-2.0-only OR BSD-2-Clause)
%YAML 1.2
---
$id: http://devicetree.org/schemas/soc/adi/adi,pads-system-config.yaml#
$schema: http://devicetree.org/meta-schemas/core.yaml#

title: Analog Devices PADS-related system config for SC5XX processor family

maintainers:
  - Arturs Artamonovs <arturs.artamonovs@analog.com>
  - Utsav Agarwal <Utsav.Agarwal@analog.com>

description:
  Allows other drivers to control the PADS-related system config register.
  This register ties into many drivers and adds silicon controls for items
  like voltage selection and endian selection.

properties:
  compatible:
    enum:
      - adi,pads-system-config

  reg:
    maxItems: 1

required:
  - compatible
  - reg

additionalProperties: false

examples:
  - |
    bus {
      compatible = "simple-bus";
      #address-cells = <1>;
      #size-cells = <1>;
      ranges;

      pads_system_config: adi-control@31004600 {
        compatible = "adi,pads-system-config";
        reg = <0x31004600 0x100>;
      };
    };

    emac0: ethernet@31040000 {
      reg = <0x31040000 0x2000>;
      adi,system-config = <&pads_system_config>;
    };
```
