## Documentation/devicetree/bindings/regulator/maxim,max77840-regulator.yaml
```yaml
# SPDX-License-Identifier: (GPL-2.0-only OR BSD-2-Clause)
%YAML 1.2
---
$id: http://devicetree.org/schemas/regulator/maxim,max77840-regulator.yaml#
$schema: http://devicetree.org/meta-schemas/core.yaml#

title: Maxim MAX77840 Regulator

maintainers:
  - Joan Na <joan.na@analog.com>

properties:
  compatible:
    const: maxim,max77840-regulator

  reg:
    maxItems: 1

  regulators:
    type: object

    properties:
      SAFEOUT1:
        $ref: regulator.yaml#

    additionalProperties: false

required:
  - compatible
  - reg
  - regulators

additionalProperties: false

examples:
  - |

    regulators {
      SAFEOUT1 {
        regulator-name = "SAFEOUT1";
        regulator-boot-on;
        regulator-always-on;
        };
    };
```

## Documentation/devicetree/bindings/regulator/nxp,pf0900-regulator.yaml
```yaml
# SPDX-License-Identifier: GPL-2.0-only OR BSD-2-Clause
%YAML 1.2
---
$id: http://devicetree.org/schemas/regulator/nxp,pf0900-regulator.yaml#
$schema: http://devicetree.org/meta-schemas/core.yaml#

title: NXP PF0900 Power Management Integrated Circuit regulators

maintainers:
  - Joy Zou <joy.zou@nxp.com>

description: |
  PF0900 is a PMIC designed for high performance consumer applications.
  It features five high efficiency buck converters, three linear and one
  vaon regulators. It has built-in one time programmable fuse bank for
  device configurations.
  The definition for each of these nodes is defined using the standard
  binding for regulators at
  Documentation/devicetree/bindings/regulator/regulator.yaml.

#The valid names for PF0900 regulator nodes are:
#SW1, SW2, SW3, SW4, SW5
#LDO1, LDO2, LDO3
#VAON.

properties:
  compatible:
    enum:
      - nxp,pf0900

  reg:
    maxItems: 1

  interrupts:
    maxItems: 1

  regulators:
    type: object
    description: |
      list of regulators provided by this controller

    patternProperties:
      "^LDO[1-3]$":
        type: object
        $ref: regulator.yaml#
        description:
          Properties for single LDO regulator.

        unevaluatedProperties: false

      "^VAON$":
        type: object
        $ref: regulator.yaml#
        description:
          Properties for single VAON regulator.

        unevaluatedProperties: false

      "^SW[1-5]$":
        type: object
        $ref: regulator.yaml#
        description:
          Properties for single SW regulator.

        properties:
          nxp,dvs-run-voltage:
            $ref: "/schemas/types.yaml#/definitions/uint32"
            minimum: 300000
            maximum: 1350000
            description:
              PMIC default "RUN" state voltage in uV. SW1~5 have such
              dvs(dynamic voltage scaling) property.

          nxp,dvs-standby-voltage:
            $ref: "/schemas/types.yaml#/definitions/uint32"
            minimum: 300000
            maximum: 1350000
            description:
              PMIC default "STANDBY" state voltage in uV. SW1~5 have such
              dvs(dynamic voltage scaling) property.

          nxp,phase-shift:
            $ref: "/schemas/types.yaml#/definitions/uint32"
            default: 0
            enum: [ 0, 45, 90, 135, 180, 225, 270, 315 ]
            description:
              SW regulators phase shift control in degrees.

        unevaluatedProperties: false

    additionalProperties: false

  sd-vsel-gpios:
    description: The GPIO1 pin is used as an input to select the output voltage
      of LDO2. Use this if the SD_VSEL signal is connected to a host GPIO.

  ldo1-enable-gpios:
    description: The GPIO2 pin is used as an input to enable and disable the
      output voltage of LDO1.

  i2c-crc-enable:
    $ref: /schemas/types.yaml#/definitions/string
    description: If the PMIC OTP_I2C_CRC_EN is enable, you need to add this property.

  ldo3-stby:
    $ref: /schemas/types.yaml#/definitions/string
    description: If the PMIC OTP_VLDO3_RUN is zero, you need to add this property.

required:
  - compatible
  - reg
  - interrupts
  - regulators

additionalProperties: false

examples:
  - |
    #include <dt-bindings/interrupt-controller/irq.h>

    i2c {
        #address-cells = <1>;
        #size-cells = <0>;
        pmic@8 {
            compatible = "nxp,pf0900";
            reg = <0x08>;
	    i2c-crc-enable;
            interrupt-parent = <&pcal6524>;
            interrupts = <89 IRQ_TYPE_LEVEL_LOW>;

            regulators {
                vaon: VAON {
                    regulator-name = "VAON";
                    regulator-min-microvolt = <1800000>;
                    regulator-max-microvolt = <3300000>;
                    regulator-boot-on;
                    regulator-always-on;
                };

                sw1: SW1 {
                    regulator-name = "SW1";
                    regulator-min-microvolt = <500000>;
                    regulator-max-microvolt = <3300000>;
                    regulator-boot-on;
                    regulator-always-on;
                    regulator-ramp-delay = <1950>;
                };

                sw2: SW2 {
                    regulator-name = "SW2";
                    regulator-min-microvolt = <300000>;
                    regulator-max-microvolt = <3300000>;
                    regulator-boot-on;
                    regulator-always-on;
                    regulator-ramp-delay = <1950>;
                };

                sw3: SW3 {
                    regulator-name = "SW3";
                    regulator-min-microvolt = <300000>;
                    regulator-max-microvolt = <3300000>;
                    regulator-boot-on;
                    regulator-always-on;
                    regulator-ramp-delay = <1950>;
                };

                sw4: SW4{
                    regulator-name = "SW4";
                    regulator-min-microvolt = <300000>;
                    regulator-max-microvolt = <3300000>;
                    regulator-boot-on;
                    regulator-always-on;
                    regulator-ramp-delay = <1950>;
                };

                sw5: SW5{
                    regulator-name = "SW5";
                    regulator-min-microvolt = <300000>;
                    regulator-max-microvolt = <3300000>;
                    regulator-boot-on;
                    regulator-always-on;
                    regulator-ramp-delay = <1950>;
                };

                ldo1: LDO1 {
                    regulator-name = "LDO1";
                    regulator-min-microvolt = <750000>;
                    regulator-max-microvolt = <3300000>;
                    regulator-boot-on;
                    regulator-always-on;
                };

                ldo2: LDO2 {
                    regulator-name = "LDO2";
                    regulator-min-microvolt = <650000>;
                    regulator-max-microvolt = <3300000>;
                    regulator-boot-on;
                    regulator-always-on;
                };

                ldo3: LDO3 {
                    regulator-name = "LDO3";
                    regulator-min-microvolt = <650000>;
                    regulator-max-microvolt = <3300000>;
                    regulator-boot-on;
                    regulator-always-on;
                };
            };
        };
     };
```

## Documentation/devicetree/bindings/regulator/nxp,pf5300-regulator.yaml
```yaml
# SPDX-License-Identifier: GPL-2.0-only OR BSD-2-Clause
%YAML 1.2
---
$id: http://devicetree.org/schemas/regulator/nxp,pf5300-regulator.yaml#
$schema: http://devicetree.org/meta-schemas/core.yaml#

title: NXP PF5300 Power Management Integrated Circuit regulators

maintainers:
  - Joy Zou <joy.zou@nxp.com>

description: |
  PF5300 is a PMIC designed for high performance consumer applications.
  It features five high efficiency buck converters. It has built-in one
  time programmable fuse bank for device configurations.
  The definition for each of these nodes is defined using the standard
  binding for regulators at
  Documentation/devicetree/bindings/regulator/regulator.yaml.

properties:
  compatible:
    enum:
      - nxp,pf5300
      - nxp,pf5301
      - nxp,pf5302

  reg:
    maxItems: 1

  interrupts:
    maxItems: 1

  regulators:
    type: object
    description: |
      list of regulators provided by this controller

    patternProperties:
      "^SW1$":
        type: object
        $ref: regulator.yaml#
        description:
          Properties for single SW regulator.

        properties:
          nxp,dvs-run-voltage:
            $ref: "/schemas/types.yaml#/definitions/uint32"
            minimum: 500000
            maximum: 1200000
            description:
              PMIC default "RUN" state voltage in uV. SW1 have such
              dvs(dynamic voltage scaling) property.

          nxp,dvs-standby-voltage:
            $ref: "/schemas/types.yaml#/definitions/uint32"
            minimum: 500000
            maximum: 1200000
            description:
              PMIC default "STANDBY" state voltage in uV. SW1 have such
              dvs(dynamic voltage scaling) property.

        unevaluatedProperties: false

    additionalProperties: false
  i2c-crc-enable:
    $ref: /schemas/types.yaml#/definitions/string
    description: If the PMIC OTP_I2C_CRC_EN is enable, you need to add this property.

required:
  - compatible
  - reg
  - interrupts
  - regulators

additionalProperties: false

examples:
  - |

    i2c {
        #address-cells = <1>;
        #size-cells = <0>;
        pmic@29 {
            compatible = "nxp,pf5300";
            reg = <0x29>;

            regulators {
                sw1: SW1 {
                    regulator-name = "SW1";
                    regulator-min-microvolt = <500000>;
                    regulator-max-microvolt = <1200000>;
                    regulator-boot-on;
                    regulator-always-on;
                    regulator-ramp-delay = <1000>;
                };
            };
        };
     };
```

## Documentation/devicetree/bindings/regulator/nxp,pf9453-regulator.yaml
```yaml
# SPDX-License-Identifier: GPL-2.0-only OR BSD-2-Clause
%YAML 1.2
---
$id: http://devicetree.org/schemas/regulator/nxp,pf9453-regulator.yaml#
$schema: http://devicetree.org/meta-schemas/core.yaml#

title: NXP PF9453 Power Management Integrated Circuit regulators

maintainers:
  - Joy Zou <joy.zou@nxp.com>

description: |
  Regulator nodes should be named to BUCK_<number> and LDO_<number>. The
  definition for each of these nodes is defined using the standard
  binding for regulators at
  Documentation/devicetree/bindings/regulator/regulator.txt.

# The valid names for PF9453 regulator nodes are:
# BUCK1, BUCK2, BUCK3, BUCK4,
# LDO1, LDO2, LDO_SNVS

properties:
  compatible:
    enum:
      - nxp,pf9453

  reg:
    maxItems: 1

  interrupts:
    maxItems: 1

  regulators:
    type: object
    description: |
      list of regulators provided by this controller

    patternProperties:
      "^LDO[1-2]$":
        type: object
        $ref: regulator.yaml#
        description:
          Properties for single LDO regulator.

      "^LDO_SNVS$":
        type: object
        $ref: regulator.yaml#
        description:
          Properties for single LDO regulator.

      "^BUCK[1-4]$":
        type: object
        $ref: regulator.yaml#
        description:
          Properties for single BUCK regulator.

        properties:
          nxp,dvs-run-voltage:
            $ref: /schemas/types.yaml#/definitions/uint32
            minimum: 600000
            maximum: 2187500
            description:
              PMIC default "RUN" state voltage in uV. Only Buck2 have such
              dvs(dynamic voltage scaling) property.

          nxp,dvs-standby-voltage:
            $ref: /schemas/types.yaml#/definitions/uint32
            minimum: 600000
            maximum: 2187500
            description:
              PMIC default "STANDBY" state voltage in uV. Only Buck2 have such
              dvs(dynamic voltage scaling) property.

        unevaluatedProperties: false

  sd-vsel-gpios:
    description: GPIO that is used to switch LDO5 between being configured by
      LDO5CTRL_L or LDO5CTRL_H register. Use this if the SD_VSEL signal is
      connected to a host GPIO.

  nxp,i2c-lt-enable:
    type: boolean
    description:
      Indicates that the I2C Level Translator is used.

  nxp,wdog_b-warm-reset:
    type: boolean
    description:
      When WDOG_B signal is asserted a warm reset will be done instead of cold
      reset.

required:
  - compatible
  - reg
  - interrupts
  - regulators

additionalProperties: false

examples:
  - |
    #include <dt-bindings/interrupt-controller/irq.h>

    i2c {
        #address-cells = <1>;
        #size-cells = <0>;
        pmic@32 {
            compatible = "nxp,pf9453";
            reg = <0x32>;
            interrupt-parent = <&pcal6524>;
            interrupts = <11 IRQ_TYPE_EDGE_FALLING>;

            regulators {
                buck1: BUCK1 {
                    regulator-name = "BUCK1";
                    regulator-min-microvolt = <600000>;
                    regulator-max-microvolt = <3775000>;
                    regulator-boot-on;
                    regulator-always-on;
                };

                buck2: BUCK2 {
                    regulator-name = "BUCK2";
                    regulator-min-microvolt = <600000>;
                    regulator-max-microvolt = <2187500>;
                    regulator-boot-on;
                    regulator-always-on;
                    regulator-ramp-delay = <12500>;
                };

                buck3: BUCK3 {
                    regulator-name = "BUCK3";
                    regulator-min-microvolt = <600000>;
                    regulator-max-microvolt = <3775000>;
                    regulator-boot-on;
                    regulator-always-on;
                };

                buck4: BUCK4{
                    regulator-name = "BUCK4";
                    regulator-min-microvolt = <600000>;
                    regulator-max-microvolt = <3775000>;
                    regulator-boot-on;
                    regulator-always-on;
                };

                ldo1: LDO1 {
                    regulator-name = "LDO1";
                    regulator-min-microvolt = <800000>;
                    regulator-max-microvolt = <3300000>;
                    regulator-boot-on;
                    regulator-always-on;
                };

                ldo2: LDO2 {
                    regulator-name = "LDO2";
                    regulator-min-microvolt = <500000>;
                    regulator-max-microvolt = <1950000>;
                    regulator-boot-on;
                    regulator-always-on;
                };

                ldo_snvs: LDO_SNVS {
                    regulator-name = "LDO_SNVS";
                    regulator-min-microvolt = <800000>;
                    regulator-max-microvolt = <3000000>;
                    regulator-boot-on;
                    regulator-always-on;
                };
            };
        };
    };
```
