## Documentation/devicetree/bindings/soc/adi/adi,trigger-routing-unit.yaml
```yaml
# SPDX-License-Identifier: (GPL-2.0-only OR BSD-2-Clause)
%YAML 1.2
---
$id: http://devicetree.org/schemas/soc/adi/adi,trigger-routing-unit.yaml#
$schema: http://devicetree.org/meta-schemas/core.yaml#

title: Analog Devices Trigger Routing Unit for SC5XX processor family

maintainers:
  - Arturs Artamonovs <arturs.artamonovs@analog.com>
  - Utsav Agarwal <Utsav.Agarwal@analog.com>

description:
  Used for ICC between SHARC and ARM cores.

  The TRU provides system-level sequence control without core intervention.
  The TRU maps trigger masters (generators of triggers) to trigger slaves
  (receivers of triggers). Slave endpoints can be configured to respond to
  triggers in various ways. Multiple TRUs may be provided in a
  multiprocessor system to create a trigger network. Common applications
  enabled by the TRU include

properties:
  compatible:
    enum:
      - adi,trigger-routing-unit

  reg:
    maxItems: 1

  adi,max-master-id:
    $ref: /schemas/types.yaml#/definitions/uint32
    description: Max Trigger Master ID
    maximum: 1024

  adi,max-slave-id:
    $ref: /schemas/types.yaml#/definitions/uint32
    description: Max Trigger Slave ID
    maximum: 1024

patternProperties:
  "^channel-[0-9]+$":
    description: Trigger Routing Channel to Map Master/Slave
    type: object
    properties:
      adi,tru-master-id:
        $ref: /schemas/types.yaml#/definitions/uint32
        description: Trigger Routing Master ID
      adi,tru-slave-id:
        $ref: /schemas/types.yaml#/definitions/uint32
        description: Trigger Routing Slave ID
    required:
      - adi,tru-master-id
      - adi,tru-slave-id
    additionalProperties: false

required:
  - compatible
  - reg
  - adi,max-master-id
  - adi,max-slave-id

additionalProperties: false

examples:
  - |
    tru: tru@3108a000 {
      compatible = "adi,trigger-routing-unit";
      reg = <0x3108a000 0x1000>;
      adi,max-master-id = <182>;
      adi,max-slave-id = <187>;

      rpmsg_to_a55: channel-0 {
        adi,tru-master-id = <134>; /* trigger master SOFT3 */
        adi,tru-slave-id = <160>; /* TRU0_IRQ3 */
      };
      rpmsg_to_sharc0: channel-1 {
        adi,tru-master-id = <135>; /* trigger master SOFT4 */
        adi,tru-slave-id = <164>; /* TRU0_IRQ7 */
      };
      rpmsg_to_sharc1: channel-2 {
        adi,tru-master-id = <136>; /* trigger master SOFT5 */
        adi,tru-slave-id = <168>; /* TRU0_IRQ11 */
      };
    };
```

## Documentation/devicetree/bindings/soc/adi/adi-rpmsg.txt
```
RPMSG bindings for SC5xx Analog Devices processors
----------------------------------------

This document describes device tree binding for adi rpmsg driver
required when rpmsg communication is needed and remote core isn't
started by adi,remoteproc.

Required properties:
- compatible	should be: "adi,rpmsg-SC598"
- core-id		core number
- adi,rcu		phandle to Remote Control Unit
- adi,rsc-table	phandle to resource table memory region shared with SHARC core
- adi,tru 		phandle to Trigger Routing Unit for ICC interrupts
- interrupts	ICC interrupt for rpmsg communication
- adi,tru-master-id ICC interrupt number to notify remote core

Optional properties:
- vdev-vring		phadle to reserved memory region for rpmsg vdev0vrings,
					if not specified allocates buffer from DMA pool.

- memory-region		phandle to reserved memory for rpmsg message buffers,
					if not specified allocates buffer from DMA pool.
					(See: ../reserved-memory/reserved-memory.txt)

The size of vdev-vring specifies how many message buffers are allocated
for tx and rx (combined) overriding the default number specified in
MAX_RPMSG_NUM_BUFS. The memory-region size must match (or be larger) selected
number of messages times MAX_RPMSG_BUF_SIZE (default 512).
E.g. for 1024 message buffers (512 for rx and 512 for tx):
	vdev-vring size = 0x0000a000
	memory-region size = 0x00080000

Selection table for MAX_RPMSG_BUF_SIZE=512 (default):

rpmsg   |            |
buffers | vdev-vring | memory-region
---------------------------------
    256 | 0x00004000 | 0x00020000
    512 | 0x00006000 | 0x00040000
   1024 | 0x0000a000 | 0x00080000
   2048 | 0x00010000 | 0x00100000
   4096 | 0x0001e000 | 0x00200000
   8192 | 0x00038000 | 0x00400000
  16384 | 0x0006c000 | 0x00800000
  32768 | 0x000d4000 | 0x01000000
  65536 | 0x001a4000 | 0x02000000
 131072 | 0x00344000 | 0x04000000
 262144 | 0x00684000 | 0x08000000
 524288 | 0x00d04000 | 0x10000000
1048576 | 0x01a04000 | 0x20000000
2097152 | 0x03404000 | 0x40000000
4194304 | 0x06804000 | 0x80000000

Example:

	reserved-memory {
		vdev0vrings: vdev0vring0@20080000 {
			reg = <0x20080000 0x4000>;
			no-map;
		};

		vdev0buffer: vdev0buffer@20084000 {
			compatible = "shared-dma-pool";
			reg = <0x20084000 0x20000>;
			no-map;
		};

		vdev1vrings: vdev0vring0@200A4000 {
			reg = <0x200A4000 0x4000>;
			no-map;
		};

		vdev1buffer: vdev0buffer@200A8000 {
			compatible = "shared-dma-pool";
			reg = <0x200A8000 0x20000>;
			no-map;
		};
	};

	sharc0_rpmsg: core0-rpmsg@0x28240000 {
		status = "okay";
		compatible = "adi,rpmsg-SC598";
		core-id = <1>;
		adi,rcu = <&rcu>;
		adi,rsc-table = <&rsc_tbl0>;
		interrupts = <GIC_SPI 337 IRQ_TYPE_EDGE_RISING>; /* TRU0_SLV3 */
		adi,tru = <&tru>;
		adi,tru-master-id = <135>; /* trigger master SOFT4 */
		vdev-vring = <&vdev0vrings>;
		memory-region = <&vdev0buffer>;
	};

	sharc1_rpmsg: core1-rpmsg@0x28a40000 {
		status = "okay";
		compatible = "adi,rpmsg-SC598";
		core-id = <2>;
		adi,rcu = <&rcu>;
		adi,rsc-table = <&rsc_tbl1>;
		interrupts = <GIC_SPI 337 IRQ_TYPE_EDGE_RISING>; /* TRU0_SLV3 */
		adi,tru = <&tru>;
		adi,tru-master-id = <136>; /* trigger master SOFT5 */
		vdev-vring = <&vdev1vrings>;
		memory-region = <&vdev1buffer>;
	};
```

## Documentation/devicetree/bindings/soc/fsl/cpm_qe/fsl,qe-ports-ic.yaml
```yaml
# SPDX-License-Identifier: (GPL-2.0-only OR BSD-2-Clause)
%YAML 1.2
---
$id: http://devicetree.org/schemas/soc/fsl/cpm_qe/fsl,qe-ports-ic.yaml#
$schema: http://devicetree.org/meta-schemas/core.yaml#

title: Freescale QUICC Engine I/O Ports Interrupt Controller

maintainers:
  - Christophe Leroy <christophe.leroy@csgroup.eu>

description:
  Interrupt controller for the QUICC Engine I/O ports found on some Freescale/NXP PowerQUICC and QorIQ SoCs.

properties:
  compatible:
    enum:
      - fsl,mpc8323-qe-ports-ic
      - fsl,mpc8360-qe-ports-ic
      - fsl,mpc8568-qe-ports-ic

  reg:
    maxItems: 1
    description: Base address and size of the QE I/O Ports Interrupt Controller registers.

  interrupt-controller: true

  '#address-cells':
    const: 0

  '#interrupt-cells':
    const: 1

  interrupts:
    maxItems: 1
    description: Interrupt line to which the QE I/O Ports controller is connected.

required:
  - compatible
  - reg
  - interrupt-controller
  - '#address-cells'
  - '#interrupt-cells'
  - interrupts

additionalProperties: false

examples:
  - |
    interrupt-controller@c00 {
      compatible = "fsl,mpc8323-qe-ports-ic";
      reg = <0xc00 0x18>;
      interrupt-controller;
      #address-cells = <0>;
      #interrupt-cells = <1>;
      interrupts = <74 0x8>;
      interrupt-parent = <&ipic>;
    };
```

## Documentation/devicetree/bindings/soc/fsl/fsl,rpmsg.txt
```
i.MX RPMSG platform implementations

Distributed framework is used in IMX RPMSG implementation, refer to the
following requirements:
  - The CAN functions contained in M core and RTOS should be ready and
    complete functional in 50ms after AMP system is turned on.
  - Partition reset. System wouldn't be stalled by the exceptions (e.x
    the reset triggered by the system hang) occurred at the other side.
    And the RPMSG mechanism should be recovered automactilly after the
    partition reset is completed.
In this scenario, the M core and RTOS would be kicked off by bootloader
firstly, then A core and Linux would be loaded later. Both M core/RTOS
and A core/Linux are running independly.
One physical memory region used to store the vring is mandatory required
to pre-reserved and well-knowned by both A core and M core

Required properties:
- compatible: "fsl,imx8qxp-rpmsg", "fsl,imx8mq-rpmsg", "fsl,imx8mm-rpmsg",
  "fsl,imx8qm-rpmsg", "fsl,imx7ulp-rpmsg", "fsl,imx7d-rpmsg",
  "fsl,imx6sx-rpmsg".
- vdev-nums: The number of the remote virtual devices.
- reg: The reserved phisical DDR memory used to store vring descriptors.

Optional properties:
- rpmsg_dma_reserved: The reserved per device dma pool, that used to
  allocate the shared memory buffers from the per device.
  And it is optional for some platforms, since the system dma pool
  is used to allocate the shared memory buffers directly on them.
- mub-partition: The partition ID of muB side, that's optional
  and used on i.mx8qm/8qxp for partition reset. The default
  value is 3 in driver without this property.

=====================================================================
Mailbox used by iMX RPMSG

- mboxes: mailboxes used in the RPMSG transactions.
- mbox-names: names of the mailboxes used in RPMSG.
	- "tx":TX channel with 32bit transmit register and IRQ transmit
	- "rx":RX channel with 32bit receive register and IRQ support
	- "rxdb":RX doorbell channel.

Example:
Rpmsg node in board dts file.
&rpmsg{
	/*
	 * 64K for one rpmsg instance:
	 */
	vdev-nums = <2>;
	reg = <0x0 0x90000000 0x0 0x20000>;
	status = "okay";
};

SOC level dts node definitions:
rpmsg_reserved: rpmsg@0x90000000 {
	no-map;
	reg = <0 0x90000000 0 0x400000>;
};
rpmsg_dma_reserved:rpmsg_dma@0x90400000 {
	compatible = "shared-dma-pool";
	no-map;
	reg = <0 0x90400000 0 0x1C00000>;
};
rpmsg: rpmsg{
	compatible = "fsl,imx8qxp-rpmsg";
	/* up to now, the following channels are used in imx rpmsg
	 * - tx1/rx1: messages channel.
	 * - general interrupt1: remote proc finish re-init rpmsg stack
	 *   when A core is partition reset.
	 */
	mbox-names = "tx", "rx", "rxdb";
	mboxes = <&lsio_mu5 0 1
		  &lsio_mu5 1 1
		  &lsio_mu5 3 1>;
	mub-partition = <3>;
	memory-region = <&rpmsg_dma_reserved>;
	status = "disabled";
};
```

## Documentation/devicetree/bindings/soc/renesas/renesas,rzn1-gpioirqmux.yaml
```yaml
# SPDX-License-Identifier: (GPL-2.0-only OR BSD-2-Clause)
%YAML 1.2
---
$id: http://devicetree.org/schemas/soc/renesas/renesas,rzn1-gpioirqmux.yaml#
$schema: http://devicetree.org/meta-schemas/core.yaml#

title: Renesas RZ/N1 SoCs GPIO Interrupt Multiplexer

description: |
   The Renesas RZ/N1 GPIO Interrupt Multiplexer multiplexes GPIO interrupt
   lines to the interrupt controller available in the SoC.

   It selects up to 8 of the 96 GPIO interrupt lines available and connect them
   to 8 output interrupt lines.

maintainers:
  - Herve Codina <herve.codina@bootlin.com>

properties:
  compatible:
    items:
      - enum:
          - renesas,r9a06g032-gpioirqmux
      - const: renesas,rzn1-gpioirqmux

  reg:
    maxItems: 1

  "#address-cells":
    const: 0

  "#interrupt-cells":
    const: 1

  interrupt-map-mask:
    items:
      - const: 0x7f

  interrupt-map:
    description:
      Specifies the mapping from external GPIO interrupt lines to the output
      interrupts. The array items have to be ordered with the first item
      related to the output line 0 (IRQ 103), the next one to the output line 1
      (IRQ 104) and so on up to the output line 8 (IRQ 110).

required:
  - compatible
  - reg
  - "#address-cells"
  - "#interrupt-cells"
  - interrupt-map-mask
  - interrupt-map

additionalProperties: false

examples:
  - |
    #include <dt-bindings/interrupt-controller/arm-gic.h>

    gic: interrupt-controller {
        interrupt-controller;
        #interrupt-cells = <3>;
    };

    interrupt-controller@51000480 {
        compatible = "renesas,r9a06g032-gpioirqmux", "renesas,rzn1-gpioirqmux";
        reg = <0x51000480 0x20>;
        #address-cells = <0>;
        #interrupt-cells = <1>;
        interrupt-map-mask = <0x7f>;
        /*
         * The child interrupt number is computed using the following formula:
         *    gpio_bank * 32 + gpio_number
         *
         * with:
         *    - gpio_bank: The GPIO bank number
         *          - 0 for GPIO0A,
         *          - 1 for GPIO1A,
         *          - 2 for GPIO2A
         *    - gpio_number: Number of the gpio in the bank (0..31)
         */
        interrupt-map =
            <32 &gic GIC_SPI 103 IRQ_TYPE_LEVEL_HIGH>, /* GPIO1A.0 */
            <89 &gic GIC_SPI 104 IRQ_TYPE_LEVEL_HIGH>, /* GPIO2A.25 */
            <9 &gic GIC_SPI 106 IRQ_TYPE_LEVEL_HIGH>; /* GPIO0A.9 */
    };
```

## Documentation/devicetree/bindings/sound/adi,ad242x-codec.yaml
```yaml
# SPDX-License-Identifier: (GPL-2.0 OR BSD-2-Clause)
%YAML 1.2
---
$id: "http://devicetree.org/schemas/sound/adi,ad242x-codec.yaml#"
$schema: "http://devicetree.org/meta-schemas/core.yaml#"

title: Analog Devices AD242x clock provider

maintainers:
  - Daniel Mack <daniel@zonque.org>

description: |
  This module is part of the AD242x MFD device. For more details and an example
  refer to Documentation/devicetree/bindings/mfd/ad242x.yaml.

properties:
  compatible:
    enum:
      - adi,ad2428w-codec

  '#sound-dai-cells':
    const: 1

  adi,pdm-highpass-filter:
    type: boolean
    description: |
      Enables highpass filtering for data received through the PDM ports

required:
  - compatible
  - '#sound-dai-cells'
```

## Documentation/devicetree/bindings/sound/adi,ad242x.yaml
```yaml
# SPDX-License-Identifier: (GPL-2.0-only OR BSD-2-Clause)
%YAML 1.2
---
$id: http://devicetree.org/schemas/sound/adi,ad242x.yaml#
$schema: http://devicetree.org/meta-schemas/core.yaml#

title: Analog Devices AD242x DTS overlay 

maintainers:
  - V Sreekanth Chintada <vsreekanth.chintada@analog.com>

description: |
  Analog Devices A2B AD242x Transceivers support with RaspberryPi 4B
  https://www.analog.com/en/products/ad2428.html

properties:
  compatible:
      - brcm,bcm2711
```

## Documentation/devicetree/bindings/sound/adi,adau1962.yaml
```yaml
# SPDX-License-Identifier: (GPL-2.0-only OR BSD-2-Clause)
%YAML 1.2
---
$id: http://devicetree.org/schemas/sound/adi,adau1962.yaml#
$schema: http://devicetree.org/meta-schemas/core.yaml#

title: Analog Devices ADAU1962 DAC

maintainers:
  - Nathan Barrett-Morrison <nathan.morrison@timesys.com>
  - Greg Malysa <greg.malysa@timesys.com>

description: |
  Analog Devices ADAU1962 DAC
  https://www.analog.com/media/en/technical-documentation/data-sheets/ADAU1962.pdf

properties:
  compatible:
    enum:
      - adi,adau1962

  reg:
    maxItems: 1

required:
  - reg
  - compatible

additionalProperties: false

examples:
  - |
    i2c {
        #address-cells = <1>;
        #size-cells = <0>;
        adau1962: adau1962@0x4 {
          compatible = "adi,adau1962";
          reg = <0x4>;
        };
    };
```
