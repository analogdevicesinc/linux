## Documentation/devicetree/bindings/sound/adi,adau1977.txt
```
Analog Devices ADAU1977/ADAU1978/ADAU1979

Datasheets:
http://www.analog.com/media/en/technical-documentation/data-sheets/ADAU1977.pdf
http://www.analog.com/media/en/technical-documentation/data-sheets/ADAU1978.pdf
http://www.analog.com/media/en/technical-documentation/data-sheets/ADAU1979.pdf

This driver supports both the I2C and SPI bus.

Required properties:
 - compatible: Should contain one of the following:
               "adi,adau1977"
               "adi,adau1978"
               "adi,adau1979"

 - AVDD-supply: analog power supply for the device, please consult
                Documentation/devicetree/bindings/regulator/regulator.txt

Optional properties:
 - reset-gpio:  the reset pin for the chip, for more details consult
                Documentation/devicetree/bindings/gpio/gpio.txt

 - DVDD-supply: supply voltage for the digital core, please consult
                Documentation/devicetree/bindings/regulator/regulator.txt

 - MICBIAS-supply: only for ADAU1977, specifies the voltage settings via
                the regulator framework. Please consult
                Documentation/devicetree/bindings/regulator/regulator.txt

                The supported voltages are 5.0V, 5.5V, 6.0V, 6.5V, 7.0V,
                7.5V, 8.0V, 8.5V, 9.0V.
                When specifying a value in the regulator (e.g. 5400000 uV) the
                closest or rounded value from the supported voltages will
                be used.
                Examples:
                  for anything lower than 5000000 uV, 5.0V will be used
                  for values in range 5750001 - 6249000 uV, 6.0V will be used
                  for values in range 6250001 - 6500000 uV, 6.5V will be used
                  for anything above 9000000 uV, 9.0V will be used

For required properties on SPI, please consult
Documentation/devicetree/bindings/spi/spi-bus.txt

Required properties on I2C:

 - reg:         The i2c address. Value depends on the state of ADDR0
                and ADDR1, as wired in hardware.

Examples:

	adau1977_spi: adau1977@0 {
		compatible = "adi,adau1977";
		spi-max-frequency = <600000>;

		AVDD-supply = <&regulator>;
		DVDD-supply = <&regulator_digital>;
		MICBIAS-supply = <&regulator_micbias>;

		reset_gpio = <&gpio 10 GPIO_ACTIVE_LOW>;
	};

	adau1977_i2c: adau1977@11 {
		compatible = "adi,adau1977";
		reg = <0x11>;

		AVDD-supply = <&regulator>;
		DVDD-supply = <&regulator_digital>;
		MICBIAS-supply = <&regulator_micbias>;

		reset_gpio = <&gpio 10 GPIO_ACTIVE_LOW>;
	};
```

## Documentation/devicetree/bindings/sound/adi,max98522.yaml
```yaml
# SPDX-License-Identifier: (GPL-2.0-only OR BSD-2-Clause)
%YAML 1.2
---
$id: http://devicetree.org/schemas/sound/adi,max98522.yaml#
$schema: http://devicetree.org/meta-schemas/core.yaml#

title: Maxim Integrated MAX98522 Speaker Amplifier

maintainers:
  - Mingu Hwang <mingu.hwang@analog.com>

properties:
  compatible:
    const: adi,max98522

  reg:
    maxItems: 1
    description: I2C address of the device.

  reset-gpios:
    maxItems: 1

required:
  - compatible
  - reg

additionalProperties: false

examples:
  - |
    #include <dt-bindings/gpio/gpio.h>
    i2c {
      #address-cells = <1>;
      #size-cells = <0>;
      max98522: amplifier@38 {
        compatible = "adi,max98522";
        reg = <0x38>;
        reset-gpios = <&gpio 9 GPIO_ACTIVE_LOW>;
      };
    };
```

## Documentation/devicetree/bindings/sound/adi,sc5xx-asoc-card.yaml
```yaml
# SPDX-License-Identifier: (GPL-2.0-only OR BSD-2-Clause)
%YAML 1.2
---
$id: http://devicetree.org/schemas/sound/adi,sc5xx-asoc-card.yaml#
$schema: http://devicetree.org/meta-schemas/core.yaml#

title: DAI/ASoC Machine driver for ADI SC5xx based boards

maintainers:
  - Nathan Barrett-Morrison <nathan.morrison@timesys.com>
  - Greg Malysa <greg.malysa@timesys.com>

description:
  This is a glue layer to glue the DAI interface to various codecs.
  The DAI interface offers a wide set of audio protocols such as
  stereo I2S and other TDM modes.

properties:
  compatible:
    enum:
      - adi,sc5xx-asoc-card

  "adi,cpu-dai":
    description: DAI Channel to use

  "adi,codec":
    description: List of codecs to use for DAI linkage

required:
  - compatible
  - adi,cpu-dai
  - adi,codec

additionalProperties: false

examples:
  - |
    sound {
      compatible = "adi,sc5xx-asoc-card";
      adi,cpu-dai = <&i2s4>;
      adi,codec = <&adau1962>, <&adau1979>;
    };
...
```

## Documentation/devicetree/bindings/sound/adi,sc5xx-i2s-dai.yaml
```yaml
# SPDX-License-Identifier: (GPL-2.0-only OR BSD-2-Clause)
%YAML 1.2
---
$id: http://devicetree.org/schemas/sound/adi,sc5xx-i2s-dai.yaml#
$schema: http://devicetree.org/meta-schemas/core.yaml#

title: I2S + Digital Audio Interface (DAI) Driver for ADI SC5xx based boards

maintainers:
  - Nathan Barrett-Morrison <nathan.morrison@timesys.com>
  - Greg Malysa <greg.malysa@timesys.com>

description:
  This is the SC5xx process family I2S+DAI driver

properties:
  compatible:
    enum:
      - adi,sc5xx-i2s-dai

  reg:
    minItems: 2
    maxItems: 2
    description: "Sport A and Sport B addresses"

  "sport-channel":
    description: The serial port channel to use for I2S

  "interrupt-names":
    description: Interrupt names (tx_status and rx_status)

  "interrupts":
    description: GIC interrupt numbers

  "dmas":
    description: TX and RX DMA cluster numbers

  "dma-names"
    description: DMA channel names (tx and rx)

  "clocks"
    description: Clock being used for sport

  "clock-names"
    description: Clock name (sclk)

required:
  - compatible
  - reg
  - "sport-channel"
  - "interrupt-names"
  - "interrupts"
  - "dmas"
  - "dma-names"
  - "clocks"
  - "clock-names"

additionalProperties: false

examples:
  - |
  i2s0: i2s0@0 {
    compatible = "adi,sc5xx-i2s-dai";
    status = "disabled";
    reg = <0x31002000 0x80>, <0x31002080 0x80>;
    sport-channel = <0>;
    interrupt-names = "tx_status", "rx_status";
    interrupts = <GIC_SPI 82 IRQ_TYPE_LEVEL_HIGH>, <GIC_SPI 84 IRQ_TYPE_LEVEL_HIGH>;
    dmas = <&sport0_dma_cluster 0>, <&sport0_dma_cluster 1>;
    dma-names = "tx", "rx";
    clocks = <&clk ADSP_SC598_CLK_CGU0_SCLK1>;
    clock-names = "sclk";
  };
```

## Documentation/devicetree/bindings/sound/ak4458.txt
```
AK4458 audio DAC

This device supports both I2C and SPI modes.

Required properties:

- compatible : "asahi-kasei,ak4458"
- reg : The I2C address of the device for I2C, the chip select number for SPI.
- asahi-kasei,pdn-gpios: A GPIO specifier for the GPIO controlling
	the power down & reset pin.
- asahi-kasei,mute-gpios: A GPIO specifier for the GPIO controlling
	the soft mute pin.

Example:

&i2c {
	ak4458: ak4458@10 {
		compatible = "asahi-kasei,ak4458";
		reg = <0x10>;
		asahi-kasei,pdn-gpios = <&gpio1 10 GPIO_ACTIVE_HIGH>
		asahi-kasei,mute-gpios = <&gpio1 11 GPIO_ACTIVE_HIGH>
	};
};
```

## Documentation/devicetree/bindings/sound/ak4497.txt
```
AK4497 audio codec

This device supports I2C mode only.

Required properties:

- compatible : "asahi-kasei,ak4497"
- reg : The I2C address of the device.
- asahi-kasei,pdn-gpio: A GPIO specifier for the GPIO controlling
	the power down & reset pin.
- asahi-kasei,mute-gpio: A GPIO specifier for the GPIO controlling
	the soft mute pin.

Example:

&i2c {
	ak4458: ak4458@0x10 {
		compatible = "asahi-kasei,ak4458";
		reg = <0x10>;
		asahi-kasei,pdn-gpios = <&gpio1 10 GPIO_ACTIVE_HIGH>
		asahi-kasei,mute-gpios = <&gpio1 11 GPIO_ACTIVE_HIGH>
	};
};
```

## Documentation/devicetree/bindings/sound/ak5558.txt
```
AK5558 audio ADC

This device supports I2C mode only.

Required properties:

- compatible : "asahi-kasei,ak5558"
- reg : The I2C address of the device for I2C.
- asahi-kasei,pdn-gpios: A GPIO specifier for the GPIO controlling
	the power down & reset pin.

Example:

&i2c {
	ak5558: ak5558@10 {
		compatible = "asahi-kasei,ak5558";
		reg = <0x10>;
		asahi-kasei,pdn-gpios = <&gpio1 10 GPIO_ACTIVE_HIGH>;
	};
};
```

## Documentation/devicetree/bindings/sound/fsl,acm.txt
```
NXP Audio Clock Mux (ACM)

The Audio Clock Mux (ACM) is a collection of control registers and multiplexers
that are used to route the audio source clocks to the audio peripherals.
Each audio peripheral has its dedicated audio clock mux and control register.

Required properties:

  - compatible	: Contains "nxp,imx8qm-acm".
  - reg		: Offset and length of the register set for the device.

Example:

acm:  acm@59e00000 {
	compatible = "nxp,imx8qm-acm";
	reg = <0x0 0x59e00000 0x0 0x1D0000>;
	status = "okay";
};
```

## Documentation/devicetree/bindings/sound/fsl,amix.txt
```
NXP Audio Mixer (AMIX).

The Audio Mixer is a on-chip functional module that allows mixing of two audio
streams into a single audio stream. Audio Mixer has two input serial audio
interfaces. These are driven by two Synchronous Audio interface modules (SAI).
Each input serial interface carries 8 audio channels in its frame in TDM manner.
Mixer mixes audio samples of corresponding channels from two interfaces into a
single sample. Before mixing, audio samples of two inputs can be attenuated
based on configuration. The output of the Audio Mixer is also a serial audio
interface. Like input interfaces it has the same TDM frame format. This output
is used to drive the serial DAC TDM interface of audio codec and also sent to
the external pins along with the receive path of normal audio SAI module for
readback by the CPU.

The output of Audio mixer can be selected from any of the three streams
 - serial audio input 1
 - serial audio input 2
 - Mixed audio

Mixing operation is independent of audio sample rate but the two audio input
streams must have same audio sample rate with same number of channels in TDM
frame to be eligible for mixing.

Device driver required properties:
=================================
  - compatible		: Compatible list, contains "fsl,imx8qm-amix"

  - reg			: Offset and length of the register set for the device.

  - clocks		: Must contain an entry for each entry in clock-names.

  - clock-names		: Must include the "ipg" for register access.

  - power-domains       : Must contain the phandle to the AMIX power domain node

Device driver configuration example:
======================================
  amix: amix@59840000 {
    compatible = "fsl,imx8qm-amix";
    reg = <0x0 0x59840000 0x0 0x10000>;
    clocks = <&clk IMX8QXP_AUD_AMIX_IPG>;
    clock-names = "ipg";
    power-domains = <&pd_amix>;
  };

Machine driver required properties:
===================================
  - compatible		: Compatible list, contains "fsl,imx-audio-amix"

  - model		: Short audio card description.

  - dais		: Must contain a list of phandles to AMIX connected
			  DAIs. The current implementation requires two phandles
			  to SAI interfaces to be provided, the first SAI in the
			  list being used to route the AMIX output.

  - amix-controller	: Must contain the phandle to the AMIX device node.

Machine driver configuration example:
====================================
  sound-amix-sai {
    compatible = "fsl,imx-audio-amix";
    model = "amix-audio-sai";
    dais = <&sai4>, <&sai5>;
    amix-controller = <&amix>;
  };
```

## Documentation/devicetree/bindings/sound/fsl,dsp.txt
```
NXP DSP

The IP is from Cadence.

Required properties:

  - compatible	: Contains "fsl,imx8qxp-dsp".
  - reg		: Offset and length of the register set for the device.

Example:

dsp:  dsp@596e8000 {
	compatible = "fsl,imx8qxp-dsp";
	reg = <0x0 0x596e8000 0x0 0x88000>;
	status = "okay";
};
```

## Documentation/devicetree/bindings/sound/fsl,hifi4.txt
```
NXP HIFI4 DSP (HIFI4)

The IP is from Cadence.

Required properties:

  - compatible	: Contains "fsl,imx8qxp-hifi4".
  - reg		: Offset and length of the register set for the device.

Example:

hifi4:  hifi4@596e8000 {
	compatible = "fsl,imx8qxp-hifi4";
	reg = <0x0 0x596e8000 0x0 0x88000>;
	status = "okay";
};
```

## Documentation/devicetree/bindings/sound/fsl,mqs.txt
```
fsl,mqs audio CODEC

Required properties:

  - compatible : must contain one of "fsl,imx6sx-mqs", "fsl,codec-mqs"
		"fsl,imx8qm-mqs", "fsl,imx8qxp-mqs".

  - clocks : a list of phandles + clock-specifiers, one for each entry in
    clock-names

  - clock-names : must contain "mclk"

  - gpr : the gpr node.

Example:

mqs: mqs {
	compatible = "fsl,imx6sx-mqs";
	gpr = <&gpr>;
	clocks = <&clks IMX6SX_CLK_SAI1>;
	clock-names = "mclk";
	status = "disabled";
};
```

## Documentation/devicetree/bindings/sound/fsl,rpmsg-i2s.txt
```
Freescale rpmsg i2s interface.

The rpmsg i2s is based on RPMSG that used communicating with M4 core,
which provides a synchronous audio interface that supports fullduplex
serial interfaces with frame synchronization such as I2S.

Required properties:

  - compatible		: Compatible list, contains "fsl,imx7ulp-rpmsg-i2s".
				"fsl,imx8mq-rpmsg-i2s", "fsl,imx8qxp-rpmsg-i2s"

  - fsl,audioindex      : This is an index indicating the audio device index in
			  the M4 side.

Example:
rpmsg_i2s: rpmsg-i2s {
	compatible = "fsl,imx7ulp-rpmsg-i2s";
	/* the audio device index in m4 domain */
	fsl,audioindex = <0> ;
	status = "okay";
};
```

## Documentation/devicetree/bindings/sound/imx-audio-ak4458.txt
```
Freescale i.MX audio complex with AK4458 DAC

Required properties:

- compatible	: "fsl,imx-audio-ak4458", "fsl,imx-audio-ak4458-mq"
- model		: The user-visible name of this sound complex
- audio-cpu	: The phandle of CPU DAI
- audio-codec	: The phandle of the AK4458 audio DAC
- audio-routing : A list of the connections between audio components. Each entry
  is a pair of strings, the first being the connection's sink, the second being
  the connection's source. Valid names could be power supplies, AK4458 pins,
  and the jacks on the board.

Example:

sound {
       compatible = "fsl,imx-audio-ak4458";
       model = "ak4458-audio";
       audio-cpu = <&sai1>;
       audio-codec = <&codec>;
       audio-routing =
               "AOUTL1", "Playback",
               "AOUTR1", "Playback",
               "AOUTL2", "Playback",
               "AOUTR2", "Playback",
               "AOUTL3", "Playback",
               "AOUTR3", "Playback",
               "AOUTL4", "Playback",
               "AOUTR4", "Playback";
};
```

## Documentation/devicetree/bindings/sound/imx-audio-ak4497.txt
```
Freescale i.MX audio complex with AK4497 DAC

Required properties:

- compatible   : "fsl,imx-audio-ak4497"
- model        : The user-visible name of this sound complex
- audio-cpu    : The phandle of CPU DAI
- audio-codec  : The phandle of the ak4497 audio DAC
- audio-routing : A list of the connections between audio components. Each entry
  is a pair of strings, the first being the connection's sink, the second being
  the connection's source. Valid names could be power supplies, ak4497 pins,
  and the jacks on the board.

Example:

sound {
       compatible = "fsl,imx-audio-ak4497";
       model = "ak4497-audio";
       audio-cpu = <&sai3>;
       audio-codec = <&codec>;
       audio-routing =
               "AOUTLN", "Playback",
               "AOUTLP", "Playback",
               "AOUTRN", "Playback",
               "AOUTRP", "Playback",
};
```
