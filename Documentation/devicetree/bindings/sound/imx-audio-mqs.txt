## Documentation/devicetree/bindings/thermal/imx91-thermal.yaml
```yaml
# SPDX-License-Identifier: (GPL-2.0-only OR BSD-2-Clause)
%YAML 1.2
---
$id: http://devicetree.org/schemas/thermal/imx91-thermal.yaml#
$schema: http://devicetree.org/meta-schemas/core.yaml#

title: NXP i.MX91 Thermal

maintainers:
  - Pengfei Li <pengfei.li_1@nxp.com>

description: |
  i.MX91 features a new temperature sensor. It includes programmable
  temperature threshold comparators for both normal and privileged
  accesses and allows a programmable measurement frequency for the
  Periodic One-Shot Measurement mode. Additionally, it provides
  status registers for indicating the end of measurement and threshold
  violation events.

properties:
  compatible:
    items:
      - const: fsl,imx91-tmu

  reg:
    maxItems: 1

  clocks:
    maxItems: 1

  nvmem-cells:
    items:
      - description: Phandle to the trim control 1 provided by ocotp
      - description: Phandle to the trim control 2 provided by ocotp

  nvmem-cell-names:
    items:
      - const: tmu-trim1
      - const: tmu-trim2

  "#thermal-sensor-cells":
    description: |
      Number of cells required to uniquely identify the thermal
      sensors, 0 for ONLY one sensor and 1 for multiple sensors.
    enum:
      - 0
      - 1

required:
  - compatible
  - reg
  - clocks
  - '#thermal-sensor-cells'

additionalProperties: false

examples:
  - |
    #include <dt-bindings/clock/imx91-clock.h>

    thermal-sensor@44482000 {
      compatible = "fsl,imx91-tmu";
      reg = <0x44482000 0x1000>;
      #thermal-sensor-cells = <0>;
      clocks = <&clk IMX91_CLK_TMC_GATE>;
      nvmem-cells = <&tmu_trim1>, <&tmu_trim2>;
      nvmem-cell-names = "tmu-trim1", "tmu-trim2";
    };

...
```

## Documentation/devicetree/bindings/timer/adi,gptimer-counter.yaml
```yaml
# SPDX-License-Identifier: (GPL-2.0-only OR BSD-2-Clause)
%YAML 1.2
---
$id: http://devicetree.org/schemas/timer/adi,gptimer-counter.yaml#
$schema: http://devicetree.org/meta-schemas/core.yaml#

title: General Purpose Timers for Analog Devices SC5XX Processors

maintainers:
  - Nathan Barrett-Morrison <nathan.morrison@timesys.com>
  - Greg Malysa <greg.malysa@timesys.com>

description: |
    GPTimer driver for providing system clock source, clock event source,
    and generic counters for use in userspace (used alongside adi,sc5xx-gptimers)

properties:
  compatible:
    enum:
      - adi,gptimer-counter

required:
  - compatible

additionalProperties: false

examples:
  - |
    gptimer_counter: gptimer-counters@0 {
      compatible = "adi,gptimer-counter";
      status = "okay";
    };
```

## Documentation/devicetree/bindings/usb/adi,musb.yaml
```yaml
# SPDX-License-Identifier: (GPL-2.0-only)
%YAML 1.2
---
$id: http://devicetree.org/schemas/usb/adi,musb.yaml#
$schema: http://devicetree.org/meta-schemas/core.yaml#

title: Inventra USB Glue Layer for Analog Devices SC5XX Processors

maintainers:
  - Analog Devices, Inc <adsp-linux@analog.com>

description: |
    For the Inventra-based USB IP on the ADI SC58X and SC57X processors
    (glues to musb_core.c)

properties:
  compatible:
    enum:
      - adi,musb

  reg:
    maxItems: 1

  reg-names:
    maxItems: 1

  interrupts:
    maxItems: 2

  interrupt-names:
    items:
      - const: mc
      - const: dma

  spu_securep_id:
    $ref: /schemas/types.yaml#/definitions/uint32
    description: System Protection Unit peripheral ID

  mentor,multipoint:
    $ref: /schemas/types.yaml#/definitions/uint32
    description: Indicate the musb controller supports multipoint with "1"

  mentor,num-eps:
    $ref: /schemas/types.yaml#/definitions/uint32
    description: Number of endpoints supported including EP0

  mentor,ram-bits:
    description: Address size of the RAM in bits

  mentor,power:
    $ref: /schemas/types.yaml#/definitions/uint32
    description: Maximum power consumption in mA

  phys:
    maxItems: 1

required:
  - compatible
  - reg
  - reg-names
  - interrupts
  - interrupt-names
  - spu_securep_id
  - mentor,multipoint
  - mentor,num-eps
  - mentor,ram-bits
  - mentor,power
  - phys

additionalProperties: false

examples:
  - |
    #include <dt-bindings/interrupt-controller/arm-gic.h>
    #include <dt-bindings/interrupt-controller/irq.h>

    usb0: usb@310c1000 {
      compatible = "adi,musb";
      reg = <0x310c1000 0x390>;
      reg-names = "mc";
      interrupts = <GIC_SPI 132 IRQ_TYPE_LEVEL_HIGH>,
                   <GIC_SPI 133 IRQ_TYPE_LEVEL_HIGH>;
      interrupt-names = "mc", "dma";
      spu_securep_id = <153>;

      mentor,multipoint = <1>;
      mentor,num-eps = <16>;
      mentor,ram-bits = <12>;
      mentor,power = <500>;
      phys = <&usb0_phy>;
      status = "disabled";
    };
```

## Documentation/devicetree/bindings/usb/cdns-usb3.txt
```
* Cadence USB3 Controller

Required properties:
- compatible: "Cadence,usb3";
- reg: base address and length of the registers
- interrupts: interrupt for the USB controller
- interrupt-parent: the interrupt parent for this module
- clocks: reference to the USB clock
- clock-names: the name of clocks
- cdns3,usbphy: reference to the USB PHY

Optional properties:
- dr_mode: One of "host", "peripheral" or "otg". Defaults to "otg"
- extcon: extcon phandler for cdns3 device
- power-domains: the power domain for cdns3 controller and phy

Examples:

usbotg3: cdns3@5b110000 {
	compatible = "Cadence,usb3";
	reg = <0x0 0x5B110000 0x0 0x10000>,
		<0x0 0x5B130000 0x0 0x10000>,
		<0x0 0x5B140000 0x0 0x10000>,
		<0x0 0x5B160000 0x0 0x40000>;
	interrupt-parent = <&gic>;
	interrupts = <GIC_SPI 271 IRQ_TYPE_LEVEL_HIGH>;
	clocks = <&clk IMX8QM_USB3_LPM_CLK>,
		<&clk IMX8QM_USB3_BUS_CLK>,
		<&clk IMX8QM_USB3_ACLK>,
		<&clk IMX8QM_USB3_IPG_CLK>,
		<&clk IMX8QM_USB3_CORE_PCLK>;
	clock-names = "usb3_lpm_clk", "usb3_bus_clk", "usb3_aclk",
		"usb3_ipg_clk", "usb3_core_pclk";
	power-domains = <&pd_conn_usb2>;
	cdns3,usbphy = <&usbphynop1>;
	dr_mode = "otg";
	extcon = <&typec_ptn5150>;
	status = "disabled";
};
```

## Documentation/devicetree/bindings/usb/intel,agilex5-dwc3.yaml
```yaml
# SPDX-License-Identifier: (GPL-2.0-only OR BSD-2-Clause)
%YAML 1.2
---
$id: http://devicetree.org/schemas/usb/intel,agilex5-dwc3.yaml#
$schema: http://devicetree.org/meta-schemas/core.yaml#

title: Intel Agilex5 DWC3 USB controller

maintainers:
  - Adrian Ng Ho Yin <adrian.ho.yin.ng@intel.com>

properties:
  compatible:
    const: intel,agilex5-dwc3

  reg:
    maxItems: 1

  clocks:
    maxItems: 2

  ranges: true

  resets:
    maxItems: 2

  reset-names:
    items:
      - const: dwc3
      - const: dwc3-ecc

  '#address-cells':
    enum: [ 1, 2 ]

  '#size-cells':
    enum: [ 1, 2 ]

# Required child node:

patternProperties:
  "^usb@[0-9a-f]+$":
    $ref: snps,dwc3.yaml#

required:
  - compatible
  - reg
  - clocks
  - resets
  - ranges

additionalProperties: false

examples:
  - |
    #include <dt-bindings/interrupt-controller/arm-gic.h>
    #include <dt-bindings/interrupt-controller/irq.h>
    #include <dt-bindings/reset/altr,rst-mgr-agilex5.h>
    #include <dt-bindings/clock/agilex5-clock.h>

    usb1@11000000 {
          compatible = "intel,agilex5-dwc3";
          reg = <0x11000000 0x100000>;
          ranges;
          clocks = <&clkmgr AGILEX5_USB31_SUSPEND_CLK>,
                   <&clkmgr AGILEX5_USB31_BUS_CLK_EARLY>;
          resets = <&rst USB1_RESET>, <&rst USB1_OCP_RESET>;
          reset-names = "dwc3", "dwc3-ecc";
          #address-cells = <1>;
          #size-cells = <1>;

          usb@11000000 {
                compatible = "snps,dwc3";
                reg = <0x11000000 0x100000>;
                interrupts = <GIC_SPI 94 IRQ_TYPE_LEVEL_HIGH>;
                dr_mode = "host";
          };
    };
```

## Documentation/devicetree/bindings/usb/typec-switch-gpio.txt
```
Typec orientation switch via a GPIO
-----------------------------------

Required properties:
- compatible: should be set one of following:
	- "nxp,ptn36043" or "nxp,cbtl04gp" for NXP Type-C SuperSpeed
	  active switch.

- gpios: the GPIO used to switch the super speed active channel,
		GPIO_ACTIVE_HIGH: GPIO state high for cc1;
		GPIO_ACTIVE_LOW:  GPIO state low for cc1.
- orientation-switch: must be present.

Required sub-node:
- port: specify the remote endpoint of typec switch consumer.

Example:

ptn36043 {
	compatible = "nxp,ptn36043";
	pinctrl-names = "default";
	pinctrl-0 = <&pinctrl_ss_sel>;
	gpios = <&gpio3 15 GPIO_ACTIVE_HIGH>;
	orientation-switch;

	port {
		usb3_data_ss: endpoint {
			remote-endpoint = <&typec_con_ss>;
		};
	};
};
```

## Documentation/devicetree/bindings/usb/typec-tcpci.txt
```
TCPCI(Typec port cotroller interface) binding
---------------------------------------------

Required properties:
- compatible:       should be "usb,tcpci".
- reg:              the i2c slave address of typec port controller device.
- interrupt-parent: the phandle to the interrupt controller which provides
                    the interrupt.
- interrupts:       interrupt specification for tcpci alert.
- port-type:        typec port type.
- default-role:     preferred power role if port type is "drp".

Required properties only for power source or drp:
- src-pdos

Required properties only for power sink or drp:
- snk-pdos
- max-snk-mv
- max-snk-ma
- op-snk-mw

Optional properties:
- sink-disable:     disable vbus sink in sink role in case we only can be source
                    for power but need dual data role.

Example:

ptn5110@50 {
	compatible = "usb,tcpci";
	reg = <0x50>;
	interrupt-parent = <&gpio3>;
	interrupts = <3 IRQ_TYPE_LEVEL_LOW>;
	port-type = "drp";
	default-role = "sink";
	src-pdos = <0x380190c8>;
	snk-pdos = <0x380190c8 0x3802d0c8>;
	max-snk-mv = <9000>;
	max-snk-ma = <1000>;
	op-snk-mw = <9000>;
};
```

## Documentation/devicetree/bindings/usb/typec.txt
```
Generic typec and power delivery properties
-------------------------------------------

Required properties:
- port-type:    should be one of "drp", "dfp" or "ufp".
- default-role: preferred power role if drp, should be "sink" or "source".
- src-pdos:     An array of u32 with each entry providing supported power
                source data object(PDO), the detailed bit definitions of
                PDO can be found in "Universal Serial Bus Power Delivery
                Specification" chapter 6.4.1.2 Source_Capabilities Message,
                the order of each entry(PDO) should follow the PD spec chapter
                6.4.1. Required only for power source and power dual role with
                power delivery support.
- snk-pdos:     An array of u32 with each entry providing supported power
                sink data object(PDO), the detailed bit definitions of PDO
                can be found in "Universal Serial Bus Power Delivery
                Specification" chapter 6.4.1.3 Sink Capabilities Message,
                the order of each entry(PDO) should follow the PD spec chapter
                6.4.1. Required only for power sink and power dual role with
                power delivery support.
- max-snk-mv:   The max voltage the sink can support in millivoltage, required
                only for power sink and power dual role with power delivery
                support.
- max-snk-ma:   The max current the sink can support in milliampere, required
                only for power sink and power dual role with power delivery
                support.
- op-snk-mw:    Sink required operating power in milliwatts, if source offered
                power is less then it, Capability Mismatch is set, required
                only for power sink and power dual role with power delivery
                support.

Example:

ptn5110@50 {
	compatible = "usb,tcpci";
	reg = <0x50>;
	interrupt-parent = <&gpio3>;
	interrupts = <3 IRQ_TYPE_LEVEL_LOW>;
	port-type = "drp";
	default-role = "sink";
	src-pdos = <0x380190c8>;
	snk-pdos = <0x380190c8 0x3802d0c8>;
	max-snk-mv = <9000>;
	max-snk-ma = <1000>;
	op-snk-mw = <9000>;
};
```

## Documentation/devicetree/bindings/video/altr,vip-fb2.txt
```
Altera Video and Image Processing(VIP) Frame Buffer II bindings

Required properties:
- compatible: "altr,vip-frame-buffer-2.0"
- reg: Physical base address and length of the framebuffer controller's
  registers.
- max-width: The width of the framebuffer in pixels.
- max-height: The height of the framebuffer in pixels.
- bits-per-symbol: only "8" is currently supported
- mem-port-width = the bus width of the avalon master port on the frame reader

Example:

dp_0_frame_buf: vip@0x100000280 {
	compatible = "altr,vip-frame-buffer-2.0";
	reg = <0x00000001 0x00000280 0x00000040>;
	altr,max-width = <1920>;
	altr,max-height = <1080>;
	altr,bits-per-symbol = <8>;
	altr,mem-port-width = <128>;
};
```

## Documentation/devicetree/bindings/watchdog/adi,watchdog.yaml
```yaml
# SPDX-License-Identifier: (GPL-2.0-only OR BSD-2-Clause)
%YAML 1.2
---
$id: http://devicetree.org/schemas/watchdog/adi,watchdog.yaml#
$schema: http://devicetree.org/meta-schemas/core.yaml#

title: Analog Devices Watchdog Peripheral on SC5XX Series Processors

maintainers:
  - Nathan Barrett-Morrison <nathan.morrison@timesys.com>
  - Greg Malysa <greg.malysa@timesys.com>

description:
  This is a basic watchdog timer peripheral which will trigger
  a processor reset through the RCU when timeout-sec expires

properties:
  compatible:
    enum:
      - adi,watchdog

  reg:
    maxItems: 1

  timeout-sec :
    maxItems: 1
    description: "Timeout value in seconds"

  clocks:
    maxItems: 1

  clock-names:
    maxItems: 1

required:
  - compatible
  - reg
  - timeout-sec
  - clocks
  - clock-names

additionalProperties: false

examples:
  - |
    watchdog@0x31008000 {
      compatible = "adi,watchdog";
      reg = <0x31008000 0x10>;
      timeout-sec = <30>;
      clocks = <&clk ADSP_SC598_CLK_CGU0_SCLK0>;
      clock-names = "adi-watchdog";
    };
```
