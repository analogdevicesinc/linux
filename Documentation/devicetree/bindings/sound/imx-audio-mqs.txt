## Documentation/devicetree/bindings/sound/imx-audio-mqs.txt
```
Freescale i.MX audio complex with mqs codec

Required properties:
- compatible : "fsl,imx-audio-mqs", "fsl,imx8qm-lpddr4-arm2-mqs", "fsl,imx8qxp-lpddr4-arm2-mqs"
- model : The user-visible name of this sound complex
- cpu-dai : The phandle of the i.MX sai controller
- audio-codec : The phandle of the mqs audio codec

Example:

sound-mqs {
	compatible = "fsl,imx6sx-sdb-mqs",
			"fsl,imx-audio-mqs";
	model = "mqs-audio";
	cpu-dai = <&sai1>;
	audio-codec = <&mqs>;
};
```

## Documentation/devicetree/bindings/sound/imx-audio-rpmsg.txt
```
Freescale i.MX audio complex with rpmsg devices

Required properties:
- compatible : "fsl,imx-audio-rpmsg"
- model : The user-visible name of this sound complex
- cpu-dai : The phandle of the i.MX rpmsg i2s device.

Example:
sound-rpmsg {
	compatible = "fsl,imx-audio-rpmsg";
	model = "rpmsg-audio";
	cpu-dai = <&rpmsg_i2s>;
};
```

## Documentation/devicetree/bindings/sound/imx-audio-wm8524.txt
```
Freescale i.MX audio complex with WM8524 codec

Required properties:

  - compatible		: "fsl,imx-audio-wm8524"

  - model		: The user-visible name of this sound complex

  - audio-cpu		: The phandle of CPU DAI

  - audio-codec		: The phandle of the WM8962 audio codec

  - audio-routing	: A list of the connections between audio components.
			  Each entry is a pair of strings, the first being the
			  connection's sink, the second being the connection's
			  source. Valid names could be power supplies, WM8524
			  pins, and the jacks on the board:

Example:

sound {
	compatible = "fsl,imx-audio-wm8524";
	model = "wm8524-audio";
	audio-cpu = <&sai2>;
	audio-codec = <&codec>;
	audio-routing =
		"Line Out Jack", "LINEVOUTL",
		"Line Out Jack", "LINEVOUTR";
};
```

## Documentation/devicetree/bindings/sound/imx-audio-wm8960.txt
```
Freescale i.MX audio complex with WM8960 codec

Required properties:

  - compatible		: "fsl,imx-audio-wm8960", "fsl,imx7d-evk-wm8960"

  - model		: The user-visible name of this sound complex

  - cpu-dai		: The phandle of CPU DAI

  - audio-codec		: The phandle of the WM8960 audio codec

  - audio-routing	: A list of the connections between audio components.
			  Each entry is a pair of strings, the first being the
			  connection's sink, the second being the connection's
			  source. Valid names could be power supplies, WM8960
			  pins, and the jacks on the board:

			  Power supplies:
			   * Mic Bias

			  Board connectors:
			   * Mic Jack
			   * Headphone Jack
			   * Ext Spk

Optional properties:
- hp-det-gpios : The gpio pin to detect plug in/out event that happens to
  Headphone jack.
- mic-det-gpios: The gpio pin to detect plug in/out event that happens to
  Microphone jack.

Example:

	sound: sound {
		compatible = "fsl,imx7d-evk-wm8960",
			   "fsl,imx-audio-wm8960";
		model = "wm8960-audio";
		cpu-dai = <&sai1>;
		audio-codec = <&wm8960>;
		codec-master;
		/*
		 * hp-det = <hp-det-pin hp-det-polarity>;
		 * hp-det-pin: JD1 JD2  or JD3
		 * hp-det-polarity = 0: hp detect high for headphone
		 * hp-det-polarity = 1: hp detect high for speaker
		 */
		hp-det = <2 0>;
		hp-det-gpios = <&gpio1 0 0>;
		mic-det-gpios = <&gpio1 0 0>;
		audio-routing =
			"Headphone Jack", "HP_L",
			"Headphone Jack", "HP_R",
			"Ext Spk", "SPK_LP",
			"Ext Spk", "SPK_LN",
			"Ext Spk", "SPK_RP",
			"Ext Spk", "SPK_RN",
			"LINPUT2", "Mic Jack",
			"LINPUT3", "Mic Jack",
			"RINPUT1", "Main MIC",
			"RINPUT2", "Main MIC",
			"Mic Jack", "MICB",
			"Main MIC", "MICB",
			"CPU-Playback", "ASRC-Playback",
			"Playback", "CPU-Playback",
			"ASRC-Capture", "CPU-Capture",
			"CPU-Capture", "Capture";
	};
```

## Documentation/devicetree/bindings/sound/imx-audio-xtor.txt
```
Freescale i.MX audio complex with Freescale DAI transceiver.
Currently supports Freescale SAI or ESAI digital audio interface.

Required properties:

  - compatible		: "fsl,imx-audio-xtor"

  - model		: The user-visible name of this sound complex

  - cpu-dai		: The phandle of the i.MX DAI, currently supports
			  SAI or ESAI controller

Optional properties:

  - asrc-controller	: The phandle of the i.MX ASRC controller associated with DAI.

Examples:

sound-xtor-sai {
	compatible = "fsl,imx-audio-xtor";
	model = "xtor-audio-sai";
	cpu-dai = <&sai0>;
	asrc-controller = <&asrc0>;
};

sound-xtor-esai {
	compatible = "fsl,imx-audio-xtor";
	model = "xtor-audio-esai";
	cpu-dai = <&esai0>;
};
```

## Documentation/devicetree/bindings/sound/imx-pdm-mic.txt
```
Freescale i.MX audio complex PDM microphone

Required properties:
- compatible: "fsl,imx-pdm-mic"
- model: The user-visible name of this sound complex
- audio-cpu : The phandle of the i.MX SAI controller
- decimation : The PDM decimation factor <64>

Example:

sound-pdm {
	compatible = "fsl,imx-pdm-mic";
	model = "imx-pdm-audio";
	audio-cpu = <&sai3>;
	decimation = <64>;
};
```

## Documentation/devicetree/bindings/spi/adi,axi-spi-engine-peripheral-props.yaml
```yaml
# SPDX-License-Identifier: (GPL-2.0 OR BSD-2-Clause)
%YAML 1.2
---
$id: http://devicetree.org/schemas/spi/adi,axi-spi-engine-peripheral-props.yaml#
$schema: http://devicetree.org/meta-schemas/core.yaml#

title: Peripheral properties for Analog Devices AXI SPI Engine Controller

maintainers:
  - Michael Hennerich <Michael.Hennerich@analog.com>
  - Nuno Sá <nuno.sa@analog.com>

properties:
  adi,offloads:
    description:
      List of AXI SPI Engine offload instances assigned to this peripheral.
    $ref: /schemas/types.yaml#/definitions/uint32-array
    maxItems: 32
    items:
      items:
        - minimum: 0
          maximum: 31

additionalProperties: true
```

## Documentation/devicetree/bindings/spi/adi,axi-spi-engine.yaml
```yaml
# SPDX-License-Identifier: (GPL-2.0-only OR BSD-2-Clause)
%YAML 1.2
---
$id: http://devicetree.org/schemas/spi/adi,axi-spi-engine.yaml#
$schema: http://devicetree.org/meta-schemas/core.yaml#

title: Analog Devices AXI SPI Engine Controller

description: |
  The AXI SPI Engine controller is part of the SPI Engine framework[1] and
  allows memory mapped access to the SPI Engine control bus. This allows it
  to be used as a general purpose software driven SPI controller as well as
  some optional advanced acceleration and offloading capabilities.

  [1] https://wiki.analog.com/resources/fpga/peripherals/spi_engine

maintainers:
  - Michael Hennerich <Michael.Hennerich@analog.com>
  - Nuno Sá <nuno.sa@analog.com>

allOf:
  - $ref: /schemas/spi/spi-controller.yaml#

$defs:
  offload:
    description:
      Describes the connections of the trigger input and the data output stream
      of one or more offload instances.

    properties:
      reg:
        description:
          Index of the offload instance.
        items:
          - minimum: 0
            maximum: 31

    required:
      - reg

properties:
  compatible:
    const: adi,axi-spi-engine-1.00.a

  reg:
    maxItems: 1

  interrupts:
    maxItems: 1

  clocks:
    items:
      - description: The AXI interconnect clock.
      - description: The SPI controller clock.

  clock-names:
    items:
      - const: s_axi_aclk
      - const: spi_clk

  offloads:
    type: object
    description: Zero or more offloads supported by the controller.

    properties:
      "#address-cells":
        const: 1

      "#size-cells":
        const: 0

    patternProperties:
      "^offload@[0-8a-f]+$":
        type: object
        $ref: '#/$defs/offload'

required:
  - compatible
  - reg
  - interrupts
  - clocks
  - clock-names

unevaluatedProperties: false

examples:
  - |
    spi@44a00000 {
        compatible = "adi,axi-spi-engine-1.00.a";
        reg = <0x44a00000 0x1000>;
        interrupts = <0 56 4>;
        clocks = <&clkc 15>, <&clkc 15>;
        clock-names = "s_axi_aclk", "spi_clk";

        #address-cells = <1>;
        #size-cells = <0>;

        offloads {
            #address-cells = <1>;
            #size-cells = <0>;

            offload@0 {
                compatible = "adi,example-offload";
                reg = <0>;
            };
        };

        adc@0 {
            compatible = "adi,example-adc";
            reg = <0>;
            adi,offloads = <0>;
        };
    };
```

## Documentation/devicetree/bindings/spi/adi,spi3-peripheral-props.yaml
```yaml
# SPDX-License-Identifier: (GPL-2.0-only OR BSD-2-Clause)
%YAML 1.2
---
$id: http://devicetree.org/schemas/spi/adi,spi3-peripheral-props.yaml#
$schema: http://devicetree.org/meta-schemas/core.yaml#

title: Peripheral-specific properties for Analog Devices SPI3 controller driver

description:
  See spi-peripheral-props.yaml for more info.

maintainers:
  - Greg Malysa <gmalysa@alumni.stanford.edu>
  - Slawomir Kulig <slawomir.kulig@analog.com>

properties:
  adi,enable-dma:
    type: boolean
    description: |
      Use DMA for data transfers to/from SPI controller.

  adi,open-drain-mode:
    type: boolean
    description: |
      Enable ODM - Open Drain Mode for all output pins.

  adi,psse:
    type: boolean
    description: |
      Enable PSSE - Controls signalling of MODF error.

additionalProperties: true
```

## Documentation/devicetree/bindings/spi/spi-cadence-qspi.txt
```
* SPI driver for Cadence QSPI Controller

Required properties:
- compatible : Should be "cadence,qspi".
- reg : Contains two entries, each of which is a tuple consisting of a
	physical address and length.  The first entry is the address and
	length of the controller register set.  The second entry is the
	address and length of the QSPI Controller data area.
- interrupts : Unit interrupt specifier for the controller interrupt.
- ext-decoder : Value of 0 means no external chipselect decoder is
	connected, 1 means there is an external chipselect decoder connected.
- num-chipselect : Number of chip select lines.
- fifo-depth : Size of the data FIFO in bytes.
- bus-num : Number of the SPI bus to which the controller is connected.

Optional properties:
- dmas : DMA request lines.  Should be <&pdma 0 &pdma 1>.  If present,
  then DMA is used for reads and writes
- dma-names : Names of DMA request lines. Should be "tx", "rx".

Example:

	qspi: spi@ff705000 {
		compatible = "cadence,qspi";
		#address-cells = <1>;
		#size-cells = <0>;
		reg = <0xff705000 0x1000>,
			<0xffa00000 0x1000>;
		interrupts = <0 151 4>;
		clocks = <&qspi_clk>;
		ext-decoder = <0>;
		num-chipselect = <4>;
		fifo-depth = <128>;
		bus-num = <2>;
		dmas = <&pdma 24 &pdma 25>;
		dma-names = "tx", "rx";
	}
```

## Documentation/devicetree/bindings/switch/adi,adg1712.yaml
```yaml
# SPDX-License-Identifier: (GPL-2.0-only OR BSD-2-Clause)
%YAML 1.2
---
$id: http://devicetree.org/schemas/switch/adi,adg1712.yaml#
$schema: http://devicetree.org/meta-schemas/core.yaml#

title: Analog Devices ADG1712 quad SPST switch

maintainers:
  - Antoniu Miclaus <antoniu.miclaus@analog.com>

description: |
  The ADG1712 contains four independent single-pole, single-throw (SPST)
  switches controlled by GPIO pins. The device operates with a low-voltage
  single supply range from +1.08V to +5.5V or a low-voltage dual supply
  range from ±1.08V to ±2.75V.

  Datasheet: https://www.analog.com/en/products/adg1712.html

select: false

allOf:
  - $ref: /schemas/mux/gpio-mux.yaml#

properties:
  compatible:
    const: gpio-mux

unevaluatedProperties: false

examples:
  - |
    #include <dt-bindings/gpio/gpio.h>

    /* ADG1712 with four independent switches, each as a 2-state mux */
    adg1712_sw1: mux-controller-0 {
        compatible = "gpio-mux";
        #mux-control-cells = <0>;
        mux-gpios = <&gpio 10 GPIO_ACTIVE_HIGH>;
        idle-state = <0>;  /* Switch open */
    };

    adg1712_sw2: mux-controller-1 {
        compatible = "gpio-mux";
        #mux-control-cells = <0>;
        mux-gpios = <&gpio 11 GPIO_ACTIVE_HIGH>;
        idle-state = <0>;  /* Switch open */
    };

    adg1712_sw3: mux-controller-2 {
        compatible = "gpio-mux";
        #mux-control-cells = <0>;
        mux-gpios = <&gpio 12 GPIO_ACTIVE_HIGH>;
        idle-state = <1>;  /* Switch closed */
    };

    adg1712_sw4: mux-controller-3 {
        compatible = "gpio-mux";
        #mux-control-cells = <0>;
        mux-gpios = <&gpio 13 GPIO_ACTIVE_HIGH>;
        idle-state = <0>;  /* Switch open */
    };
...
```

## Documentation/devicetree/bindings/thermal/adi,sc59x-thermal.yaml
```yaml
# SPDX-License-Identifier: (GPL-2.0-only OR BSD-2-Clause)
%YAML 1.2
---
$id: http://devicetree.org/schemas/thermal/adi,sc59x-thermal.yaml#
$schema: http://devicetree.org/meta-schemas/core.yaml#

title: Analog Devices Thermal Monitor for SC59x 64-bit Family Processors

maintainers:
  - Nathan Barrett-Morrison <nathan.morrison@timesys.com>
  - Greg Malysa <greg.malysa@timesys.com>

description: |
  Thermal Monitor for SC59x 64-bit Family Processors

properties:
  compatible:
    enum:
      - adi,sc59x-thermal

  reg:
    maxItems: 1

  "#thermal-sensor-cells":
    const: 0

  interrupt-parent:
    maxItems: 1

  interrupts:
    maxItems: 2
    minItems: 2

  adi,gain:
    maxItems: 1
    description: "Gain error correction value (two's complement)"

  adi,offset:
    maxItems: 1
    description: "Offset error correction value (Q9.7)"

required:
  - compatible
  - reg
  - "#thermal-sensor-cells"
  - interrupt-parent
  - interrupts
  - adi,gain
  - adi,offset

additionalProperties: false

examples:
  - |
    thermal: thermal@0x31016800 {
      compatible = "adi,sc59x-thermal";
      reg = <0x31016800 0x100>;
      #thermal-sensor-cells = <0>;
      interrupt-parent = <&gic>;
      interrupts = <GIC_SPI 7 IRQ_TYPE_EDGE_RISING>,
                   <GIC_SPI 8 IRQ_TYPE_EDGE_RISING>;
      adi,gain = <0x4>; /* 10-bit two's complement */
      adi,offset = <0x7D40>; /* Q9.7 fixed point */
      status = "disabled";
    };
```

## Documentation/devicetree/bindings/thermal/imx-sc-thermal.txt
```
* IMX8QM/QXP SoC Temperature Sensor

Required properties:
- compatible :
- "nxp,imx8qm-sc-tsens"
- "nxp,imx8qxp-sc-tsens"

- reg: Address range of the thermal registers
- #thermal-sensor-cells : Should be 1. See ./thermal.txt for a description.
- tsens-num: the number of temp sensor on this SOC.

Example:
tsens: thermal-sensor@ {
		compatible = "nxp,imx8qm-sc-tsens";
		tsens-num = <5>;
		#thermal-sensor-cells = <1>;
};
```

## Documentation/devicetree/bindings/thermal/imx8mm-thermal.txt
```
* Temperature Monitor (TMU) on Freescale i.MX8MM SoCs

Required properties:
- compatible : "fsl,imx8mm-tmu"
- reg: Address and length of the register
- clocks : thermal sensor's clock source.
- #thermal-sensor-cells : Should be 0. See ./thermal.txt for a description.
Example:

tmu: tmu@0x30260000 {
	compatible = "fsl,imx8mm-tmu";
	reg = <0x0 0x30260000 0x0 0x10000>;
	clocks = <&clk IMX8MM_CLK_TMU_ROOT>;
	interrupts = <GIC_SPI 49 IRQ_TYPE_LEVEL_HIGH>;
	#thermal-sensor-cells = <0>;
};
```
