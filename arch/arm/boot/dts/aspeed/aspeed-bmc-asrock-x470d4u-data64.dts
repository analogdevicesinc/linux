// SPDX-License-Identifier: GPL-2.0+

#include "aspeed-bmc-asrock-x470d4u.dts"

/ {
	compatible = "asrock,x470d4u-data64-bmc", "aspeed,ast2500";
	model = "ASRock Rack X470D4U-series BMC (64MB flash)";
};

&fmc {
	flash@0 {
		/delete-node/partitions;
#include "openbmc-flash-layout-64.dtsi"
	};
};
