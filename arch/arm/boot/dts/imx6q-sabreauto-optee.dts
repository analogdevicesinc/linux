/*
 * Copyright 2017 NXP
 *
 * This program is free software; you can redistribute it and/or modify
 * it under the terms of the GNU General Public License version 2 as
 * published by the Free Software Foundation.
 */

#include "imx6q-sabreauto.dts"

&ocram {
	/* Reserve the high 32K for OP-TEE */
	reg = <0x00905000 0x33000>;
};
