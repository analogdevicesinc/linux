/*
 * Copyright 2017 NXP
 *
 * This program is free software; you can redistribute it and/or modify
 * it under the terms of the GNU General Public License version 2 as
 * published by the Free Software Foundation.
 */

#include "imx6qp-sabreauto.dts"

/* TODO: This needs to be changed to use OCRAM3 */
&ocram {
	reg = <0x00905000 0x33000>;
};
