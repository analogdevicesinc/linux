/*
 * Copyright 2017 NXP
 *
 * This program is free software; you can redistribute it and/or modify
 * it under the terms of the GNU General Public License version 2 as
 * published by the Free Software Foundation.
 */

#include "imx6sx-sabreauto.dts"

&ocram {
	reg = <0x00905000 0x1b000>;
};

&ocrams_ddr {
	reg = <0x00904000 0x1000>;
};

&ocrams {
	/* 0x8f8000 are used by optee */
	reg = <0x00900000 0x4000>;
	clocks = <&clks IMX6SX_CLK_OCRAM>;
};
