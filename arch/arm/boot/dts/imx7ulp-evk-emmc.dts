/*
 * Copyright (C) 2016 Freescale Semiconductor, Inc.
 * Copyright 2018 NXP.
 *
 * This program is free software; you can redistribute it and/or modify
 * it under the terms of the GNU General Public License version 2 as
 * published by the Free Software Foundation.
 */

#include "imx7ulp-evk.dts"

/* To support eMMC HS200/HS400, need to do the following reowrk:
 * 1,remove TF sd slot, replace eMMC chip
 * 2,fix eMMC I/O voltage to 1.8v, remove R183, short TP3 and TP89
 * 3,add R107, make eMMC boot work
 */
&usdhc0 {
	pinctrl-names = "default", "state_100mhz", "state_200mhz", "sleep";
	pinctrl-0 = <&pinctrl_usdhc0_8bit>;
	pinctrl-1 = <&pinctrl_usdhc0_8bit>;
	pinctrl-2 = <&pinctrl_usdhc0_8bit>;
	pinctrl-3 = <&pinctrl_usdhc0_8bit>;
	non-removable;
	bus-width = <8>;
	status = "okay";
};
