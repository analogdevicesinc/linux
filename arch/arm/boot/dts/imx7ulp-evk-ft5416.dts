/*
 * Copyright (C) 2017 Freescale Semiconductor, Inc.
 *
 * This program is free software; you can redistribute it and/or modify
 * it under the terms of the GNU General Public License version 2 as
 * published by the Free Software Foundation.
 */

#include "imx7ulp-evk.dts"

&lpi2c7 {
	focaltech@38 {
		focaltech,panel-type = <FT5416>;
		focaltech,swap-xy;
		/delete-property/focaltech,scaling-down-half;
	};
};
