/*
 * Copyright 2016 Freescale Semiconductor, Inc.
 *
 * This program is free software; you can redistribute it and/or modify
 * it under the terms of the GNU General Public License version 2 as
 * published by the Free Software Foundation.
 */

#include "imx7ulp-evk.dts"

&bcmdhd_wlan_0 {
	status = "disabled";
};

&lpuart6 {
	status = "disabled";
};

&usdhc1 {
	pinctrl-names = "default", "state_100mhz", "state_200mhz", "sleep";
	pinctrl-0 = <&pinctrl_usdhc1 &pinctrl_usdhc1_rst>;
	pinctrl-1 = <&pinctrl_usdhc1 &pinctrl_usdhc1_rst>;
	pinctrl-2 = <&pinctrl_usdhc1 &pinctrl_usdhc1_rst>;
	pinctrl-3 = <&pinctrl_usdhc1 &pinctrl_usdhc1_rst>;
	cd-gpios = <&gpio2 13 GPIO_ACTIVE_LOW>;
	wp-gpios = <&gpio2 12 GPIO_ACTIVE_HIGH>;
	vmmc-supply = <&reg_vsd_3v3b>;
	/delete-property/non-removable;
	/delete-property/cd-post;
	/delete-property/wifi-host;
	status = "okay";
};
