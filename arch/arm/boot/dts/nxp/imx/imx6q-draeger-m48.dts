// SPDX-License-Identifier: GPL-2.0+
/*
 * (C) Copyright 2020 Draeger and Licensors, info@draeger.com
 *
 * Device Tree file for Draeger M48 Board
 */

/dts-v1/;

#include "imx6q.dtsi"
#include "imx6qdl-draeger-m48.dtsi"

/ {
	model = "Draeger M48 i.MX6 Quad";
	compatible = "draeger,imx6q-m48", "fsl,imx6q";
};
