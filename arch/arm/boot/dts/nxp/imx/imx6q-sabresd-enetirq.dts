// SPDX-License-Identifier: GPL-2.0
//
// Copyright (C) 2014 Freescale Semiconductor, Inc.
// Copyright 2019 NXP

#include "imx6q-sabresd.dts"

&fec {
	pinctrl-0 = <&pinctrl_enet &pinctrl_enet_irq>;
	interrupts-extended = <&gpio1 6 0x4>, <&gpc 0 119 0x4>;
};

&i2c3 {
	status = "disabled";
};
