/*
 * Copyright (C) 2015 Freescale Semiconductor, Inc.
 *
 * This program is free software; you can redistribute it and/or modify
 * it under the terms of the GNU General Public License version 2 as
 * published by the Free Software Foundation.
 */

#include "imx6sl-evk.dts"

&gpc {
	/* use ldo-enable, u-boot will check it and configure */
	fsl,ldo-bypass = <0>;
};

&reg_arm {
	/delete-property/ vin-supply;
};

&reg_pu {
	/delete-property/ vin-supply;
};

&reg_soc {
	/delete-property/ vin-supply;
};
