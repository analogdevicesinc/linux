// SPDX-License-Identifier: (GPL-2.0 OR MIT)
/*
 * Copyright 2016 Freescale Semiconductor, Inc.
 * Copyright 2017-2019 NXP.
 *
 */

/dts-v1/;

#include "imx6sll-evk.dts"

&usdhc2 {
        compatible = "fsl,imx6sll-usdhc", "fsl,imx6sx-usdhc";
};

