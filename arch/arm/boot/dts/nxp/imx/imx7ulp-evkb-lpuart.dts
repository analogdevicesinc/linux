/*
 * Copyright 2019 NXP
 *
 * This program is free software; you can redistribute it and/or modify
 * it under the terms of the GNU General Public License version 2 as
 * published by the Free Software Foundation.
 */

#include "imx7ulp-evkb.dts"

&lpi2c7 {
	status = "disabled";
};

&lpuart7 { /* Uart test */
	status = "okay";
};
