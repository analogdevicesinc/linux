/*
 * Copyright 2018 NXP.
 *
 * This program is free software; you can redistribute it and/or modify
 * it under the terms of the GNU General Public License version 2 as
 * published by the Free Software Foundation.
 */

#include "imx7ulp-evkb-mipi.dts"

&mipi_dsi {
	lcd_panel = "ROCKTECH-QHD-RK055IQH042";
};
