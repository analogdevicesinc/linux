/dts-v1/;
/plugin/;

/ {
	compatible = "brcm,bcm2835";

	fragment@0 {
		target = <&i2c1>;
		__overlay__ {
			#address-cells = <1>;
			#size-cells = <0>;
			status = "okay";

			ad5110@2f {
				compatible = "adi,ad5110";
				reg = <0x2F>;
			};
		};
	};
};
