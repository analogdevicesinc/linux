// SPDX-License-Identifier: GPL-2.0
/*
 * Overlay for the ADM1273 digital power monitor (PMBus)
 */

/dts-v1/;
/plugin/;

/ {
	compatible = "brcm,bcm2835", "brcm,bcm2708", "brcm,bcm2709", "brcm,bcm2711";
};

&i2c1 {
	#address-cells = <1>;
	#size-cells = <0>;
	status = "okay";

	adm1273: adm1273@10 {
		compatible = "adi,adm1273";
		reg = <0x10>;
		shunt-resistor-micro-ohms = <1000>;
		adi,volt-curr-sample-average = <16>;
	};
};
