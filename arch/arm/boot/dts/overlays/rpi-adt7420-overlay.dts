// SPDX-License-Identifier: GPL-2.0
/dts-v1/;
/plugin/;

/ {
	compatible = "brcm,bcm2835", "brcm,bcm2708", "brcm,bcm2709", "brcm,bcm2711";

	__overrides__ {
		i2c_address = <&adt7420>, "reg:0";
	};
};

&i2c1 {
	#address-cells = <1>;
	#size-cells = <0>;
	status = "okay";

	adt7420: adt7420@48 {
		compatible = "adt7420";
		reg = <0x48>;
	};
};
