// SPDX-License-Identifier: GPL-2.0

/dts-v1/;
/plugin/;

/ {
	compatible = "brcm,bcm2708";
};

&i2c_arm {
	status = "okay";

	#address-cells = <1>;
	#size-cells = <0>;

	adc: ad7746@48 {
		compatible = "adi,ad7746";
		reg = <0x48>;
	};
};
