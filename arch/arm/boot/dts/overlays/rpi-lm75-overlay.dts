// SPDX-License-Identifier: GPL-2.0
/dts-v1/;
/plugin/;

/ {
	compatible = "brcm,bcm2835";

	__overrides__ {
		addr = <&lm75>,"reg:0";
	};
};

&i2c1 {
	#address-cells = <1>;
	#size-cells = <0>;
	status = "okay";

	lm75: lm75@4c {
		compatible = "lm75";
		reg = <0x4c>;
		label = "my_lm75";
	};
};
