// SPDX-License-Identifier: GPL-2.0

/dts-v1/;
/plugin/;

#include <dt-bindings/interrupt-controller/irq.h>

/ {
	compatible = "brcm,bcm2835", "brcm,bcm2711";
};

&i2c1 {
	status = "okay";

	#address-cells = <1>;
        #size-cells = <0>;

        rtc@68 {
            compatible = "adi,max31335";
            reg = <0x68>;
	};
};
