// SPDX-License-Identifier: GPL-2.0
/dts-v1/;
/plugin/;

/ {
    compatible = "brcm,bcm2836", "brcm,bcm2835";
    fragment@0 {
        target = <&spidev0>;
        __overlay__ {
        spi-max-frequency = <1000000>;
        };
    };
};
