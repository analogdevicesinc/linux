// SPDX-License-Identifier: (GPL-2.0-only OR BSD-2-Clause)
/*
 * Copyright (c) Qualcomm Technologies, Inc. and/or its subsidiaries.
 */

/dts-v1/;

#include "qcom-kuno.dtsi"

/ {
	model = "Qualcomm Technologies, Inc. Kuno IDP";
	compatible = "qcom,kuno-idp", "qcom,kuno";

	aliases {
		serial0 = &uart3;
	};

	chosen {
		stdout-path = "serial0:115200n8";
	};
};

&uart3 {
	status = "okay";
};
