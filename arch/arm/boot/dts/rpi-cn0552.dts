/dts-v1/;
/plugin/;
/ {
	compatible = "brcm,bcm2708";
	
	fragment@0 {
		target = <&i2c_arm>;
		__overlay__ {
			#address-cells = <1>;
			#size-cells = <0>;
			
			status = "okay";
			
			adc: ad7746@48 {
                compatible = "adi,ad7746";
                reg = <0x48>;
            };
		};
	};
};