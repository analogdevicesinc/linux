// SPDX-License-Identifier: GPL-2.0
/*
 * Hardkernel's Exynos4412 based ODROID-U2 board device tree source
 *
 * Copyright (c) 2026 Josef Schlehofer <pepe.schlehofer@gmail.com>
 *
 * Device tree source file for Hardkernel's ODROID-U2 board which is based
 * on Samsung's Exynos4412 SoC. The board is the predecessor of the
 * ODROID-U3, so only the differences from it are described here.
 */

#include "exynos4412-odroidu3.dts"

/ {
	model = "Hardkernel ODROID-U2 board based on Exynos4412";
	compatible = "hardkernel,odroid-u2", "samsung,exynos4412", "samsung,exynos4";
};

/* No VBUS supply switch on the micro-USB port */
/delete-node/ &vbus_otg_reg;

&hsotg {
	dr_mode = "peripheral";
	/delete-property/ vbus-supply;
};

&sound {
	model = "Odroid-U2";
	audio-routing = "Headphone Jack", "HPL",
			"Headphone Jack", "HPR",
			"DMICL", "DMIC",
			"DMICR", "DMIC",
			"Mixer DAI RX", "HiFi Capture";
	samsung,audio-widgets = "Headphone", "Headphone Jack",
				"Microphone", "DMIC";
};

/* No expansion header with SPI */
&spi_1 {
	status = "disabled";
};
