/dts-v1/;
#include "socfpga_arria10_socdk.dtsi"

#include "adi-adin1300-dual-socfpga.dtsi"

&mmc {
	status = "okay";
	num-slots = <1>;
	cap-sd-highspeed;
	broken-cd;
	bus-width = <4>;
	altr,dw-mshc-ciu-div = <3>;
	altr,dw-mshc-sdr-timing = <0 3>;
};
