// SPDX-License-Identifier: GPL-2.0
/*
 * Analog Devices AD4003
 * https://www.analog.com/en/products/ad4003.html
 *
 * hdl_project: <pulsar_adc/coraz7s>
 * Link: https://github.com/analogdevicesinc/hdl/tree/main/projects/pulsar_adc
 * board_revision: <A>
 *
 * Copyright (C) 2025 Analog Devices Inc.
 */
/dts-v1/;
#include "zynq-coraz7s-pulsar.dtsi"

&pulsar_adc {
	compatible = "adi,ad4003";
	spi-max-frequency = <100000000>;
	adi,sdi-pin = "sdi";
	adi,high-z-input;
};
