// SPDX-License-Identifier: GPL-2.0
/*
 * Analog Devices AD7691
 * https://www.analog.com/en/products/ad7691.html
 *
 * hdl_project: <pulsar_adc/coraz7s>
 * Link: https://github.com/analogdevicesinc/hdl/tree/main/projects/pulsar_adc
 * board_revision: <A>
 *
 * Copyright (C) 2025 Analog Devices Inc.
 */
/dts-v1/;
#include "zynq-coraz7s-pulsar.dtsi"

&pulsar_adc {
	compatible = "adi,ad7691";
};
