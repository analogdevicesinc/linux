// SPDX-License-Identifier: GPL-2.0
/* Copyright (C) 2025 Analog Devices Inc. */

&fpga_axi {
	axi_sysid_0: axi-sysid-0@45000000 {
		compatible = "adi,axi-sysid-1.00.a";
		reg = <0x45000000 0x10000>;
	};
};
