// SPDX-License-Identifier: GPL-2.0
/*
 * Analog Devices AD4032-24
 *
 * hdl_project: <ad4630_fmc/zed>
 * board_revision: <B>
 *
 * Copyright (C) 2026 Analog Devices Inc.
 */
/dts-v1/;
#include "zynq-zed-adv7511-ad4630.dtsi"

&ad4630_adc {
	compatible = "adi,ad4032-24";
};
