// SPDX-License-Identifier: GPL-2.0
/*
 * Analog Devices ADA4356 LiDAR application
 *
 * hdl_project: <ada4355_fmc/zed>
 * board_revision: <>
 *
 * Copyright (C) 2025 Analog Devices Inc.
 */

#include "zynq-zed-adv7511-ada4356.dts"

&fpga_axi {
	/* TDD Controller for LiDAR timing control */
	axi_tdd: axi-tdd@44a40000 {
		compatible = "adi,axi-tdd";
		reg = <0x44a40000 0x10000>;
		clocks = <&clkc 15>, <&ada4355_fixed_clock>;
		clock-names = "s_axi_aclk", "intf_clk";
	};

	/* IIO wrapper for TDD - makes sysfs attributes accessible via libiio */
	iio_axi_tdd_0: iio-axi-tdd-0@0 {
		compatible = "adi,iio-fake-platform-device";
		adi,faked-dev = <&axi_tdd>;
		adi,attribute-names =
			"version", "core_id", "scratch", "magic",
			"sync_soft", "sync_external", "sync_internal", "sync_reset",
			"enable", "startup_delay_raw", "startup_delay_ms",
			"burst_count", "frame_length_raw", "frame_length_ms",
			"state", "internal_sync_period_raw", "internal_sync_period_ms",
			"out_channel0_enable", "out_channel0_polarity",
			"out_channel0_on_raw", "out_channel0_on_ms",
			"out_channel0_off_raw", "out_channel0_off_ms",
			"out_channel1_enable", "out_channel1_polarity",
			"out_channel1_on_raw", "out_channel1_on_ms",
			"out_channel1_off_raw", "out_channel1_off_ms";
		label = "iio-axi-tdd-0";
	};
};
