// SPDX-License-Identifier: GPL-2.0
/*
 * Analog Devices ADAQ23878 (LTC2387-18 inside, 18-bit, one-lane mode).
 *
 * Pair with the matching one-lane HDL bitstream (TWOLANES=0, ADC_RES=18).
 *
 * hdl_project: <adaq2387x/zed with ADC_RES=18, TWOLANES=0>
 * board_revision: <A>
 *
 * Copyright (C) 2026 Analog Devices Inc.
 */
/dts-v1/;

#include "zynq-zed-adv7511-adaq23878.dtsi"

&adaq23878 {
	adi,use-one-lane;
};
