// SPDX-License-Identifier: GPL-2.0
/*
 * Analog Devices ADAQ23878 (LTC2387-18 inside, 18-bit, two-lane mode).
 *
 * hdl_project: <adaq2387x/zed with ADC_RES=18, TWOLANES=1>
 * board_revision: <A>
 *
 * Copyright (C) 2026 Analog Devices Inc.
 */
/dts-v1/;

#include "zynq-zed-adv7511-adaq23878.dtsi"
