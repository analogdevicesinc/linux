// SPDX-License-Identifier: GPL-2.0
/*
 * Analog Devices ADV7511
 * https://www.analog.com/en/products/adv7511.html
 * https://wiki.analog.com/resources/tools-software/linux-drivers/platforms/zynq
 * https://wiki.analog.com/resources/fpga/xilinx/kc705/adv7511
 *
 * hdl_project: <adv7511/zed>
 * board_revision: <>
 *
 * Copyright (C) 2012-2019 Analog Devices Inc.
 */
/dts-v1/;

#include "zynq-zed.dtsi"
#include "zynq-zed-adv7511.dtsi"

&eeprom1 {
	status = "disabled";
};

/{
	one-bit-adc-dac@0 {
			compatible = "adi,one-bit-adc-dac";

			#address-cells = <1>;
			#size-cells = <0>;

			out-gpios = <&gpio0 86 GPIO_ACTIVE_LOW>;

			channel@0 {
				reg = <0>;
				label = "QSPI_RST_N";
			};
		};
};
