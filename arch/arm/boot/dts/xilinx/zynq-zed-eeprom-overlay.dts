/dts-v1/;
/plugin/;

/ {
	fragment@0 {
		target-path = "/fpga-axi";
		__overlay__ {
			#address-cells = <1>;
			#size-cells = <1>;
			i2c@41620000 {
				compatible = "xlnx,axi-iic-1.01.b", "xlnx,xps-iic-2.00.a";
				reg = <0x41620000 0x10000>;
				interrupt-parent = <&intc>;
				interrupts = <0x00 0x37 0x04>;
				clocks = <&clkc 15>;
				clock-names = "pclk";
				#size-cells = <0x00>;
				#address-cells = <0x01>;

				eeprom1: eeprom@50 {
					compatible = "at24,24c02";
					reg = <0x50>;
				};
			};
		};
	};
};