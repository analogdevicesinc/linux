// SPDX-License-Identifier: GPL-2.0
/*
 * Analog Devices ADALM2000
 * https://wiki.analog.com/university/tools/m2k
 * https://wiki.analog.com/university/courses/electronics/labs
 * https://wiki.analog.com/university/tools/adalm2000/devs/intro
 * https://wiki.analog.com/university/tools/m2k/users/quick_start
 *
 * hdl_project: <m2k/standalone>
 * board_revision: <D>
 *
 * Copyright (C) 2018-2019 Analog Devices Inc.
 */
/*
 * 	Summary of RevC -> RevD hardware changes which require firmware changes:
 *	Nothing: Update model string to be in sync with the PCB silkscreen
 */

#include "zynq-m2k-revc.dts"

/ {
	model = "Analog Devices M2k Rev.D (Z7010)";
};
