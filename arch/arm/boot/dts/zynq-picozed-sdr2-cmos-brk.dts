#include  "zynq-picozed-sdr2-brk.dts"

&adc0_ad9361 {
	/* Enable CMOS Mode */
	adi,swap-ports-enable;
	/delete-property/ adi,lvds-mode-enable;
	/delete-property/ adi,lvds-rx-onchip-termination-enable;
	adi,full-port-enable;
	adi,digital-interface-tune-fir-disable;
};
