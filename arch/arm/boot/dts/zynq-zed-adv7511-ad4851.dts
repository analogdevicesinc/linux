// SPDX-License-Identifier: GPL-2.0
/dts-v1/;


#include "zynq-zed-adv7511-ad485x.dtsi"

&dma_channel {
	adi,source-bus-width = <64>;
};

&ad485x {
	compatible = "adi,ad4851";
};


&spi1 {
	status = "okay";

	ad5292: ad5292@0{
		compatible = "adi,ad5292";
		reg = <0>;
		spi-max-frequency = <5000000>;
	};
};
