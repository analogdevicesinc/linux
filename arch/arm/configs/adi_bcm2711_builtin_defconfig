## arch/microblaze/configs/kc705_xcomm_defconfig
```kconfig
CONFIG_SYSVIPC=y
CONFIG_POSIX_MQUEUE=y
CONFIG_HIGH_RES_TIMERS=y
CONFIG_BSD_PROCESS_ACCT=y
CONFIG_BSD_PROCESS_ACCT_V3=y
CONFIG_IKCONFIG=y
CONFIG_IKCONFIG_PROC=y
CONFIG_LOG_BUF_SHIFT=14
CONFIG_SYSFS_DEPRECATED=y
CONFIG_SYSFS_DEPRECATED_V2=y
CONFIG_BLK_DEV_INITRD=y
CONFIG_INITRAMFS_SOURCE="rootfs.cpio.gz"
CONFIG_CC_OPTIMIZE_FOR_SIZE=y
CONFIG_SYSCTL_SYSCALL=y
CONFIG_EMBEDDED=y
CONFIG_SLAB=y
CONFIG_MODULES=y
CONFIG_MODULE_UNLOAD=y
# CONFIG_BLOCK is not set
CONFIG_KERNEL_BASE_ADDR=0xc0000000
CONFIG_XILINX_MICROBLAZE0_FAMILY="virtex6"
CONFIG_XILINX_MICROBLAZE0_USE_MSR_INSTR=1
CONFIG_XILINX_MICROBLAZE0_USE_PCMP_INSTR=1
CONFIG_XILINX_MICROBLAZE0_USE_BARREL=1
CONFIG_XILINX_MICROBLAZE0_USE_DIV=1
CONFIG_XILINX_MICROBLAZE0_USE_HW_MUL=2
CONFIG_XILINX_MICROBLAZE0_HW_VER="8.20.a"
CONFIG_MMU=y
CONFIG_CMDLINE_BOOL=y
CONFIG_CMDLINE="console=ttyUL0,57600 root=/dev/ram"
CONFIG_CMDLINE_FORCE=y
# CONFIG_SECCOMP is not set
CONFIG_ADVANCED_OPTIONS=y
CONFIG_LOWMEM_SIZE_BOOL=y
CONFIG_KERNEL_START_BOOL=y
CONFIG_TASK_SIZE_BOOL=y
# CONFIG_COMPACTION is not set
# CONFIG_CORE_DUMP_DEFAULT_ELF_HEADERS is not set
CONFIG_BINFMT_MISC=y
CONFIG_NET=y
CONFIG_PACKET=y
CONFIG_UNIX=y
CONFIG_INET=y
# CONFIG_IPV6 is not set
CONFIG_MTD=y
CONFIG_MTD_CMDLINE_PARTS=y
CONFIG_MTD_CFI=y
CONFIG_MTD_JEDECPROBE=y
CONFIG_MTD_CFI_ADV_OPTIONS=y
CONFIG_MTD_CFI_INTELEXT=y
CONFIG_MTD_CFI_AMDSTD=y
CONFIG_MTD_CFI_STAA=y
CONFIG_MTD_RAM=y
CONFIG_MTD_COMPLEX_MAPPINGS=y
CONFIG_MTD_PHYSMAP=y
CONFIG_MTD_PHYSMAP_OF=y
CONFIG_MTD_M25P80=y
CONFIG_PROC_DEVICETREE=y
CONFIG_AD525X_DPOT=y
CONFIG_AD525X_DPOT_I2C=y
CONFIG_AD525X_DPOT_SPI=y
CONFIG_XLNX_LCD=y
CONFIG_EEPROM_AT24=y
CONFIG_NETDEVICES=y
CONFIG_XILINX_EMACLITE=y
# CONFIG_INPUT is not set
# CONFIG_SERIO is not set
# CONFIG_VT is not set
CONFIG_SERIAL_8250=y
CONFIG_SERIAL_8250_CONSOLE=y
CONFIG_SERIAL_UARTLITE=y
CONFIG_SERIAL_UARTLITE_CONSOLE=y
CONFIG_SERIAL_OF_PLATFORM=y
# CONFIG_HW_RANDOM is not set
CONFIG_I2C=y
CONFIG_I2C_CHARDEV=y
CONFIG_I2C_MUX=y
CONFIG_I2C_MUX_PCA954x=y
# CONFIG_I2C_HELPER_AUTO is not set
CONFIG_I2C_XILINX=y
CONFIG_SPI=y
CONFIG_SPI_XCOMM=y
CONFIG_SPI_AD9250FMC=y
CONFIG_SPI_XILINX=y
CONFIG_SPI_SPIDEV=y
CONFIG_GPIOLIB=y
CONFIG_GPIO_SYSFS=y
CONFIG_GPIO_XILINX=y
# CONFIG_HWMON is not set
# CONFIG_USB_SUPPORT is not set
CONFIG_DMADEVICES=y
CONFIG_XILINX_DMA=y
CONFIG_DMA_AXI_DMAC=y
CONFIG_STAGING=y
CONFIG_COMMON_CLK_DEBUG=y
CONFIG_IIO=y
CONFIG_IIO_KFIFO_BUF=y
CONFIG_CF_AXI_ADC=y
CONFIG_CF_AXI_FFT=y
CONFIG_AD8366=y
CONFIG_AD9523=y
CONFIG_AD9548=y
CONFIG_AD9517=y
CONFIG_CF_AXI_DDS=y
CONFIG_CF_AXI_DDS_SO=y
CONFIG_CF_AXI_DDS_AD9122=y
CONFIG_ADF4350=y
# CONFIG_DNOTIFY is not set
CONFIG_TMPFS=y
CONFIG_JFFS2_FS=y
CONFIG_JFFS2_SUMMARY=y
CONFIG_NFS_FS=y
# CONFIG_FTRACE is not set
CONFIG_EARLY_PRINTK=y
CONFIG_KEYS=y
CONFIG_KEYS_DEBUG_PROC_KEYS=y
# CONFIG_CRYPTO_ANSI_CPRNG is not set
```

## arch/x86/configs/adi_ci_defconfig
```kconfig
# CONFIG_LOCALVERSION_AUTO is not set
# CONFIG_CROSS_MEMORY_ATTACH is not set
# CONFIG_PREEMPT_DYNAMIC is not set
# CONFIG_UTS_NS is not set
# CONFIG_TIME_NS is not set
# CONFIG_PID_NS is not set
# CONFIG_INITRAMFS_PRESERVE_MTIME is not set
# CONFIG_64BIT is not set
# CONFIG_X86_EXTENDED_PLATFORM is not set
# CONFIG_SCHED_OMIT_FRAME_POINTER is not set
# CONFIG_X86_MCE is not set
# CONFIG_PERF_EVENTS_AMD_UNCORE is not set
# CONFIG_X86_IOPL_IOPERM is not set
# CONFIG_MTRR_SANITIZER is not set
# CONFIG_RELOCATABLE is not set
# CONFIG_SPECULATION_MITIGATIONS is not set
# CONFIG_SUSPEND is not set
# CONFIG_ACPI is not set
# CONFIG_VIRTUALIZATION is not set
# CONFIG_SECCOMP is not set
# CONFIG_STACKPROTECTOR is not set
# CONFIG_COMPAT_32BIT_TIME is not set
CONFIG_MODULES=y
CONFIG_MODULE_DEBUG=y
CONFIG_MODULE_STATS=y
CONFIG_MODULE_FORCE_LOAD=y
CONFIG_MODULE_UNLOAD=y
CONFIG_MODULE_FORCE_UNLOAD=y
CONFIG_MODULE_UNLOAD_TAINT_TRACKING=y
# CONFIG_BLOCK_LEGACY_AUTOLOAD is not set
# CONFIG_MQ_IOSCHED_DEADLINE is not set
# CONFIG_MQ_IOSCHED_KYBER is not set
# CONFIG_BINFMT_ELF is not set
# CONFIG_BINFMT_SCRIPT is not set
# CONFIG_SWAP is not set
# CONFIG_SLAB_MERGE_DEFAULT is not set
# CONFIG_COMPAT_BRK is not set
# CONFIG_COMPACTION is not set
# CONFIG_BOUNCE is not set
# CONFIG_STANDALONE is not set
# CONFIG_PREVENT_FIRMWARE_BUILD is not set
CONFIG_DEBUG_DRIVER=y
CONFIG_CONNECTOR=y
# CONFIG_DMIID is not set
CONFIG_OF=y
CONFIG_OF_UNITTEST=y
CONFIG_OF_OVERLAY=y
CONFIG_OF_CONFIGFS=y
# CONFIG_BLK_DEV is not set
# CONFIG_INPUT_KEYBOARD is not set
# CONFIG_INPUT_MOUSE is not set
# CONFIG_SERIO is not set
CONFIG_EEPROM_AT24=y
# CONFIG_LEGACY_PTYS is not set
# CONFIG_LEGACY_TIOCSTI is not set
# CONFIG_LDISC_AUTOLOAD is not set
# CONFIG_HW_RANDOM is not set
# CONFIG_DEVMEM is not set
# CONFIG_DEVPORT is not set
CONFIG_I2C=y
CONFIG_I2C_XILINX=y
CONFIG_I3C=y
CONFIG_SPI=y
CONFIG_SPI_AXI_SPI_ENGINE=y
CONFIG_GPIOLIB=y
CONFIG_POWER_SUPPLY=y
CONFIG_HWMON=y
CONFIG_REGULATOR=y
# CONFIG_HID_SUPPORT is not set
# CONFIG_USB_SUPPORT is not set
# CONFIG_VIRTIO_MENU is not set
# CONFIG_VHOST_MENU is not set
# CONFIG_SURFACE_PLATFORMS is not set
# CONFIG_X86_PLATFORM_DEVICES is not set
CONFIG_COMMON_CLK=y
CONFIG_COMMON_CLK_AXI_CLKGEN=y
# CONFIG_IOMMU_SUPPORT is not set
CONFIG_MEMORY=y
CONFIG_IIO=y
CONFIG_IIO_BUFFER=y
CONFIG_IIO_BUFFER_CB=y
CONFIG_IIO_BUFFER_DMAENGINE=y
CONFIG_IIO_BUFFER_HW_CONSUMER=y
CONFIG_IIO_TRIGGERED_BUFFER=y
CONFIG_IIO_SW_DEVICE=y
CONFIG_IIO_SW_TRIGGER=y
CONFIG_IIO_TRIGGERED_EVENT=y
CONFIG_PWM=y
# CONFIG_DNOTIFY is not set
# CONFIG_INOTIFY_USER is not set
# CONFIG_MISC_FILESYSTEMS is not set
# CONFIG_SYMBOLIC_ERRNAME is not set
CONFIG_DEBUG_KERNEL=y
# CONFIG_SECTION_MISMATCH_WARN_ONLY is not set
CONFIG_DEBUG_FS=y
# CONFIG_FTRACE is not set
# CONFIG_X86_VERBOSE_BOOTUP is not set
# CONFIG_RUNTIME_TESTING_MENU is not set
```

## drivers/a2b/Kconfig
```kconfig
menuconfig A2B
	tristate "A2B support"
	depends on I2C
	select MFD_CORE
	select REGMAP

if A2B

config AD2428
	tristate "AD2428 (and similar) support"

endif
```

## drivers/atm/Kconfig
```kconfig
# SPDX-License-Identifier: GPL-2.0
#
# ATM device configuration
#

menuconfig ATM_DRIVERS
	bool "ATM drivers"
	depends on NETDEVICES && ATM
	default y
	help
	  Say Y here to get to see options for Asynchronous Transfer Mode
	  device drivers. This option alone does not add any kernel code.

	  If you say N, all options in this submenu will be skipped and disabled.

if ATM_DRIVERS && NETDEVICES && ATM

config ATM_SOLOS
	tristate "Solos ADSL2+ PCI Multiport card driver"
	depends on PCI
	select FW_LOADER
	help
	  Support for the Solos multiport ADSL2+ card.

endif # ATM
```

## drivers/bus/axi4/Kconfig
```kconfig
#
# axilite driver configuration
#

menuconfig AXI4
	bool "AXI4 Driver Support"
	depends on ARM_AMBA && USE_OF
	default y
	---help---
	  This section contains all the AXI4 Drivers

if AXI4

config MWIPCORE
	tristate "Mathwork IP Core Driver"
	depends on ARM_AMBA && USE_OF
	default m
	help
		Say Y here if you want to add support for the MathWorks IP
		core driver

		If unsure, say N.

		To compile this driver as a module, choose M here:
		the module will be called mwipcore
endif
```

## drivers/clk/Kconfig.adi
```kconfig
# This file exists solely to be include in Kconfig.adi

config CLK_ALL_ADI_DRIVERS
	tristate "Build all Analog Devices CLOCK Drivers"
	imply COMMON_CLK_AD9545
	imply COMMON_CLK_AD9545_I2C
	imply COMMON_CLK_AD9545_SPI
```

## drivers/clk/adi/Kconfig
```kconfig
#
# Analog Devices Clock Drivers
#
# When adding new entries keep the list in alphabetical order

menu "Analog Devices Clock Drivers"

config COMMON_CLK_AD9545
	tristate

config COMMON_CLK_AD9545_I2C
	tristate "Analog Devices AD9545 via I2C"
	depends on REGMAP_I2C
	select COMMON_CLK_AD9545
	help
	  Say yes here to build support for Analog Devices AD9545
	  Quad Input, 10-Output, Dual DPLL/IEEE 1588,
	  1 pps Synchronizer and Jitter Cleaner via I2C

config COMMON_CLK_AD9545_SPI
	tristate "Analog Devices AD9545 via SPI"
	depends on REGMAP_SPI
	select COMMON_CLK_AD9545
	help
	  Say yes here to build support for Analog Devices AD9545
	  Quad Input, 10-Output, Dual DPLL/IEEE 1588,
	  1 pps Synchronizer and Jitter Cleaner via SPI

config COMMON_CLK_LTC6948
	tristate "Analog Devices LTC6948/LTC6947 Fractional-N Synthesizer with Integrated VCO"
	depends on SPI
	depends on COMMON_CLK
	help
	  Say yes here to build support for Analog Devices LTC6948/LTC6947
	  Fractional-N Synthesizer with Integrated VCO.
	  The driver provides direct access via sysfs.

	  To compile this driver as a module, choose M here: the
	  module will be called ltc6948.

endmenu
```
