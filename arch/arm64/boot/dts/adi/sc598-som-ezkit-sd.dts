// SPDX-License-Identifier: GPL-2.0
/*
 * Copyright (c) 2026 Analog Devices Incorporated
 */

/dts-v1/;

#include "sc598-som-ezkit.dtsi"

&mmc0 {
	pinctrl-0 = <&mmc0_8bgrp>, <&mmc_carrier_grp>;
	max-frequency = <44000000>;
	no-1-8-v;
	bus-width = <4>;

	status = "okay";
};
