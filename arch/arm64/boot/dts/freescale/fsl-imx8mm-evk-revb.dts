/*
 * Copyright 2018 NXP
 *
 * This program is free software; you can redistribute it and/or
 * modify it under the terms of the GNU General Public License
 * as published by the Free Software Foundation; either version 2
 * of the License, or (at your option) any later version.
 *
 * This program is distributed in the hope that it will be useful,
 * but WITHOUT ANY WARRANTY; without even the implied warranty of
 * MERCHANTABILITY or FITNESS FOR A PARTICULAR PURPOSE.  See the
 * GNU General Public License for more details.
 */

/dts-v1/;

#include "fsl-imx8mm-evk.dts"

/ {
	model = "FSL i.MX8MM EVK RevB board";
};

/*
 * External OSC is used as PCIe REFCLK on RevC board.
 * Use the -revb.dts file to distiguish the different
 * HW design.
 */
&pcie0{
	ext_osc = <0>;
	status = "okay";
};

