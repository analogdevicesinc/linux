#include "fsl-imx8mm-evk.dts"

&adv_bridge {
	status = "disabled";
};

&mipi_dsi {
	panel@0 {
		compatible = "raydium,rm67191";
		reg = <0>;
		pinctrl-0 = <&pinctrl_mipi_dsi_en>;
		reset-gpio = <&gpio1 8 GPIO_ACTIVE_HIGH>;
		dsi-lanes = <4>;
		video-mode = <2>;	/* 0: burst mode
					 * 1: non-burst mode with sync event
					 * 2: non-burst mode with sync pulse
					 */
		panel-width-mm = <68>;
		panel-height-mm = <121>;
		status = "okay";
	};
};
