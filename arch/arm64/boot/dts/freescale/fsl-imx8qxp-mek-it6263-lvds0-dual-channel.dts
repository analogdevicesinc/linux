/*
 * Copyright 2018 NXP
 *
 * This program is free software; you can redistribute it and/or
 * modify it under the terms of the GNU General Public License
 * as published by the Free Software Foundation; either version 2
 * of the License, or (at your option) any later version.
 *
 * This program is distributed in the hope that it will be useful,
 * but WITHOUT ANY WARRANTY; without even the implied warranty of
 * MERCHANTABILITY or FITNESS FOR A PARTICULAR PURPOSE.  See the
 * GNU General Public License for more details.
 */

#include "fsl-imx8qxp-mek.dts"

&i2c0_mipi_lvds0 {
	lvds-to-hdmi-bridge@4c {
		split-mode;
	};
};

&ldb1 {
	fsl,dual-channel;
	power-domains = <&pd_mipi_dsi_0_dual_lvds>;
};

&ldb2 {
	status = "disabled";
};
