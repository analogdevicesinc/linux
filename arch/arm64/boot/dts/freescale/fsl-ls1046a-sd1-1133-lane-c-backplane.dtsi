// SPDX-License-Identifier: (GPL-2.0+ OR MIT)
/*
 * Copyright 2023 NXP
 */

&mac10 { /* DTSEC10/10GEC2 */
	phy-connection-type = "10gbase-kr";
	pcsphy-handle = <&pcsphy7>;
	pcs-handle-names = "c73";
	managed = "c73";
	phys = <&serdes1 2>;
	phy-names = "serdes";
};
