// SPDX-License-Identifier: (GPL-2.0+ OR MIT)
/*
 * Copyright 2024 NXP
 */

&dpmac16 {
	phys = <&serdes_2 5>; /* lane F */
	phy-names = "serdes";
	managed = "c73";
};

&pcs_mdio16 {
	status = "okay";
};
