// SPDX-License-Identifier: GPL-2.0+
/*
 * Copyright 2019 NXP
 */

/dts-v1/;

#include "imx8dx.dtsi"
#include "imx8x-17x17-val.dtsi"

/ {
    model = "Freescale i.MX8DX 17x17 Validation Board";
    compatible = "fsl,imx8dx-17x17-val", "fsl,imx8dx", "fsl,imx8qxp";
};

