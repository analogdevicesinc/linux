// SPDX-License-Identifier: GPL-2.0+
/*
 * Copyright 2019 NXP
 */

/dts-v1/;

#include "imx8mm-ddr4-evk.dts"

/ {
	model = "FSL i.MX8MM DDR4 EVK RevB board";
};

/*
 * External OSC is used as PCIe REFCLK on RevC board.
 * Use the -revb.dts file to distiguish the different
 * HW design.
 */
&pcie0{
	ext_osc = <0>;
	status = "okay";
};
