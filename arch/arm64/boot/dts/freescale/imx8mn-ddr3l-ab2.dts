// SPDX-License-Identifier: (GPL-2.0+ OR MIT)
 /*
  * Copyright 2021 NXP
  */

#include "imx8mn-ab2.dts"

/ {
	model = "NXP i.MX8MNano DDR3L Audio board 2.0";
};

&A53_0 {
	cpu-supply = <&buck1>;
};

&{/thermal-zones/cpu-thermal/cooling-maps/map0} {
	cooling-device =
					<&A53_0 THERMAL_NO_LIMIT THERMAL_NO_LIMIT>,
					<&A53_1 THERMAL_NO_LIMIT THERMAL_NO_LIMIT>,
					<&A53_2 THERMAL_NO_LIMIT THERMAL_NO_LIMIT>,
					<&A53_3 THERMAL_NO_LIMIT THERMAL_NO_LIMIT>;
};
/delete-node/ &{/display-subsystem};
/delete-node/ &gpu;
/delete-node/ &lcdif;
/delete-node/ &mipi_dsi;
