// SPDX-License-Identifier: GPL-2.0
//
// Copyright 2020 NXP

#include "imx8mp-evk.dts"

/delete-node/&spidev1;

&ecspi2 {
	#address-cells = <0>;
	/delete-property/cs-gpios;
	spi-slave;
};

&pinctrl_ecspi2_cs {
	fsl,pins = <
		MX8MP_IOMUXC_ECSPI2_SS0__ECSPI2_SS0		0x82
	>;
};
