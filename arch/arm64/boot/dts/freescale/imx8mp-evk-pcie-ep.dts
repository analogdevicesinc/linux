// SPDX-License-Identifier: GPL-2.0+
/*
 * Copyright 2020 NXP
 */

/dts-v1/;

#include "imx8mp-evk.dts"

&pcie {
	status = "disabled";
};

&pcie_ep {
	pinctrl-names = "default";
	pinctrl-0 = <&pinctrl_pcie0>;
	status = "okay";
};
