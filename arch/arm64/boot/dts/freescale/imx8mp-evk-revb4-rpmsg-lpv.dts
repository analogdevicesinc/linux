// SPDX-License-Identifier: (GPL-2.0+ OR MIT)
/*
 * Copyright 2023 NXP
 */

/dts-v1/;

#include "imx8mp-evk-revb4-rpmsg.dts"

&rpmsg_audio {
	/delete-property/ fsl,enable-lpa;
	/delete-property/ fsl,rpmsg-in;
};
