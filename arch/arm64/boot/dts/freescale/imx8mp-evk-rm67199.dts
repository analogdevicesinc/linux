// SPDX-License-Identifier: GPL-2.0+
/*
 * Copyright 2021 NXP
 */

#include "imx8mp-evk-rm67191.dts"

/delete-node/ &synaptics_dsx_ts;

&mipi_dsi {
	panel@0 {
		compatible = "raydium,rm67199";
	};
};
