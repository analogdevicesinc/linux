// SPDX-License-Identifier: GPL-2.0
/*
 * Copyright 2020 NXP.
 */

#include "imx8mq-evk-lcdif-rm67191.dts"

/delete-node/ &synaptics_dsx_ts;

&mipi_dsi {
	panel@0 {
		compatible = "raydium,rm67199";
	};
};
