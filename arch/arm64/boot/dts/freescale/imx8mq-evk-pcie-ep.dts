// SPDX-License-Identifier: GPL-2.0+
/*
 * Copyright 2020 NXP
 */

/dts-v1/;

#include "imx8mq-evk.dts"

&pcie0 {
	status = "disabled";
};

&pcie1 {
	status = "disabled";
};

&pcie1_ep {
	pinctrl-names = "default";
	pinctrl-0 = <&pinctrl_pcie1>;
	clocks = <&clk IMX8MQ_CLK_PCIE2_ROOT>,
		 <&pcie0_refclk>,
		 <&clk IMX8MQ_CLK_PCIE2_PHY>,
		 <&clk IMX8MQ_CLK_PCIE2_AUX>;
	status = "okay";
};
