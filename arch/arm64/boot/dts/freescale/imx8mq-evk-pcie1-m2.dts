/*
 * Copyright 2017-2019 NXP
 *
 * This program is free software; you can redistribute it and/or
 * modify it under the terms of the GNU General Public License
 * as published by the Free Software Foundation; either version 2
 * of the License, or (at your option) any later version.
 *
 * This program is distributed in the hope that it will be useful,
 * but WITHOUT ANY WARRANTY; without even the implied warranty of
 * MERCHANTABILITY or FITNESS FOR A PARTICULAR PURPOSE.  See the
 * GNU General Public License for more details.
 */

#include "imx8mq-evk.dts"

&pcie0{
	status = "disabled";
};

&gpio3 {
	/* enable the M.2 BT */
	bt-reg-on-hog {
		/delete-property/ output-high;
		output-low;
	};
};

&gpio5 {
	/delete-node/ wl-reg-on-hog; /* disable the on-board wifi */
};
