// SPDX-License-Identifier: GPL-2.0+
/*
 * Copyright 2018~2019 NXP
 */

#include "imx8qm-lpddr4-val-lpspi.dts"

/delete-node/&spidev0;

&pinctrl_lpspi3 {
	fsl,pins = <
		IMX8QM_SPI3_SCK_DMA_SPI3_SCK		0x6000040
		IMX8QM_SPI3_SDO_DMA_SPI3_SDO		0x6000040
		IMX8QM_SPI3_SDI_DMA_SPI3_SDI		0x6000040
		IMX8QM_SPI3_CS0_DMA_SPI3_CS0		0x6000040
	>;
};

&lpspi3 {
	#address-cells = <0>;
	pinctrl-0 = <&pinctrl_lpspi3>;
	/delete-property/ cs-gpios;
	spi-slave;
};
