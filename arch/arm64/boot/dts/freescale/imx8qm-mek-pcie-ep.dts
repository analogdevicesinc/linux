// SPDX-License-Identifier: GPL-2.0+
/*
 * Copyright 2020 NXP
 */

/dts-v1/;

#include "imx8qm-mek-rpmsg.dts"

&pciea{
	status = "disabled";
};

&pcieb{
	status = "disabled";
};

&pciea_ep{
	pinctrl-names = "default";
	pinctrl-0 = <&pinctrl_pciea>;
	vpcie-supply = <&reg_pciea>;
	phys = <&hsio_phy 0 PHY_TYPE_PCIE 0>;
	phy-names = "pcie-phy";
	status = "okay";
};
