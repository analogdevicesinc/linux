// SPDX-License-Identifier: (GPL-2.0+ OR MIT)
/*
 * Copyright 2022 NXP
 */

#include "imx8ulp-9x9-evk-lpspi.dts"

/delete-node/&spidev0;

&pinctrl_lpspi5 {
	fsl,pins = <
		MX8ULP_PAD_PTF16__LPSPI5_SIN	0x3
		MX8ULP_PAD_PTF17__LPSPI5_SOUT	0x3
		MX8ULP_PAD_PTF18__LPSPI5_SCK	0x3
		MX8ULP_PAD_PTF19__LPSPI5_PCS0	0x3
	>;
};

&lpspi5 {
	#address-cells = <0>;
	pinctrl-0 = <&pinctrl_lpspi5>;
	pinctrl-1 = <&pinctrl_lpspi5>;
	/delete-property/ cs-gpios;

	spi-slave;
};
