// SPDX-License-Identifier: (GPL-2.0+ OR MIT)
/*
 * Copyright 2025 NXP
 *
 * Default reserved memory and EdgeLock Enclave (ELE) enablement shared by
 * i.MX8ULP boards. Include this from a board dts to bring up the secure
 * enclave without having to duplicate the reserved-memory node. The ELE
 * hardware can only access DDR in the 0x80000000 - 0xafffffff window, so the
 * pool is constrained to that range with alloc-ranges and the kernel is left
 * to place the 1 MiB region.
 */

/ {
	reserved-memory {
		#address-cells = <2>;
		#size-cells = <2>;
		ranges;

		ele_reserved: ele-reserved {
			compatible = "shared-dma-pool";
			alloc-ranges = <0 0x80000000 0 0x30000000>;
			size = <0 0x100000>;
			no-map;
		};
	};
};

&hsm0 {
	memory-region = <&ele_reserved>;
	status = "okay";
};
