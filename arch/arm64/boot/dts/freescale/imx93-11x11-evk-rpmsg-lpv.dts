// SPDX-License-Identifier: (GPL-2.0+ OR MIT)
/*
 * Copyright 2023 NXP
 */

/dts-v1/;

#include "imx93-11x11-evk-rpmsg.dts"

&rpmsg_audio {
	/delete-property/ fsl,enable-lpa;
	/delete-property/ fsl,rpmsg-in;
};
