// SPDX-License-Identifier: (GPL-2.0+ OR MIT)
/*
 * Copyright 2024 NXP
 */

/dts-v1/;
/plugin/;

#include <dt-bindings/clock/fsl,imx95-clock.h>
#include <dt-bindings/gpio/gpio.h>

&pcal6524 {
	mipi-csi-minisas-sel-hog {
		status = "disabled";
	};

	mipi-csi-rpi-sel-hog {
		gpio-hog;
		gpios = <16 GPIO_ACTIVE_HIGH>;
		output-high;
		status = "okay";
	};
};
