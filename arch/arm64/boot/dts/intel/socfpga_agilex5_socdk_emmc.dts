// SPDX-License-Identifier:     GPL-2.0
/*
 * Copyright (C) 2024, Intel Corporation
 */
#include "socfpga_agilex5_socdk_nand.dts"

/ {
	model = "SoCFPGA Agilex5 SoCDK eMMC";
	compatible = "intel,socfpga-agilex5-socdk", "intel,socfpga-agilex";
};

&mmc {
	status = "okay";
	bus-width = <8>;
	no-1-8-v;
	cap-sd-highspeed;
	cap-mmc-highspeed;
	disable-wp;
	sd-uhs-sdr50;
	sdhci-caps = <0x00000000 0x0000c800>;
	sdhci-caps-mask = <0x00002000 0x0000ff00>;
	no-sdio;
	cdns,phy-use-ext-lpbk-dqs = <1>;
	cdns,phy-use-lpbk-dqs = <1>;
	cdns,phy-use-phony-dqs = <1>;
	cdns,phy-use-phony-dqs-cmd = <1>;
	cdns,phy-io-mask-always-on = <0>;
	cdns,phy-io-mask-end = <5>;
	cdns,phy-io-mask-start = <0>;
	cdns,phy-data-select-oe-end = <1>;
	cdns,phy-sync-method = <1>;
	cdns,phy-sw-half-cycle-shift = <0>;
	cdns,phy-rd-del-sel = <52>;
	cdns,phy-underrun-suppress = <1>;
	cdns,phy-gate-cfg-always-on = <1>;
	cdns,phy-param-dll-bypass-mode = <1>;
	cdns,phy-param-phase-detect-sel = <2>;
	cdns,phy-param-dll-start-point = <254>;
	cdns,phy-read-dqs-cmd-delay = <0>;
	cdns,phy-clk-wrdqs-delay = <0>;
	cdns,phy-clk-wr-delay = <0>;
	cdns,phy-read-dqs-delay = <0>;
	cdns,phy-phony-dqs-timing = <0>;
	cdns,hrs09-rddata-en = <1>;
	cdns,hrs09-rdcmd-en = <1>;
	cdns,hrs09-extended-wr-mode = <1>;
	cdns,hrs09-extended-rd-mode = <1>;
	cdns,hrs10-hcsdclkadj = <3>;
	cdns,hrs16-wrdata1-sdclk-dly = <0>;
	cdns,hrs16-wrdata0-sdclk-dly = <0>;
	cdns,hrs16-wrcmd1-sdclk-dly = <0>;
	cdns,hrs16-wrcmd0-sdclk-dly = <0>;
	cdns,hrs16-wrdata1-dly = <0>;
	cdns,hrs16-wrdata0-dly = <0>;
	cdns,hrs16-wrcmd1-dly = <0>;
	cdns,hrs16-wrcmd0-dly = <0>;
	cdns,hrs07-rw-compensate = <10>;
	cdns,hrs07-idelay-val = <0>;
};

&nand {
	status = "disabled";
};
