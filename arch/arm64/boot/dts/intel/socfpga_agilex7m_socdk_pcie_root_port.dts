// SPDX-License-Identifier:     GPL-2.0
/*
 * Copyright (C) 2024, Intel Corporation
 */

#include "socfpga_agilex7m_socdk.dts"
#include "socfpga_agilex_pcie_root_port.dtsi"

&pcie_0_pcie_aglx {
	status = "okay";
	compatible = "altr,pcie-root-port-3.0-r-tile";
};
