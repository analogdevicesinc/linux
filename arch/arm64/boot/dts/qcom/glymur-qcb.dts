// SPDX-License-Identifier: BSD-3-Clause
/*
 * Copyright (c) Qualcomm Technologies, Inc. and/or its subsidiaries.
 */

/dts-v1/;

#include "glymur-cob.dtsi"
#include "glymur-qcb.dtsi"

/ {
	model = "Qualcomm Technologies, Inc. Glymur QCB";
	compatible = "qcom,glymur-qcb", "qcom,glymur";
};
