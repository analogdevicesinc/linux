// SPDX-License-Identifier: BSD-3-Clause
/*
 * Copyright (c) Qualcomm Technologies, Inc. and/or its subsidiaries.
 */

/dts-v1/;

#include "glymur-sip.dtsi"
#include "glymur-crd.dtsi"

/ {
	model = "Qualcomm Technologies, Inc. Glymur CRD (SiP)";
	compatible = "qcom,glymur-sip-crd", "qcom,glymur";
};
