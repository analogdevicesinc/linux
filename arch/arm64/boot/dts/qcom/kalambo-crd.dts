// SPDX-License-Identifier: BSD-3-Clause
/*
 * Copyright (c) Qualcomm Technologies, Inc. and/or its subsidiaries.
 */

/dts-v1/;

#include "kalambo.dtsi"
#include "glymur-crd.dtsi"

/ {
	model = "Qualcomm Technologies, Inc. Kalambo CRD";
	compatible = "qcom,kalambo-crd", "qcom,kalambo";
};
