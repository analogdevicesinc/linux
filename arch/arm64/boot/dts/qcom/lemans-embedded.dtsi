// SPDX-License-Identifier: BSD-3-Clause
/*
 * Copyright (c) Qualcomm Technologies, Inc. and/or its subsidiaries.
 */

#include <dt-bindings/interconnect/qcom,icc.h>
#include <dt-bindings/clock/qcom,dsi-phy-28nm.h>
#include <dt-bindings/clock/qcom,rpmh.h>
#include <dt-bindings/clock/qcom,sa8775p-dispcc.h>
#include <dt-bindings/clock/qcom,sa8775p-gcc.h>
#include <dt-bindings/clock/qcom,sa8775p-gpucc.h>
#include <dt-bindings/clock/qcom,sa8775p-videocc.h>
#include <dt-bindings/clock/qcom,sa8775p-camcc.h>
#include <dt-bindings/interconnect/qcom,osm-l3.h>
#include <dt-bindings/interconnect/qcom,sa8775p-rpmh.h>
#include <dt-bindings/power/qcom-rpmpd.h>
#include <dt-bindings/soc/qcom,rpmh-rsc.h>

#include "lemans.dtsi"

/ {
	clocks {
		xo_board_clk: xo-board-clk {
			compatible = "fixed-clock";
			#clock-cells = <0>;
		};

		sleep_clk: sleep-clk {
			compatible = "fixed-clock";
			#clock-cells = <0>;
		};
	};

	cpu0_opp_table: opp-table-cpu0 {
		compatible = "operating-points-v2";
		opp-shared;

		opp-1267200000 {
			opp-hz = /bits/ 64 <1267200000>;
			opp-peak-kBps = <(1555200 * 4) (921600 * 32)>;
		};

		opp-1363200000 {
			opp-hz = /bits/ 64 <1363200000>;
			opp-peak-kBps = <(1555200 * 4) (921600 * 32)>;
		};

		opp-1459200000 {
			opp-hz = /bits/ 64 <1459200000>;
			opp-peak-kBps = <(1555200 * 4) (921600 * 32)>;
		};

		opp-1536000000 {
			opp-hz = /bits/ 64 <1536000000>;
			opp-peak-kBps = <(1555200 * 4) (921600 * 32)>;
		};

		opp-1632000000 {
			opp-hz = /bits/ 64 <1632000000>;
			opp-peak-kBps = <(1708800 * 4) (1228800 * 32)>;
		};

		opp-1708800000 {
			opp-hz = /bits/ 64 <1708800000>;
			opp-peak-kBps = <(1708800 * 4) (1228800 * 32)>;
		};

		opp-1785600000 {
			opp-hz = /bits/ 64 <1785600000>;
			opp-peak-kBps = <(1708800 * 4) (1228800 * 32)>;
		};

		opp-1862400000 {
			opp-hz = /bits/ 64 <1862400000>;
			opp-peak-kBps = <(1708800 * 4) (1228800 * 32)>;
		};

		opp-1939200000 {
			opp-hz = /bits/ 64 <1939200000>;
			opp-peak-kBps = <(1708800 * 4) (1228800 * 32)>;
		};

		opp-2016000000 {
			opp-hz = /bits/ 64 <2016000000>;
			opp-peak-kBps = <(1708800 * 4) (1228800 * 32)>;
		};

		opp-2112000000 {
			opp-hz = /bits/ 64 <2112000000>;
			opp-peak-kBps = <(2092800 * 4) (1555200 * 32)>;
		};

		opp-2188800000 {
			opp-hz = /bits/ 64 <2188800000>;
			opp-peak-kBps = <(2092800 * 4) (1555200 * 32)>;
		};

		opp-2265600000 {
			opp-hz = /bits/ 64 <2265600000>;
			opp-peak-kBps = <(2092800 * 4) (1555200 * 32)>;
		};

		opp-2361600000 {
			opp-hz = /bits/ 64 <2361600000>;
			opp-peak-kBps = <(3196800 * 4) (1612800 * 32)>;
		};

		opp-2457600000 {
			opp-hz = /bits/ 64 <2457600000>;
			opp-peak-kBps = <(3196800 * 4) (1612800 * 32)>;
		};

		opp-2553600000 {
			opp-hz = /bits/ 64 <2553600000>;
			opp-peak-kBps = <(3196800 * 4) (1708800 * 32)>;
		};
	};

	cpu4_opp_table: opp-table-cpu4 {
		compatible = "operating-points-v2";
		opp-shared;

		opp-1267200000 {
			opp-hz = /bits/ 64 <1267200000>;
			opp-peak-kBps = <(1555200 * 4) (921600 * 32)>;
		};

		opp-1363200000 {
			opp-hz = /bits/ 64 <1363200000>;
			opp-peak-kBps = <(1555200 * 4) (921600 * 32)>;
		};

		opp-1459200000 {
			opp-hz = /bits/ 64 <1459200000>;
			opp-peak-kBps = <(1555200 * 4) (921600 * 32)>;
		};

		opp-1536000000 {
			opp-hz = /bits/ 64 <1536000000>;
			opp-peak-kBps = <(1555200 * 4) (921600 * 32)>;
		};

		opp-1632000000 {
			opp-hz = /bits/ 64 <1632000000>;
			opp-peak-kBps = <(1708800 * 4) (1228800 * 32)>;
		};

		opp-1708800000 {
			opp-hz = /bits/ 64 <1708800000>;
			opp-peak-kBps = <(1708800 * 4) (1228800 * 32)>;
		};

		opp-1785600000 {
			opp-hz = /bits/ 64 <1785600000>;
			opp-peak-kBps = <(1708800 * 4) (1228800 * 32)>;
		};

		opp-1862400000 {
			opp-hz = /bits/ 64 <1862400000>;
			opp-peak-kBps = <(1708800 * 4) (1228800 * 32)>;
		};

		opp-1939200000 {
			opp-hz = /bits/ 64 <1939200000>;
			opp-peak-kBps = <(1708800 * 4) (1228800 * 32)>;
		};

		opp-2016000000 {
			opp-hz = /bits/ 64 <2016000000>;
			opp-peak-kBps = <(1708800 * 4) (1228800 * 32)>;
		};

		opp-2112000000 {
			opp-hz = /bits/ 64 <2112000000>;
			opp-peak-kBps = <(2092800 * 4) (1555200 * 32)>;
		};

		opp-2188800000 {
			opp-hz = /bits/ 64 <2188800000>;
			opp-peak-kBps = <(2092800 * 4) (1555200 * 32)>;
		};

		opp-2265600000 {
			opp-hz = /bits/ 64 <2265600000>;
			opp-peak-kBps = <(2092800 * 4) (1555200 * 32)>;
		};

		opp-2361600000 {
			opp-hz = /bits/ 64 <2361600000>;
			opp-peak-kBps = <(3196800 * 4) (1612800 * 32)>;
		};

		opp-2457600000 {
			opp-hz = /bits/ 64 <2457600000>;
			opp-peak-kBps = <(3196800 * 4) (1612800 * 32)>;
		};

		opp-2553600000 {
			opp-hz = /bits/ 64 <2553600000>;
			opp-peak-kBps = <(3196800 * 4) (1708800 * 32)>;
		};
	};

	clk_virt: interconnect-clk-virt {
		compatible = "qcom,sa8775p-clk-virt";
		#interconnect-cells = <2>;
		qcom,bcm-voters = <&apps_bcm_voter>;
	};

	mc_virt: interconnect-mc-virt {
		compatible = "qcom,sa8775p-mc-virt";
		#interconnect-cells = <2>;
		qcom,bcm-voters = <&apps_bcm_voter>;
	};

	qup_opp_table_100mhz: opp-table-qup100mhz {
		compatible = "operating-points-v2";

		opp-100000000 {
			opp-hz = /bits/ 64 <100000000>;
			required-opps = <&rpmhpd_opp_svs_l1>;
		};
	};
};

&adreno_smmu {
	power-domains = <&gpucc GPU_CC_CX_GDSC>;
	clocks = <&gcc GCC_GPU_MEMNOC_GFX_CLK>,
		 <&gcc GCC_GPU_SNOC_DVM_GFX_CLK>,
		 <&gpucc GPU_CC_AHB_CLK>,
		 <&gpucc GPU_CC_HLOS1_VOTE_GPU_SMMU_CLK>,
		 <&gpucc GPU_CC_CX_GMU_CLK>,
		 <&gpucc GPU_CC_HUB_CX_INT_CLK>,
		 <&gpucc GPU_CC_HUB_AON_CLK>;
	clock-names = "gcc_gpu_memnoc_gfx_clk",
		      "gcc_gpu_snoc_dvm_gfx_clk",
		      "gpu_cc_ahb_clk",
		      "gpu_cc_hlos1_vote_gpu_smmu_clk",
		      "gpu_cc_cx_gmu_clk",
		      "gpu_cc_hub_cx_int_clk",
		      "gpu_cc_hub_aon_clk";
};

&camss {
	clocks = <&camcc CAM_CC_CAMNOC_AXI_CLK>,
		 <&camcc CAM_CC_CORE_AHB_CLK>,
		 <&camcc CAM_CC_CPAS_AHB_CLK>,
		 <&camcc CAM_CC_CPAS_FAST_AHB_CLK>,
		 <&camcc CAM_CC_CPAS_IFE_LITE_CLK>,
		 <&camcc CAM_CC_CPAS_IFE_0_CLK>,
		 <&camcc CAM_CC_CPAS_IFE_1_CLK>,
		 <&camcc CAM_CC_CSID_CLK>,
		 <&camcc CAM_CC_CSIPHY0_CLK>,
		 <&camcc CAM_CC_CSI0PHYTIMER_CLK>,
		 <&camcc CAM_CC_CSIPHY1_CLK>,
		 <&camcc CAM_CC_CSI1PHYTIMER_CLK>,
		 <&camcc CAM_CC_CSIPHY2_CLK>,
		 <&camcc CAM_CC_CSI2PHYTIMER_CLK>,
		 <&camcc CAM_CC_CSIPHY3_CLK>,
		 <&camcc CAM_CC_CSI3PHYTIMER_CLK>,
		 <&camcc CAM_CC_CSID_CSIPHY_RX_CLK>,
		 <&gcc GCC_CAMERA_HF_AXI_CLK>,
		 <&gcc GCC_CAMERA_SF_AXI_CLK>,
		 <&camcc CAM_CC_ICP_AHB_CLK>,
		 <&camcc CAM_CC_IFE_0_CLK>,
		 <&camcc CAM_CC_IFE_0_FAST_AHB_CLK>,
		 <&camcc CAM_CC_IFE_1_CLK>,
		 <&camcc CAM_CC_IFE_1_FAST_AHB_CLK>,
		 <&camcc CAM_CC_IFE_LITE_CLK>,
		 <&camcc CAM_CC_IFE_LITE_AHB_CLK>,
		 <&camcc CAM_CC_IFE_LITE_CPHY_RX_CLK>,
		 <&camcc CAM_CC_IFE_LITE_CSID_CLK>;
	clock-names = "camnoc_axi",
		      "core_ahb",
		      "cpas_ahb",
		      "cpas_fast_ahb_clk",
		      "cpas_vfe_lite",
		      "cpas_vfe0",
		      "cpas_vfe1",
		      "csid",
		      "csiphy0",
		      "csiphy0_timer",
		      "csiphy1",
		      "csiphy1_timer",
		      "csiphy2",
		      "csiphy2_timer",
		      "csiphy3",
		      "csiphy3_timer",
		      "csiphy_rx",
		      "gcc_axi_hf",
		      "gcc_axi_sf",
		      "icp_ahb",
		      "vfe0",
		      "vfe0_fast_ahb",
		      "vfe1",
		      "vfe1_fast_ahb",
		      "vfe_lite",
		      "vfe_lite_ahb",
		      "vfe_lite_cphy_rx",
		      "vfe_lite_csid";

	interconnects = <&gem_noc MASTER_APPSS_PROC QCOM_ICC_TAG_ACTIVE_ONLY
			 &config_noc SLAVE_CAMERA_CFG QCOM_ICC_TAG_ACTIVE_ONLY>,
			<&mmss_noc MASTER_CAMNOC_HF QCOM_ICC_TAG_ALWAYS
			 &mc_virt SLAVE_EBI1 QCOM_ICC_TAG_ALWAYS>;
	interconnect-names = "ahb",
			     "hf_0";

	power-domains = <&camcc CAM_CC_TITAN_TOP_GDSC>;
	power-domain-names = "top";
};

&cci0 {
	power-domains = <&camcc CAM_CC_TITAN_TOP_GDSC>;

	clocks = <&camcc CAM_CC_CAMNOC_AXI_CLK>,
		 <&camcc CAM_CC_CPAS_AHB_CLK>,
		 <&camcc CAM_CC_CCI_0_CLK>;
	clock-names = "camnoc_axi",
		      "cpas_ahb",
		      "cci";

	pinctrl-0 = <&cci0_0_default &cci0_1_default>;
	pinctrl-1 = <&cci0_0_sleep &cci0_1_sleep>;
	pinctrl-names = "default", "sleep";
};

&cci1 {
	power-domains = <&camcc CAM_CC_TITAN_TOP_GDSC>;

	clocks = <&camcc CAM_CC_CAMNOC_AXI_CLK>,
		 <&camcc CAM_CC_CPAS_AHB_CLK>,
		 <&camcc CAM_CC_CCI_1_CLK>;
	clock-names = "camnoc_axi",
		      "cpas_ahb",
		      "cci";

	pinctrl-0 = <&cci1_0_default &cci1_1_default>;
	pinctrl-1 = <&cci1_0_sleep &cci1_1_sleep>;
	pinctrl-names = "default", "sleep";
};

&cci2 {
	power-domains = <&camcc CAM_CC_TITAN_TOP_GDSC>;

	clocks = <&camcc CAM_CC_CAMNOC_AXI_CLK>,
		 <&camcc CAM_CC_CPAS_AHB_CLK>,
		 <&camcc CAM_CC_CCI_2_CLK>;
	clock-names = "camnoc_axi",
		      "cpas_ahb",
		      "cci";

	pinctrl-0 = <&cci2_0_default &cci2_1_default>;
	pinctrl-1 = <&cci2_0_sleep &cci2_1_sleep>;
	pinctrl-names = "default", "sleep";
};

&cci3 {
	power-domains = <&camcc CAM_CC_TITAN_TOP_GDSC>;

	clocks = <&camcc CAM_CC_CAMNOC_AXI_CLK>,
		 <&camcc CAM_CC_CPAS_AHB_CLK>,
		 <&camcc CAM_CC_CCI_3_CLK>;
	clock-names = "camnoc_axi",
		      "cpas_ahb",
		      "cci";

	pinctrl-0 = <&cci3_0_default &cci3_1_default>;
	pinctrl-1 = <&cci3_0_sleep &cci3_1_sleep>;
	pinctrl-names = "default", "sleep";
};

&cpu0 {
	operating-points-v2 = <&cpu0_opp_table>;
	interconnects = <&gem_noc MASTER_APPSS_PROC QCOM_ICC_TAG_ACTIVE_ONLY
			 &mc_virt SLAVE_EBI1 QCOM_ICC_TAG_ACTIVE_ONLY>,
			<&epss_l3_cl0 MASTER_EPSS_L3_APPS
			 &epss_l3_cl0 SLAVE_EPSS_L3_SHARED>;
};

&cpu1 {
	operating-points-v2 = <&cpu0_opp_table>;
	interconnects = <&gem_noc MASTER_APPSS_PROC QCOM_ICC_TAG_ACTIVE_ONLY
			 &mc_virt SLAVE_EBI1 QCOM_ICC_TAG_ACTIVE_ONLY>,
			<&epss_l3_cl0 MASTER_EPSS_L3_APPS
			 &epss_l3_cl0 SLAVE_EPSS_L3_SHARED>;
};

&cpu2 {
	operating-points-v2 = <&cpu0_opp_table>;
	interconnects = <&gem_noc MASTER_APPSS_PROC QCOM_ICC_TAG_ACTIVE_ONLY
			 &mc_virt SLAVE_EBI1 QCOM_ICC_TAG_ACTIVE_ONLY>,
			<&epss_l3_cl0 MASTER_EPSS_L3_APPS
			 &epss_l3_cl0 SLAVE_EPSS_L3_SHARED>;
};

&cpu3 {
	operating-points-v2 = <&cpu0_opp_table>;
	interconnects = <&gem_noc MASTER_APPSS_PROC QCOM_ICC_TAG_ACTIVE_ONLY
			 &mc_virt SLAVE_EBI1 QCOM_ICC_TAG_ACTIVE_ONLY>,
			<&epss_l3_cl0 MASTER_EPSS_L3_APPS
			 &epss_l3_cl0 SLAVE_EPSS_L3_SHARED>;
};

&cpu4 {
	operating-points-v2 = <&cpu4_opp_table>;
	interconnects = <&gem_noc MASTER_APPSS_PROC QCOM_ICC_TAG_ACTIVE_ONLY
			 &mc_virt SLAVE_EBI1 QCOM_ICC_TAG_ACTIVE_ONLY>,
			<&epss_l3_cl1 MASTER_EPSS_L3_APPS
			 &epss_l3_cl1 SLAVE_EPSS_L3_SHARED>;
};

&cpu5 {
	operating-points-v2 = <&cpu4_opp_table>;
	interconnects = <&gem_noc MASTER_APPSS_PROC QCOM_ICC_TAG_ACTIVE_ONLY
			 &mc_virt SLAVE_EBI1 QCOM_ICC_TAG_ACTIVE_ONLY>,
			<&epss_l3_cl1 MASTER_EPSS_L3_APPS
			 &epss_l3_cl1 SLAVE_EPSS_L3_SHARED>;
};

&cpu6 {
	operating-points-v2 = <&cpu4_opp_table>;
	interconnects = <&gem_noc MASTER_APPSS_PROC QCOM_ICC_TAG_ACTIVE_ONLY
			 &mc_virt SLAVE_EBI1 QCOM_ICC_TAG_ACTIVE_ONLY>,
			<&epss_l3_cl1 MASTER_EPSS_L3_APPS
			 &epss_l3_cl1 SLAVE_EPSS_L3_SHARED>;
};

&cpu7 {
	operating-points-v2 = <&cpu4_opp_table>;
	interconnects = <&gem_noc MASTER_APPSS_PROC QCOM_ICC_TAG_ACTIVE_ONLY
			 &mc_virt SLAVE_EBI1 QCOM_ICC_TAG_ACTIVE_ONLY>,
			<&epss_l3_cl1 MASTER_EPSS_L3_APPS
			 &epss_l3_cl1 SLAVE_EPSS_L3_SHARED>;
};

&cpu_bwmon0 {
	compatible = "qcom,sa8775p-cpu-bwmon", "qcom,sdm845-bwmon";
	interconnects = <&gem_noc MASTER_APPSS_PROC QCOM_ICC_TAG_ACTIVE_ONLY
			 &gem_noc SLAVE_LLCC QCOM_ICC_TAG_ACTIVE_ONLY>;
};

&cpu_bwmon1 {
	compatible = "qcom,sa8775p-cpu-bwmon", "qcom,sdm845-bwmon";
	interconnects = <&gem_noc MASTER_APPSS_PROC QCOM_ICC_TAG_ACTIVE_ONLY
			 &gem_noc SLAVE_LLCC QCOM_ICC_TAG_ACTIVE_ONLY>;
};

&cpufreq_hw {
	clocks = <&rpmhcc RPMH_CXO_CLK>, <&gcc GCC_GPLL0>;
	clock-names = "xo", "alternate";
};

&crypto {
	interconnects = <&aggre2_noc MASTER_CRYPTO_CORE0 QCOM_ICC_TAG_ALWAYS
			 &mc_virt SLAVE_EBI1 QCOM_ICC_TAG_ALWAYS>;
	interconnect-names = "memory";
};

&ethernet0 {
	clocks = <&gcc GCC_EMAC0_AXI_CLK>,
		 <&gcc GCC_EMAC0_SLV_AHB_CLK>,
		 <&gcc GCC_EMAC0_PTP_CLK>,
		 <&gcc GCC_EMAC0_PHY_AUX_CLK>;
	clock-names = "stmmaceth",
		      "pclk",
		      "ptp_ref",
		      "phyaux";

	interconnects = <&gem_noc MASTER_APPSS_PROC QCOM_ICC_TAG_ALWAYS
			 &config_noc SLAVE_EMAC_CFG QCOM_ICC_TAG_ALWAYS>,
			<&aggre1_noc MASTER_EMAC QCOM_ICC_TAG_ALWAYS
			 &mc_virt SLAVE_EBI1 QCOM_ICC_TAG_ALWAYS>;
	interconnect-names = "cpu-mac",
			     "mac-mem";

	power-domains = <&gcc EMAC0_GDSC>;

	phys = <&serdes0>;
	phy-names = "serdes";
};

&ethernet1 {
	clocks = <&gcc GCC_EMAC1_AXI_CLK>,
		 <&gcc GCC_EMAC1_SLV_AHB_CLK>,
		 <&gcc GCC_EMAC1_PTP_CLK>,
		 <&gcc GCC_EMAC1_PHY_AUX_CLK>;
	clock-names = "stmmaceth",
		      "pclk",
		      "ptp_ref",
		      "phyaux";

	interconnects = <&gem_noc MASTER_APPSS_PROC QCOM_ICC_TAG_ALWAYS
			 &config_noc SLAVE_EMAC1_CFG QCOM_ICC_TAG_ALWAYS>,
			<&aggre1_noc MASTER_EMAC_1 QCOM_ICC_TAG_ALWAYS
			 &mc_virt SLAVE_EBI1 QCOM_ICC_TAG_ALWAYS>;
	interconnect-names = "cpu-mac",
			     "mac-mem";

	power-domains = <&gcc EMAC1_GDSC>;

	phys = <&serdes1>;
	phy-names = "serdes";
};

&gmu {
	compatible = "qcom,adreno-gmu-663.0", "qcom,adreno-gmu";
	clocks = <&gpucc GPU_CC_CX_GMU_CLK>,
		 <&gpucc GPU_CC_CXO_CLK>,
		 <&gcc GCC_DDRSS_GPU_AXI_CLK>,
		 <&gcc GCC_GPU_MEMNOC_GFX_CLK>,
		 <&gpucc GPU_CC_AHB_CLK>,
		 <&gpucc GPU_CC_HUB_CX_INT_CLK>,
		 <&gpucc GPU_CC_HLOS1_VOTE_GPU_SMMU_CLK>;
	clock-names = "gmu",
		      "cxo",
		      "axi",
		      "memnoc",
		      "ahb",
		      "hub",
		      "smmu_vote";
	power-domains = <&gpucc GPU_CC_CX_GDSC>,
			<&gpucc GPU_CC_GX_GDSC>;
	power-domain-names = "cx",
			     "gx";
	operating-points-v2 = <&gmu_opp_table>;

	gmu_opp_table: opp-table {
		compatible = "operating-points-v2";

		opp-500000000 {
			opp-hz = /bits/ 64 <500000000>;
			opp-level = <RPMH_REGULATOR_LEVEL_SVS>;
		};
	};
};

&gpu {
	operating-points-v2 = <&gpu_opp_table>;
	interconnects = <&gem_noc MASTER_GFX3D QCOM_ICC_TAG_ALWAYS
			 &mc_virt SLAVE_EBI1 QCOM_ICC_TAG_ALWAYS>;
	interconnect-names = "gfx-mem";

	gpu_opp_table: opp-table {
		compatible = "operating-points-v2";

		opp-405000000 {
			opp-hz = /bits/ 64 <405000000>;
			opp-level = <RPMH_REGULATOR_LEVEL_SVS_L1>;
			opp-peak-kBps = <5285156>;
			opp-supported-hw = <0x3>;
		};

		opp-530000000 {
			opp-hz = /bits/ 64 <530000000>;
			opp-level = <RPMH_REGULATOR_LEVEL_SVS_L1>;
			opp-peak-kBps = <12484375>;
			opp-supported-hw = <0x2>;
		};

		opp-676000000 {
			opp-hz = /bits/ 64 <676000000>;
			opp-level = <RPMH_REGULATOR_LEVEL_NOM>;
			opp-peak-kBps = <8171875>;
			opp-supported-hw = <0x1>;
		};

		opp-778000000 {
			opp-hz = /bits/ 64 <778000000>;
			opp-level = <RPMH_REGULATOR_LEVEL_TURBO>;
			opp-peak-kBps = <10687500>;
			opp-supported-hw = <0x1>;
		};

		opp-800000000 {
			opp-hz = /bits/ 64 <800000000>;
			opp-level = <RPMH_REGULATOR_LEVEL_TURBO_L1>;
			opp-peak-kBps = <12484375>;
			opp-supported-hw = <0x1>;
		};
	};
};

&i2c0 {
	clocks = <&gcc GCC_QUPV3_WRAP0_S0_CLK>;
	clock-names = "se";
	pinctrl-0 = <&qup_i2c0_default>;
	pinctrl-names = "default";
	interconnects = <&clk_virt MASTER_QUP_CORE_0 QCOM_ICC_TAG_ALWAYS
			 &clk_virt SLAVE_QUP_CORE_0 QCOM_ICC_TAG_ALWAYS>,
			<&gem_noc MASTER_APPSS_PROC QCOM_ICC_TAG_ALWAYS
			 &config_noc SLAVE_QUP_0 QCOM_ICC_TAG_ALWAYS>,
			<&aggre2_noc MASTER_QUP_0 QCOM_ICC_TAG_ALWAYS
			 &mc_virt SLAVE_EBI1 QCOM_ICC_TAG_ALWAYS>;
	interconnect-names = "qup-core",
			     "qup-config",
			     "qup-memory";
	power-domains = <&rpmhpd SA8775P_CX>;
};

&i2c1 {
	clocks = <&gcc GCC_QUPV3_WRAP0_S1_CLK>;
	clock-names = "se";
	pinctrl-0 = <&qup_i2c1_default>;
	pinctrl-names = "default";
	interconnects = <&clk_virt MASTER_QUP_CORE_0 QCOM_ICC_TAG_ALWAYS
			 &clk_virt SLAVE_QUP_CORE_0 QCOM_ICC_TAG_ALWAYS>,
			<&gem_noc MASTER_APPSS_PROC QCOM_ICC_TAG_ALWAYS
			 &config_noc SLAVE_QUP_0 QCOM_ICC_TAG_ALWAYS>,
			<&aggre2_noc MASTER_QUP_0 QCOM_ICC_TAG_ALWAYS
			 &mc_virt SLAVE_EBI1 QCOM_ICC_TAG_ALWAYS>;
	interconnect-names = "qup-core",
			     "qup-config",
			     "qup-memory";
	power-domains = <&rpmhpd SA8775P_CX>;
};

&i2c2 {
	clocks = <&gcc GCC_QUPV3_WRAP0_S2_CLK>;
	clock-names = "se";
	pinctrl-0 = <&qup_i2c2_default>;
	pinctrl-names = "default";
	interconnects = <&clk_virt MASTER_QUP_CORE_0 QCOM_ICC_TAG_ALWAYS
			 &clk_virt SLAVE_QUP_CORE_0 QCOM_ICC_TAG_ALWAYS>,
			<&gem_noc MASTER_APPSS_PROC QCOM_ICC_TAG_ALWAYS
			 &config_noc SLAVE_QUP_0 QCOM_ICC_TAG_ALWAYS>,
			<&aggre2_noc MASTER_QUP_0 QCOM_ICC_TAG_ALWAYS
			 &mc_virt SLAVE_EBI1 QCOM_ICC_TAG_ALWAYS>;
	interconnect-names = "qup-core",
			     "qup-config",
			     "qup-memory";
	power-domains = <&rpmhpd SA8775P_CX>;
};

&i2c3 {
	clocks = <&gcc GCC_QUPV3_WRAP0_S3_CLK>;
	clock-names = "se";
	pinctrl-0 = <&qup_i2c3_default>;
	pinctrl-names = "default";
	interconnects = <&clk_virt MASTER_QUP_CORE_0 QCOM_ICC_TAG_ALWAYS
			 &clk_virt SLAVE_QUP_CORE_0 QCOM_ICC_TAG_ALWAYS>,
			<&gem_noc MASTER_APPSS_PROC QCOM_ICC_TAG_ALWAYS
			 &config_noc SLAVE_QUP_0 QCOM_ICC_TAG_ALWAYS>,
			<&aggre2_noc MASTER_QUP_0 QCOM_ICC_TAG_ALWAYS
			 &mc_virt SLAVE_EBI1 QCOM_ICC_TAG_ALWAYS>;
	interconnect-names = "qup-core",
			     "qup-config",
			     "qup-memory";
	power-domains = <&rpmhpd SA8775P_CX>;
};

&i2c4 {
	clocks = <&gcc GCC_QUPV3_WRAP0_S4_CLK>;
	clock-names = "se";
	pinctrl-0 = <&qup_i2c4_default>;
	pinctrl-names = "default";
	interconnects = <&clk_virt MASTER_QUP_CORE_0 QCOM_ICC_TAG_ALWAYS
			 &clk_virt SLAVE_QUP_CORE_0 QCOM_ICC_TAG_ALWAYS>,
			<&gem_noc MASTER_APPSS_PROC QCOM_ICC_TAG_ALWAYS
			 &config_noc SLAVE_QUP_0 QCOM_ICC_TAG_ALWAYS>,
			<&aggre2_noc MASTER_QUP_0 QCOM_ICC_TAG_ALWAYS
			 &mc_virt SLAVE_EBI1 QCOM_ICC_TAG_ALWAYS>;
	interconnect-names = "qup-core",
			     "qup-config",
			     "qup-memory";
	power-domains = <&rpmhpd SA8775P_CX>;
};

&i2c5 {
	clocks = <&gcc GCC_QUPV3_WRAP0_S5_CLK>;
	clock-names = "se";
	pinctrl-0 = <&qup_i2c5_default>;
	pinctrl-names = "default";
	interconnects = <&clk_virt MASTER_QUP_CORE_0 QCOM_ICC_TAG_ALWAYS
			 &clk_virt SLAVE_QUP_CORE_0 QCOM_ICC_TAG_ALWAYS>,
			<&gem_noc MASTER_APPSS_PROC QCOM_ICC_TAG_ALWAYS
			 &config_noc SLAVE_QUP_0 QCOM_ICC_TAG_ALWAYS>,
			<&aggre2_noc MASTER_QUP_0 QCOM_ICC_TAG_ALWAYS
			 &mc_virt SLAVE_EBI1 QCOM_ICC_TAG_ALWAYS>;
	interconnect-names = "qup-core",
			     "qup-config",
			     "qup-memory";
	power-domains = <&rpmhpd SA8775P_CX>;
};

&i2c7 {
	clocks = <&gcc GCC_QUPV3_WRAP1_S0_CLK>;
	clock-names = "se";
	pinctrl-0 = <&qup_i2c7_default>;
	pinctrl-names = "default";
	interconnects = <&clk_virt MASTER_QUP_CORE_1 QCOM_ICC_TAG_ALWAYS
			 &clk_virt SLAVE_QUP_CORE_1 QCOM_ICC_TAG_ALWAYS>,
			<&gem_noc MASTER_APPSS_PROC QCOM_ICC_TAG_ALWAYS
			 &config_noc SLAVE_QUP_1 QCOM_ICC_TAG_ALWAYS>,
			<&aggre2_noc MASTER_QUP_1 QCOM_ICC_TAG_ALWAYS
			 &mc_virt SLAVE_EBI1 QCOM_ICC_TAG_ALWAYS>;
	interconnect-names = "qup-core",
			     "qup-config",
			     "qup-memory";
	power-domains = <&rpmhpd SA8775P_CX>;
};

&i2c8 {
	clocks = <&gcc GCC_QUPV3_WRAP1_S1_CLK>;
	clock-names = "se";
	pinctrl-0 = <&qup_i2c8_default>;
	pinctrl-names = "default";
	interconnects = <&clk_virt MASTER_QUP_CORE_1 QCOM_ICC_TAG_ALWAYS
			 &clk_virt SLAVE_QUP_CORE_1 QCOM_ICC_TAG_ALWAYS>,
			<&gem_noc MASTER_APPSS_PROC QCOM_ICC_TAG_ALWAYS
			 &config_noc SLAVE_QUP_1 QCOM_ICC_TAG_ALWAYS>,
			<&aggre2_noc MASTER_QUP_1 QCOM_ICC_TAG_ALWAYS
			 &mc_virt SLAVE_EBI1 QCOM_ICC_TAG_ALWAYS>;
	interconnect-names = "qup-core",
			     "qup-config",
			     "qup-memory";
	power-domains = <&rpmhpd SA8775P_CX>;
};

&i2c9 {
	clocks = <&gcc GCC_QUPV3_WRAP1_S2_CLK>;
	clock-names = "se";
	pinctrl-0 = <&qup_i2c9_default>;
	pinctrl-names = "default";
	interconnects = <&clk_virt MASTER_QUP_CORE_1 QCOM_ICC_TAG_ALWAYS
			 &clk_virt SLAVE_QUP_CORE_1 QCOM_ICC_TAG_ALWAYS>,
			<&gem_noc MASTER_APPSS_PROC QCOM_ICC_TAG_ALWAYS
			 &config_noc SLAVE_QUP_1 QCOM_ICC_TAG_ALWAYS>,
			<&aggre2_noc MASTER_QUP_1 QCOM_ICC_TAG_ALWAYS
			 &mc_virt SLAVE_EBI1 QCOM_ICC_TAG_ALWAYS>;
	interconnect-names = "qup-core",
			     "qup-config",
			     "qup-memory";
	power-domains = <&rpmhpd SA8775P_CX>;
};

&i2c10 {
	clocks = <&gcc GCC_QUPV3_WRAP1_S3_CLK>;
	clock-names = "se";
	pinctrl-0 = <&qup_i2c10_default>;
	pinctrl-names = "default";
	interconnects = <&clk_virt MASTER_QUP_CORE_1 QCOM_ICC_TAG_ALWAYS
			 &clk_virt SLAVE_QUP_CORE_1 QCOM_ICC_TAG_ALWAYS>,
			<&gem_noc MASTER_APPSS_PROC QCOM_ICC_TAG_ALWAYS
			 &config_noc SLAVE_QUP_1 QCOM_ICC_TAG_ALWAYS>,
			<&aggre2_noc MASTER_QUP_1 QCOM_ICC_TAG_ALWAYS
			 &mc_virt SLAVE_EBI1 QCOM_ICC_TAG_ALWAYS>;
	interconnect-names = "qup-core",
			     "qup-config",
			     "qup-memory";
	power-domains = <&rpmhpd SA8775P_CX>;
};

&i2c11 {
	clocks = <&gcc GCC_QUPV3_WRAP1_S4_CLK>;
	clock-names = "se";
	pinctrl-0 = <&qup_i2c11_default>;
	pinctrl-names = "default";
	interconnects = <&clk_virt MASTER_QUP_CORE_1 QCOM_ICC_TAG_ALWAYS
			 &clk_virt SLAVE_QUP_CORE_1 QCOM_ICC_TAG_ALWAYS>,
			<&gem_noc MASTER_APPSS_PROC QCOM_ICC_TAG_ALWAYS
			 &config_noc SLAVE_QUP_1 QCOM_ICC_TAG_ALWAYS>,
			<&aggre2_noc MASTER_QUP_1 QCOM_ICC_TAG_ALWAYS
			 &mc_virt SLAVE_EBI1 QCOM_ICC_TAG_ALWAYS>;
	interconnect-names = "qup-core",
			     "qup-config",
			     "qup-memory";
	power-domains = <&rpmhpd SA8775P_CX>;
};

&i2c12 {
	clocks = <&gcc GCC_QUPV3_WRAP1_S5_CLK>;
	clock-names = "se";
	pinctrl-0 = <&qup_i2c12_default>;
	pinctrl-names = "default";
	interconnects = <&clk_virt MASTER_QUP_CORE_1 QCOM_ICC_TAG_ALWAYS
			 &clk_virt SLAVE_QUP_CORE_1 QCOM_ICC_TAG_ALWAYS>,
			<&gem_noc MASTER_APPSS_PROC QCOM_ICC_TAG_ALWAYS
			 &config_noc SLAVE_QUP_1 QCOM_ICC_TAG_ALWAYS>,
			<&aggre2_noc MASTER_QUP_1 QCOM_ICC_TAG_ALWAYS
			 &mc_virt SLAVE_EBI1 QCOM_ICC_TAG_ALWAYS>;
	interconnect-names = "qup-core",
			     "qup-config",
			     "qup-memory";
	power-domains = <&rpmhpd SA8775P_CX>;
};

&i2c13 {
	clocks = <&gcc GCC_QUPV3_WRAP1_S6_CLK>;
	clock-names = "se";
	pinctrl-0 = <&qup_i2c13_default>;
	pinctrl-names = "default";
	interconnects = <&clk_virt MASTER_QUP_CORE_1 QCOM_ICC_TAG_ALWAYS
			 &clk_virt SLAVE_QUP_CORE_1 QCOM_ICC_TAG_ALWAYS>,
			<&gem_noc MASTER_APPSS_PROC QCOM_ICC_TAG_ALWAYS
			 &config_noc SLAVE_QUP_1 QCOM_ICC_TAG_ALWAYS>,
			<&aggre2_noc MASTER_QUP_1 QCOM_ICC_TAG_ALWAYS
			 &mc_virt SLAVE_EBI1 QCOM_ICC_TAG_ALWAYS>;
	interconnect-names = "qup-core",
			     "qup-config",
			     "qup-memory";
	power-domains = <&rpmhpd SA8775P_CX>;
};

&i2c14 {
	clocks = <&gcc GCC_QUPV3_WRAP2_S0_CLK>;
	clock-names = "se";
	pinctrl-0 = <&qup_i2c14_default>;
	pinctrl-names = "default";
	interconnects = <&clk_virt MASTER_QUP_CORE_2 QCOM_ICC_TAG_ALWAYS
			 &clk_virt SLAVE_QUP_CORE_2 QCOM_ICC_TAG_ALWAYS>,
			<&gem_noc MASTER_APPSS_PROC QCOM_ICC_TAG_ALWAYS
			 &config_noc SLAVE_QUP_2 QCOM_ICC_TAG_ALWAYS>,
			<&aggre2_noc MASTER_QUP_2 QCOM_ICC_TAG_ALWAYS
			 &mc_virt SLAVE_EBI1 QCOM_ICC_TAG_ALWAYS>;
	interconnect-names = "qup-core",
			     "qup-config",
			     "qup-memory";
	power-domains = <&rpmhpd SA8775P_CX>;
};

&i2c15 {
	clocks = <&gcc GCC_QUPV3_WRAP2_S1_CLK>;
	clock-names = "se";
	pinctrl-0 = <&qup_i2c15_default>;
	pinctrl-names = "default";
	interconnects = <&clk_virt MASTER_QUP_CORE_2 QCOM_ICC_TAG_ALWAYS
			 &clk_virt SLAVE_QUP_CORE_2 QCOM_ICC_TAG_ALWAYS>,
			<&gem_noc MASTER_APPSS_PROC QCOM_ICC_TAG_ALWAYS
			 &config_noc SLAVE_QUP_2 QCOM_ICC_TAG_ALWAYS>,
			<&aggre2_noc MASTER_QUP_2 QCOM_ICC_TAG_ALWAYS
			 &mc_virt SLAVE_EBI1 QCOM_ICC_TAG_ALWAYS>;
	interconnect-names = "qup-core",
			     "qup-config",
			     "qup-memory";
	power-domains = <&rpmhpd SA8775P_CX>;
};

&i2c16 {
	clocks = <&gcc GCC_QUPV3_WRAP2_S2_CLK>;
	clock-names = "se";
	pinctrl-0 = <&qup_i2c16_default>;
	pinctrl-names = "default";
	interconnects = <&clk_virt MASTER_QUP_CORE_2 QCOM_ICC_TAG_ALWAYS
			 &clk_virt SLAVE_QUP_CORE_2 QCOM_ICC_TAG_ALWAYS>,
			<&gem_noc MASTER_APPSS_PROC QCOM_ICC_TAG_ALWAYS
			 &config_noc SLAVE_QUP_2 QCOM_ICC_TAG_ALWAYS>,
			<&aggre2_noc MASTER_QUP_2 QCOM_ICC_TAG_ALWAYS
			 &mc_virt SLAVE_EBI1 QCOM_ICC_TAG_ALWAYS>;
	interconnect-names = "qup-core",
			     "qup-config",
			     "qup-memory";
	power-domains = <&rpmhpd SA8775P_CX>;
};

&i2c17 {
	clocks = <&gcc GCC_QUPV3_WRAP2_S3_CLK>;
	clock-names = "se";
	pinctrl-0 = <&qup_i2c17_default>;
	pinctrl-names = "default";
	interconnects = <&clk_virt MASTER_QUP_CORE_2 QCOM_ICC_TAG_ALWAYS
			 &clk_virt SLAVE_QUP_CORE_2 QCOM_ICC_TAG_ALWAYS>,
			<&gem_noc MASTER_APPSS_PROC QCOM_ICC_TAG_ALWAYS
			 &config_noc SLAVE_QUP_2 QCOM_ICC_TAG_ALWAYS>,
			<&aggre2_noc MASTER_QUP_2 QCOM_ICC_TAG_ALWAYS
			 &mc_virt SLAVE_EBI1 QCOM_ICC_TAG_ALWAYS>;
	interconnect-names = "qup-core",
			     "qup-config",
			     "qup-memory";
	power-domains = <&rpmhpd SA8775P_CX>;
};

&i2c18 {
	clocks = <&gcc GCC_QUPV3_WRAP2_S4_CLK>;
	clock-names = "se";
	pinctrl-0 = <&qup_i2c18_default>;
	pinctrl-names = "default";
	interconnects = <&clk_virt MASTER_QUP_CORE_2 QCOM_ICC_TAG_ALWAYS
			 &clk_virt SLAVE_QUP_CORE_2 QCOM_ICC_TAG_ALWAYS>,
			<&gem_noc MASTER_APPSS_PROC QCOM_ICC_TAG_ALWAYS
			 &config_noc SLAVE_QUP_2 QCOM_ICC_TAG_ALWAYS>,
			<&aggre2_noc MASTER_QUP_2 QCOM_ICC_TAG_ALWAYS
			 &mc_virt SLAVE_EBI1 QCOM_ICC_TAG_ALWAYS>;
	interconnect-names = "qup-core",
			     "qup-config",
			     "qup-memory";
	power-domains = <&rpmhpd SA8775P_CX>;
};

&i2c19 {
	clocks = <&gcc GCC_QUPV3_WRAP2_S5_CLK>;
	clock-names = "se";
	pinctrl-0 = <&qup_i2c19_default>;
	pinctrl-names = "default";
	interconnects = <&clk_virt MASTER_QUP_CORE_2 QCOM_ICC_TAG_ALWAYS
			 &clk_virt SLAVE_QUP_CORE_2 QCOM_ICC_TAG_ALWAYS>,
			<&gem_noc MASTER_APPSS_PROC QCOM_ICC_TAG_ALWAYS
			 &config_noc SLAVE_QUP_2 QCOM_ICC_TAG_ALWAYS>,
			<&aggre2_noc MASTER_QUP_2 QCOM_ICC_TAG_ALWAYS
			 &mc_virt SLAVE_EBI1 QCOM_ICC_TAG_ALWAYS>;
	interconnect-names = "qup-core",
			     "qup-config",
			     "qup-memory";
	power-domains = <&rpmhpd SA8775P_CX>;
};

&i2c20 {
	clocks = <&gcc GCC_QUPV3_WRAP2_S6_CLK>;
	clock-names = "se";
	pinctrl-0 = <&qup_i2c20_default>;
	pinctrl-names = "default";
	interconnects = <&clk_virt MASTER_QUP_CORE_2 QCOM_ICC_TAG_ALWAYS
			 &clk_virt SLAVE_QUP_CORE_2 QCOM_ICC_TAG_ALWAYS>,
			<&gem_noc MASTER_APPSS_PROC QCOM_ICC_TAG_ALWAYS
			 &config_noc SLAVE_QUP_2 QCOM_ICC_TAG_ALWAYS>,
			<&aggre2_noc MASTER_QUP_2 QCOM_ICC_TAG_ALWAYS
			 &mc_virt SLAVE_EBI1 QCOM_ICC_TAG_ALWAYS>;
	interconnect-names = "qup-core",
			     "qup-config",
			     "qup-memory";
	power-domains = <&rpmhpd SA8775P_CX>;
};

&i2c21 {
	clocks = <&gcc GCC_QUPV3_WRAP3_S0_CLK>;
	clock-names = "se";
	pinctrl-0 = <&qup_i2c21_default>;
	pinctrl-names = "default";
	interconnects = <&clk_virt MASTER_QUP_CORE_3 QCOM_ICC_TAG_ALWAYS
			&clk_virt SLAVE_QUP_CORE_3 QCOM_ICC_TAG_ALWAYS>,
		   <&gem_noc MASTER_APPSS_PROC QCOM_ICC_TAG_ALWAYS
			&config_noc SLAVE_QUP_3 QCOM_ICC_TAG_ALWAYS>,
		   <&aggre1_noc MASTER_QUP_3 QCOM_ICC_TAG_ALWAYS
			&mc_virt SLAVE_EBI1 QCOM_ICC_TAG_ALWAYS>;
	interconnect-names = "qup-core",
				 "qup-config",
				 "qup-memory";
	power-domains = <&rpmhpd SA8775P_CX>;
};

&iris {
	power-domains = <&videocc VIDEO_CC_MVS0C_GDSC>,
			<&videocc VIDEO_CC_MVS0_GDSC>,
			<&rpmhpd SA8775P_MX>,
			<&rpmhpd SA8775P_MMCX>;
	power-domain-names = "venus",
			     "vcodec0",
			     "mxc",
			     "mmcx";
	operating-points-v2 = <&iris_opp_table>;

	clocks = <&gcc GCC_VIDEO_AXI0_CLK>,
		 <&videocc VIDEO_CC_MVS0C_CLK>,
		 <&videocc VIDEO_CC_MVS0_CLK>;
	clock-names = "iface",
		      "core",
		      "vcodec0_core";

	interconnects = <&gem_noc MASTER_APPSS_PROC QCOM_ICC_TAG_ACTIVE_ONLY
			 &config_noc SLAVE_VENUS_CFG QCOM_ICC_TAG_ACTIVE_ONLY>,
			<&mmss_noc MASTER_VIDEO_P0 QCOM_ICC_TAG_ALWAYS
			 &mc_virt SLAVE_EBI1 QCOM_ICC_TAG_ALWAYS>;
	interconnect-names = "cpu-cfg",
			     "video-mem";

	resets = <&gcc GCC_VIDEO_AXI0_CLK_ARES>;
	reset-names = "bus";

	iris_opp_table: opp-table {
		compatible = "operating-points-v2";

		opp-366000000 {
			opp-hz = /bits/ 64 <366000000>;
			required-opps = <&rpmhpd_opp_svs_l1>,
					<&rpmhpd_opp_svs_l1>;
		};

		opp-444000000 {
			opp-hz = /bits/ 64 <444000000>;
			required-opps = <&rpmhpd_opp_svs_l1>,
					<&rpmhpd_opp_nom>;
		};

		opp-533000000 {
			opp-hz = /bits/ 64 <533000000>;
			required-opps = <&rpmhpd_opp_nom>,
					<&rpmhpd_opp_turbo>;
		};

		opp-560000000 {
			opp-hz = /bits/ 64 <560000000>;
			required-opps = <&rpmhpd_opp_nom>,
					<&rpmhpd_opp_turbo_l1>;
		};
	};
};

&llcc_bwmon {
	compatible = "qcom,sa8775p-llcc-bwmon", "qcom,sc7280-llcc-bwmon";
	interconnects = <&mc_virt MASTER_LLCC QCOM_ICC_TAG_ACTIVE_ONLY
			 &mc_virt SLAVE_EBI1 QCOM_ICC_TAG_ACTIVE_ONLY>;
};

&mdss0 {
	/* same path used twice */
	interconnects = <&mmss_noc MASTER_MDP0 QCOM_ICC_TAG_ALWAYS
			 &mc_virt SLAVE_EBI1 QCOM_ICC_TAG_ALWAYS>,
			<&mmss_noc MASTER_MDP1 QCOM_ICC_TAG_ALWAYS
			 &mc_virt SLAVE_EBI1 QCOM_ICC_TAG_ALWAYS>,
			<&gem_noc MASTER_APPSS_PROC QCOM_ICC_TAG_ACTIVE_ONLY
			 &config_noc SLAVE_DISPLAY_CFG QCOM_ICC_TAG_ACTIVE_ONLY>;
	interconnect-names = "mdp0-mem",
			     "mdp1-mem",
			     "cpu-cfg";

	resets = <&dispcc0 MDSS_DISP_CC_MDSS_CORE_BCR>;

	power-domains = <&dispcc0 MDSS_DISP_CC_MDSS_CORE_GDSC>;

	clocks = <&dispcc0 MDSS_DISP_CC_MDSS_AHB_CLK>,
		 <&gcc GCC_DISP_HF_AXI_CLK>,
		 <&dispcc0 MDSS_DISP_CC_MDSS_MDP_CLK>;

	mdss0_dsi0_phy: phy@ae94400 {
		compatible = "qcom,sa8775p-dsi-phy-5nm";
		reg = <0x0 0x0ae94400 0x0 0x200>,
		      <0x0 0x0ae94600 0x0 0x280>,
		      <0x0 0x0ae94900 0x0 0x27c>;
		reg-names = "dsi_phy",
			    "dsi_phy_lane",
			    "dsi_pll";

		#clock-cells = <1>;
		#phy-cells = <0>;

		clocks = <&dispcc0 MDSS_DISP_CC_MDSS_AHB_CLK>,
			 <&rpmhcc RPMH_CXO_CLK>;
		clock-names = "iface", "ref";

		status = "disabled";
	};

	mdss0_dsi1_phy: phy@ae96400 {
		compatible = "qcom,sa8775p-dsi-phy-5nm";
		reg = <0x0 0x0ae96400 0x0 0x200>,
		      <0x0 0x0ae96600 0x0 0x280>,
		      <0x0 0x0ae96900 0x0 0x27c>;
		reg-names = "dsi_phy",
			    "dsi_phy_lane",
			    "dsi_pll";

		#clock-cells = <1>;
		#phy-cells = <0>;

		clocks = <&dispcc0 MDSS_DISP_CC_MDSS_AHB_CLK>,
			 <&rpmhcc RPMH_CXO_CLK>;
		clock-names = "iface", "ref";

		status = "disabled";
	};

	mdss0_dp0_phy: phy@aec2a00 {
		compatible = "qcom,sa8775p-edp-phy";

		reg = <0x0 0x0aec2a00 0x0 0x200>,
		      <0x0 0x0aec2200 0x0 0xd0>,
		      <0x0 0x0aec2600 0x0 0xd0>,
		      <0x0 0x0aec2000 0x0 0x1c8>;

		clocks = <&dispcc0 MDSS_DISP_CC_MDSS_DPTX0_AUX_CLK>,
			 <&dispcc0 MDSS_DISP_CC_MDSS_AHB_CLK>,
			 <&gcc GCC_EDP_REF_CLKREF_EN>;
		clock-names = "aux",
			      "cfg_ahb",
			      "ref";

		#clock-cells = <1>;
		#phy-cells = <0>;

		status = "disabled";
	};

	mdss0_dp1_phy: phy@aec5a00 {
		compatible = "qcom,sa8775p-edp-phy";

		reg = <0x0 0x0aec5a00 0x0 0x200>,
		      <0x0 0x0aec5200 0x0 0xd0>,
		      <0x0 0x0aec5600 0x0 0xd0>,
		      <0x0 0x0aec5000 0x0 0x1c8>;

		clocks = <&dispcc0 MDSS_DISP_CC_MDSS_DPTX1_AUX_CLK>,
			 <&dispcc0 MDSS_DISP_CC_MDSS_AHB_CLK>,
			 <&gcc GCC_EDP_REF_CLKREF_EN>;
		clock-names = "aux",
			      "cfg_ahb",
			      "ref";

		#clock-cells = <1>;
		#phy-cells = <0>;

		status = "disabled";
	};
};

&mdss0_dp0 {
	clocks = <&dispcc0 MDSS_DISP_CC_MDSS_AHB_CLK>,
		 <&dispcc0 MDSS_DISP_CC_MDSS_DPTX0_AUX_CLK>,
		 <&dispcc0 MDSS_DISP_CC_MDSS_DPTX0_LINK_CLK>,
		 <&dispcc0 MDSS_DISP_CC_MDSS_DPTX0_LINK_INTF_CLK>,
		 <&dispcc0 MDSS_DISP_CC_MDSS_DPTX0_PIXEL0_CLK>,
		 <&dispcc0 MDSS_DISP_CC_MDSS_DPTX0_PIXEL1_CLK>,
		 <&dispcc0 MDSS_DISP_CC_MDSS_DPTX0_PIXEL2_CLK>,
		 <&dispcc0 MDSS_DISP_CC_MDSS_DPTX0_PIXEL3_CLK>;
	clock-names = "core_iface",
		      "core_aux",
		      "ctrl_link",
		      "ctrl_link_iface",
		      "stream_pixel",
		      "stream_1_pixel",
		      "stream_2_pixel",
		      "stream_3_pixel";
	assigned-clocks = <&dispcc0 MDSS_DISP_CC_MDSS_DPTX0_LINK_CLK_SRC>,
			  <&dispcc0 MDSS_DISP_CC_MDSS_DPTX0_PIXEL0_CLK_SRC>,
			  <&dispcc0 MDSS_DISP_CC_MDSS_DPTX0_PIXEL1_CLK_SRC>,
			  <&dispcc0 MDSS_DISP_CC_MDSS_DPTX0_PIXEL2_CLK_SRC>,
			  <&dispcc0 MDSS_DISP_CC_MDSS_DPTX0_PIXEL3_CLK_SRC>;
	assigned-clock-parents = <&mdss0_dp0_phy 0>,
				 <&mdss0_dp0_phy 1>,
				 <&mdss0_dp0_phy 1>,
				 <&mdss0_dp0_phy 1>,
				 <&mdss0_dp0_phy 1>;
	phys = <&mdss0_dp0_phy>;
	phy-names = "dp";

	operating-points-v2 = <&dp_opp_table>;
	power-domains = <&rpmhpd SA8775P_MMCX>;

	dp_opp_table: opp-table {
		compatible = "operating-points-v2";

		opp-162000000 {
			opp-hz = /bits/ 64 <162000000>;
			required-opps = <&rpmhpd_opp_low_svs>;
		};

		opp-270000000 {
			opp-hz = /bits/ 64 <270000000>;
			required-opps = <&rpmhpd_opp_svs>;
		};

		opp-540000000 {
			opp-hz = /bits/ 64 <540000000>;
			required-opps = <&rpmhpd_opp_svs_l1>;
		};

		opp-810000000 {
			opp-hz = /bits/ 64 <810000000>;
			required-opps = <&rpmhpd_opp_nom>;
		};
	};
};

&mdss0_dp1 {
	clocks = <&dispcc0 MDSS_DISP_CC_MDSS_AHB_CLK>,
		 <&dispcc0 MDSS_DISP_CC_MDSS_DPTX1_AUX_CLK>,
		 <&dispcc0 MDSS_DISP_CC_MDSS_DPTX1_LINK_CLK>,
		 <&dispcc0 MDSS_DISP_CC_MDSS_DPTX1_LINK_INTF_CLK>,
		 <&dispcc0 MDSS_DISP_CC_MDSS_DPTX1_PIXEL0_CLK>,
		 <&dispcc0 MDSS_DISP_CC_MDSS_DPTX1_PIXEL1_CLK>;
	clock-names = "core_iface",
		      "core_aux",
		      "ctrl_link",
		      "ctrl_link_iface",
		      "stream_pixel",
		      "stream_1_pixel";
	assigned-clocks = <&dispcc0 MDSS_DISP_CC_MDSS_DPTX1_LINK_CLK_SRC>,
			  <&dispcc0 MDSS_DISP_CC_MDSS_DPTX1_PIXEL0_CLK_SRC>,
			  <&dispcc0 MDSS_DISP_CC_MDSS_DPTX1_PIXEL1_CLK_SRC>;
	assigned-clock-parents = <&mdss0_dp1_phy 0>,
				 <&mdss0_dp1_phy 1>,
				 <&mdss0_dp1_phy 1>;
	phys = <&mdss0_dp1_phy>;
	phy-names = "dp";

	operating-points-v2 = <&dp_opp_table>;
	power-domains = <&rpmhpd SA8775P_MMCX>;
};

&mdss0_dsi0 {
	clocks = <&dispcc0 MDSS_DISP_CC_MDSS_BYTE0_CLK>,
		 <&dispcc0 MDSS_DISP_CC_MDSS_BYTE0_INTF_CLK>,
		 <&dispcc0 MDSS_DISP_CC_MDSS_PCLK0_CLK>,
		 <&dispcc0 MDSS_DISP_CC_MDSS_ESC0_CLK>,
		 <&dispcc0 MDSS_DISP_CC_MDSS_AHB_CLK>,
		 <&gcc GCC_DISP_HF_AXI_CLK>;
	clock-names = "byte",
		      "byte_intf",
		      "pixel",
		      "core",
		      "iface",
		      "bus";
	assigned-clocks = <&dispcc0 MDSS_DISP_CC_MDSS_BYTE0_CLK_SRC>,
			  <&dispcc0 MDSS_DISP_CC_MDSS_PCLK0_CLK_SRC>;
	assigned-clock-parents = <&mdss0_dsi0_phy DSI_BYTE_PLL_CLK>,
				 <&mdss0_dsi0_phy DSI_PIXEL_PLL_CLK>;
	phys = <&mdss0_dsi0_phy>;

	operating-points-v2 = <&mdss_dsi_opp_table>;
	power-domains = <&rpmhpd SA8775P_MMCX>;

	refgen-supply = <&refgen>;

	mdss_dsi_opp_table: opp-table {
		compatible = "operating-points-v2";

		opp-358000000 {
			opp-hz = /bits/ 64 <358000000>;
			required-opps = <&rpmhpd_opp_svs_l1>;
		};
	};
};

&mdss0_dsi1 {
	clocks = <&dispcc0 MDSS_DISP_CC_MDSS_BYTE1_CLK>,
		 <&dispcc0 MDSS_DISP_CC_MDSS_BYTE1_INTF_CLK>,
		 <&dispcc0 MDSS_DISP_CC_MDSS_PCLK1_CLK>,
		 <&dispcc0 MDSS_DISP_CC_MDSS_ESC1_CLK>,
		 <&dispcc0 MDSS_DISP_CC_MDSS_AHB_CLK>,
		 <&gcc GCC_DISP_HF_AXI_CLK>;
	clock-names = "byte",
		      "byte_intf",
		      "pixel",
		      "core",
		      "iface",
		      "bus";
	assigned-clocks = <&dispcc0 MDSS_DISP_CC_MDSS_BYTE1_CLK_SRC>,
			  <&dispcc0 MDSS_DISP_CC_MDSS_PCLK1_CLK_SRC>;
	assigned-clock-parents = <&mdss0_dsi1_phy DSI_BYTE_PLL_CLK>,
				 <&mdss0_dsi1_phy DSI_PIXEL_PLL_CLK>;
	phys = <&mdss0_dsi1_phy>;

	operating-points-v2 = <&mdss_dsi_opp_table>;
	power-domains = <&rpmhpd SA8775P_MMCX>;

	refgen-supply = <&refgen>;
};

&mdss0_mdp {
	clocks = <&gcc GCC_DISP_HF_AXI_CLK>,
		 <&dispcc0 MDSS_DISP_CC_MDSS_AHB_CLK>,
		 <&dispcc0 MDSS_DISP_CC_MDSS_MDP_LUT_CLK>,
		 <&dispcc0 MDSS_DISP_CC_MDSS_MDP_CLK>,
		 <&dispcc0 MDSS_DISP_CC_MDSS_VSYNC_CLK>;
	clock-names = "nrt_bus",
		      "iface",
		      "lut",
		      "core",
		      "vsync";

	assigned-clocks = <&dispcc0 MDSS_DISP_CC_MDSS_VSYNC_CLK>;
	assigned-clock-rates = <19200000>;

	operating-points-v2 = <&mdss0_mdp_opp_table>;
	power-domains = <&rpmhpd SA8775P_MMCX>;

	mdss0_mdp_opp_table: opp-table {
		compatible = "operating-points-v2";

		opp-375000000 {
			opp-hz = /bits/ 64 <375000000>;
			required-opps = <&rpmhpd_opp_svs_l1>;
		};

		opp-500000000 {
			opp-hz = /bits/ 64 <500000000>;
			required-opps = <&rpmhpd_opp_nom>;
		};

		opp-575000000 {
			opp-hz = /bits/ 64 <575000000>;
			required-opps = <&rpmhpd_opp_turbo>;
		};

		opp-650000000 {
			opp-hz = /bits/ 64 <650000000>;
			required-opps = <&rpmhpd_opp_turbo_l1>;
		};
	};
};

&mdss1 {
	interconnects = <&mmss_noc MASTER_MDP_CORE1_0 QCOM_ICC_TAG_ALWAYS
			 &mc_virt SLAVE_EBI1 QCOM_ICC_TAG_ALWAYS>,
			<&mmss_noc MASTER_MDP_CORE1_1 QCOM_ICC_TAG_ALWAYS
			 &mc_virt SLAVE_EBI1 QCOM_ICC_TAG_ALWAYS>,
			<&gem_noc MASTER_APPSS_PROC QCOM_ICC_TAG_ACTIVE_ONLY
			 &config_noc SLAVE_DISPLAY_CFG QCOM_ICC_TAG_ACTIVE_ONLY>;
	interconnect-names = "mdp0-mem",
			     "mdp1-mem",
			     "cpu-cfg";

	resets = <&dispcc1 MDSS_DISP_CC_MDSS_CORE_BCR>;

	power-domains = <&dispcc1 MDSS_DISP_CC_MDSS_CORE_GDSC>;

	clocks = <&dispcc1 MDSS_DISP_CC_MDSS_AHB_CLK>,
		 <&gcc GCC_DISP1_HF_AXI_CLK>,
		 <&dispcc1 MDSS_DISP_CC_MDSS_MDP_CLK>;

	mdss1_dp0_phy: phy@220c2a00 {
		compatible = "qcom,sa8775p-edp-phy";
		reg = <0x0 0x220c2a00 0x0 0x200>,
		      <0x0 0x220c2200 0x0 0xd0>,
		      <0x0 0x220c2600 0x0 0xd0>,
		      <0x0 0x220c2000 0x0 0x1c8>;

		clocks = <&dispcc1 MDSS_DISP_CC_MDSS_DPTX0_AUX_CLK>,
			 <&dispcc1 MDSS_DISP_CC_MDSS_AHB_CLK>,
			 <&gcc GCC_EDP_REF_CLKREF_EN>;
		clock-names = "aux",
			      "cfg_ahb",
			      "ref";

		#clock-cells = <1>;
		#phy-cells = <0>;

		status = "disabled";
	};

	mdss1_dp1_phy: phy@220c5a00 {
		compatible = "qcom,sa8775p-edp-phy";
		reg = <0x0 0x220c5a00 0x0 0x200>,
		      <0x0 0x220c5200 0x0 0xd0>,
		      <0x0 0x220c5600 0x0 0xd0>,
		      <0x0 0x220c5000 0x0 0x1c8>;

		clocks = <&dispcc1 MDSS_DISP_CC_MDSS_DPTX1_AUX_CLK>,
			 <&dispcc1 MDSS_DISP_CC_MDSS_AHB_CLK>,
			 <&gcc GCC_EDP_REF_CLKREF_EN>;
		clock-names = "aux",
			      "cfg_ahb",
			      "ref";

		#clock-cells = <1>;
		#phy-cells = <0>;

		status = "disabled";
	};
};

&mdss1_dp0 {
	clocks = <&dispcc1 MDSS_DISP_CC_MDSS_AHB_CLK>,
		 <&dispcc1 MDSS_DISP_CC_MDSS_DPTX0_AUX_CLK>,
		 <&dispcc1 MDSS_DISP_CC_MDSS_DPTX0_LINK_CLK>,
		 <&dispcc1 MDSS_DISP_CC_MDSS_DPTX0_LINK_INTF_CLK>,
		 <&dispcc1 MDSS_DISP_CC_MDSS_DPTX0_PIXEL0_CLK>,
		 <&dispcc1 MDSS_DISP_CC_MDSS_DPTX0_PIXEL1_CLK>,
		 <&dispcc1 MDSS_DISP_CC_MDSS_DPTX0_PIXEL2_CLK>,
		 <&dispcc1 MDSS_DISP_CC_MDSS_DPTX0_PIXEL3_CLK>;
	clock-names = "core_iface",
		      "core_aux",
		      "ctrl_link",
		      "ctrl_link_iface",
		      "stream_pixel",
		      "stream_1_pixel",
		      "stream_2_pixel",
		      "stream_3_pixel";
	assigned-clocks = <&dispcc1 MDSS_DISP_CC_MDSS_DPTX0_LINK_CLK_SRC>,
			  <&dispcc1 MDSS_DISP_CC_MDSS_DPTX0_PIXEL0_CLK_SRC>,
			  <&dispcc1 MDSS_DISP_CC_MDSS_DPTX0_PIXEL1_CLK_SRC>,
			  <&dispcc1 MDSS_DISP_CC_MDSS_DPTX0_PIXEL2_CLK_SRC>,
			  <&dispcc1 MDSS_DISP_CC_MDSS_DPTX0_PIXEL3_CLK_SRC>;
	assigned-clock-parents = <&mdss1_dp0_phy 0>,
				 <&mdss1_dp0_phy 1>,
				 <&mdss1_dp0_phy 1>,
				 <&mdss1_dp0_phy 1>,
				 <&mdss1_dp0_phy 1>;
	phys = <&mdss1_dp0_phy>;
	phy-names = "dp";

	operating-points-v2 = <&dp_opp_table>;
	power-domains = <&rpmhpd SA8775P_MMCX>;
};

&mdss1_dp1 {
	clocks = <&dispcc1 MDSS_DISP_CC_MDSS_AHB_CLK>,
		 <&dispcc1 MDSS_DISP_CC_MDSS_DPTX1_AUX_CLK>,
		 <&dispcc1 MDSS_DISP_CC_MDSS_DPTX1_LINK_CLK>,
		 <&dispcc1 MDSS_DISP_CC_MDSS_DPTX1_LINK_INTF_CLK>,
		 <&dispcc1 MDSS_DISP_CC_MDSS_DPTX1_PIXEL0_CLK>,
		 <&dispcc1 MDSS_DISP_CC_MDSS_DPTX1_PIXEL1_CLK>;
	clock-names = "core_iface",
		      "core_aux",
		      "ctrl_link",
		      "ctrl_link_iface",
		      "stream_pixel",
		      "stream_1_pixel";
	assigned-clocks = <&dispcc1 MDSS_DISP_CC_MDSS_DPTX1_LINK_CLK_SRC>,
			  <&dispcc1 MDSS_DISP_CC_MDSS_DPTX1_PIXEL0_CLK_SRC>,
			  <&dispcc1 MDSS_DISP_CC_MDSS_DPTX1_PIXEL1_CLK_SRC>;
	assigned-clock-parents = <&mdss1_dp1_phy 0>,
				 <&mdss1_dp1_phy 1>,
				 <&mdss1_dp1_phy 1>;
	phys = <&mdss1_dp1_phy>;
	phy-names = "dp";

	operating-points-v2 = <&dp_opp_table>;
	power-domains = <&rpmhpd SA8775P_MMCX>;
};

&mdss1_mdp {
	clocks = <&gcc GCC_DISP1_HF_AXI_CLK>,
		 <&dispcc1 MDSS_DISP_CC_MDSS_AHB_CLK>,
		 <&dispcc1 MDSS_DISP_CC_MDSS_MDP_LUT_CLK>,
		 <&dispcc1 MDSS_DISP_CC_MDSS_MDP_CLK>,
		 <&dispcc1 MDSS_DISP_CC_MDSS_VSYNC_CLK>;
	clock-names = "nrt_bus",
		      "iface",
		      "lut",
		      "core",
		      "vsync";

	assigned-clocks = <&dispcc1 MDSS_DISP_CC_MDSS_VSYNC_CLK>;
	assigned-clock-rates = <19200000>;

	operating-points-v2 = <&mdss0_mdp_opp_table>;
	power-domains = <&rpmhpd SA8775P_MMCX>;
};

&pcie0 {
	clocks = <&gcc GCC_PCIE_0_AUX_CLK>,
		 <&gcc GCC_PCIE_0_CFG_AHB_CLK>,
		 <&gcc GCC_PCIE_0_MSTR_AXI_CLK>,
		 <&gcc GCC_PCIE_0_SLV_AXI_CLK>,
		 <&gcc GCC_PCIE_0_SLV_Q2A_AXI_CLK>;
	clock-names = "aux",
		      "cfg",
		      "bus_master",
		      "bus_slave",
		      "slave_q2a";

	assigned-clocks = <&gcc GCC_PCIE_0_AUX_CLK>;
	assigned-clock-rates = <19200000>;

	interconnects = <&pcie_anoc MASTER_PCIE_0 0 &mc_virt SLAVE_EBI1 0>,
			<&gem_noc MASTER_APPSS_PROC 0 &config_noc SLAVE_PCIE_0 0>;
	interconnect-names = "pcie-mem", "cpu-pcie";

	resets = <&gcc GCC_PCIE_0_BCR>,
		 <&gcc GCC_PCIE_0_LINK_DOWN_BCR>;
	reset-names = "pci",
		      "link_down";

	power-domains = <&gcc PCIE_0_GDSC>;

	linux,pci-domain = <0>;
};

&pcie0_ep {
	clocks = <&gcc GCC_PCIE_0_AUX_CLK>,
		<&gcc GCC_PCIE_0_CFG_AHB_CLK>,
		<&gcc GCC_PCIE_0_MSTR_AXI_CLK>,
		<&gcc GCC_PCIE_0_SLV_AXI_CLK>,
		<&gcc GCC_PCIE_0_SLV_Q2A_AXI_CLK>;
	clock-names = "aux",
		      "cfg",
		      "bus_master",
		      "bus_slave",
		      "slave_q2a";

	interconnects = <&pcie_anoc MASTER_PCIE_0 0 &mc_virt SLAVE_EBI1 0>,
			<&gem_noc MASTER_APPSS_PROC 0 &config_noc SLAVE_PCIE_0 0>;
	interconnect-names = "pcie-mem", "cpu-pcie";

	resets = <&gcc GCC_PCIE_0_BCR>;
	reset-names = "core";

	power-domains = <&gcc PCIE_0_GDSC>;

	phys = <&pcie0_phy>;
	phy-names = "pciephy";

	linux,pci-domain = <0>;
};

&pcie1 {
	clocks = <&gcc GCC_PCIE_1_AUX_CLK>,
		 <&gcc GCC_PCIE_1_CFG_AHB_CLK>,
		 <&gcc GCC_PCIE_1_MSTR_AXI_CLK>,
		 <&gcc GCC_PCIE_1_SLV_AXI_CLK>,
		 <&gcc GCC_PCIE_1_SLV_Q2A_AXI_CLK>;
	clock-names = "aux",
		      "cfg",
		      "bus_master",
		      "bus_slave",
		      "slave_q2a";

	assigned-clocks = <&gcc GCC_PCIE_1_AUX_CLK>;
	assigned-clock-rates = <19200000>;

	interconnects = <&pcie_anoc MASTER_PCIE_1 0 &mc_virt SLAVE_EBI1 0>,
			<&gem_noc MASTER_APPSS_PROC 0 &config_noc SLAVE_PCIE_1 0>;
	interconnect-names = "pcie-mem", "cpu-pcie";

	resets = <&gcc GCC_PCIE_1_BCR>,
		 <&gcc GCC_PCIE_1_LINK_DOWN_BCR>;
	reset-names = "pci",
		      "link_down";

	power-domains = <&gcc PCIE_1_GDSC>;

	linux,pci-domain = <1>;
};

&pcie1_ep {
	clocks = <&gcc GCC_PCIE_1_AUX_CLK>,
		 <&gcc GCC_PCIE_1_CFG_AHB_CLK>,
		 <&gcc GCC_PCIE_1_MSTR_AXI_CLK>,
		 <&gcc GCC_PCIE_1_SLV_AXI_CLK>,
		 <&gcc GCC_PCIE_1_SLV_Q2A_AXI_CLK>;
	clock-names = "aux",
		      "cfg",
		      "bus_master",
		      "bus_slave",
		      "slave_q2a";

	interconnects = <&pcie_anoc MASTER_PCIE_1 0 &mc_virt SLAVE_EBI1 0>,
			<&gem_noc MASTER_APPSS_PROC 0 &config_noc SLAVE_PCIE_1 0>;
	interconnect-names = "pcie-mem", "cpu-pcie";

	resets = <&gcc GCC_PCIE_1_BCR>;
	reset-names = "core";

	power-domains = <&gcc PCIE_1_GDSC>;

	phys = <&pcie1_phy>;
	phy-names = "pciephy";

	linux,pci-domain = <1>;
};

&pcie1_port0 {
	phys = <&pcie1_phy>;
};

&pcieport0 {
	phys = <&pcie0_phy>;
};

&qupv3_id_0 {
	clock-names = "m-ahb", "s-ahb";
	clocks = <&gcc GCC_QUPV3_WRAP_0_M_AHB_CLK>,
		 <&gcc GCC_QUPV3_WRAP_0_S_AHB_CLK>;
};

&qupv3_id_1 {
	clock-names = "m-ahb", "s-ahb";
	clocks = <&gcc GCC_QUPV3_WRAP_1_M_AHB_CLK>,
		 <&gcc GCC_QUPV3_WRAP_1_S_AHB_CLK>;
};

&qupv3_id_2 {
	clocks = <&gcc GCC_QUPV3_WRAP_2_M_AHB_CLK>,
		 <&gcc GCC_QUPV3_WRAP_2_S_AHB_CLK>;
	clock-names = "m-ahb", "s-ahb";
};

&qupv3_id_3 {
	clock-names = "m-ahb", "s-ahb";
	clocks = <&gcc GCC_QUPV3_WRAP_3_M_AHB_CLK>,
		 <&gcc GCC_QUPV3_WRAP_3_S_AHB_CLK>;
};

&remoteproc_adsp {
	clocks = <&rpmhcc RPMH_CXO_CLK>;
	clock-names = "xo";

	power-domains = <&rpmhpd SA8775P_LCX>,
			<&rpmhpd SA8775P_LMX>;
	power-domain-names = "lcx", "lmx";

	interconnects = <&lpass_ag_noc MASTER_LPASS_PROC 0
			 &mc_virt SLAVE_EBI1 0>;

};

&remoteproc_cdsp0 {
	clocks = <&rpmhcc RPMH_CXO_CLK>;
	clock-names = "xo";

	power-domains = <&rpmhpd SA8775P_CX>,
			<&rpmhpd SA8775P_MXC>,
			<&rpmhpd SA8775P_NSP0>;
	power-domain-names = "cx", "mxc", "nsp";

	interconnects = <&nspa_noc MASTER_CDSP_PROC 0
			 &mc_virt SLAVE_EBI1 0>;
};

&remoteproc_cdsp1 {
	clocks = <&rpmhcc RPMH_CXO_CLK>;
	clock-names = "xo";

	power-domains = <&rpmhpd SA8775P_CX>,
			<&rpmhpd SA8775P_MXC>,
			<&rpmhpd SA8775P_NSP1>;
	power-domain-names = "cx", "mxc", "nsp";

	interconnects = <&nspb_noc MASTER_CDSP_PROC_B 0
			 &mc_virt SLAVE_EBI1 0>;
};

&remoteproc_gpdsp0 {
	clocks = <&rpmhcc RPMH_CXO_CLK>;
	clock-names = "xo";

	power-domains = <&rpmhpd SA8775P_CX>,
			<&rpmhpd SA8775P_MXC>;
	power-domain-names = "cx", "mxc";

	interconnects = <&gpdsp_anoc MASTER_DSP0 0
			 &config_noc SLAVE_CLK_CTL 0>;
};

&remoteproc_gpdsp1 {
	clocks = <&rpmhcc RPMH_CXO_CLK>;
	clock-names = "xo";

	power-domains = <&rpmhpd SA8775P_CX>,
			<&rpmhpd SA8775P_MXC>;
	power-domain-names = "cx", "mxc";

	interconnects = <&gpdsp_anoc MASTER_DSP1 0
			 &config_noc SLAVE_CLK_CTL 0>;
};

&sdhc {
	clocks = <&gcc GCC_SDCC1_AHB_CLK>,
		 <&gcc GCC_SDCC1_APPS_CLK>;
	clock-names = "iface",
		      "core";

	interconnects = <&aggre1_noc MASTER_SDC QCOM_ICC_TAG_ALWAYS
			 &mc_virt SLAVE_EBI1 QCOM_ICC_TAG_ALWAYS>,
			<&gem_noc MASTER_APPSS_PROC QCOM_ICC_TAG_ACTIVE_ONLY
			 &config_noc SLAVE_SDC1 QCOM_ICC_TAG_ACTIVE_ONLY>;
	interconnect-names = "sdhc-ddr",
			     "cpu-sdhc";

	operating-points-v2 = <&sdhc_opp_table>;
	power-domains = <&rpmhpd SA8775P_CX>;
	resets = <&gcc GCC_SDCC1_BCR>;

	sdhc_opp_table: opp-table {
		compatible = "operating-points-v2";

		opp-100000000 {
			opp-hz = /bits/ 64 <100000000>;
			required-opps = <&rpmhpd_opp_low_svs>;
			opp-peak-kBps = <1800000 400000>;
			opp-avg-kBps = <100000 0>;
		};

		opp-384000000 {
			opp-hz = /bits/ 64 <384000000>;
			required-opps = <&rpmhpd_opp_nom>;
			opp-peak-kBps = <5400000 1600000>;
			opp-avg-kBps = <390000 0>;
		};
	};
};

&soc {
	gcc: clock-controller@100000 {
		compatible = "qcom,sa8775p-gcc";
		reg = <0x0 0x00100000 0x0 0xc7018>;
		#clock-cells = <1>;
		#reset-cells = <1>;
		#power-domain-cells = <1>;
		clocks = <&rpmhcc RPMH_CXO_CLK>,
			 <&sleep_clk>,
			 <0>,
			 <0>,
			 <0>,
			 <&usb_0_qmpphy>,
			 <&usb_1_qmpphy>,
			 <0>,
			 <0>,
			 <0>,
			 <&pcie0_phy>,
			 <&pcie1_phy>,
			 <0>,
			 <0>,
			 <0>;
		power-domains = <&rpmhpd SA8775P_CX>;
	};

	config_noc: interconnect@14c0000 {
		compatible = "qcom,sa8775p-config-noc";
		reg = <0x0 0x014c0000 0x0 0x13080>;
		#interconnect-cells = <2>;
		qcom,bcm-voters = <&apps_bcm_voter>;
	};

	system_noc: interconnect@1680000 {
		compatible = "qcom,sa8775p-system-noc";
		reg = <0x0 0x01680000 0x0 0x15080>;
		#interconnect-cells = <2>;
		qcom,bcm-voters = <&apps_bcm_voter>;
	};

	aggre1_noc: interconnect@16c0000 {
		compatible = "qcom,sa8775p-aggre1-noc";
		reg = <0x0 0x016c0000 0x0 0x18080>;
		#interconnect-cells = <2>;
		qcom,bcm-voters = <&apps_bcm_voter>;
		clocks = <&gcc GCC_AGGRE_UFS_PHY_AXI_CLK>,
			 <&gcc GCC_AGGRE_NOC_QUPV3_AXI_CLK>,
			 <&gcc GCC_AGGRE_USB2_PRIM_AXI_CLK>,
			 <&gcc GCC_AGGRE_USB3_PRIM_AXI_CLK>,
			 <&gcc GCC_AGGRE_USB3_SEC_AXI_CLK>;
	};

	aggre2_noc: interconnect@1700000 {
		compatible = "qcom,sa8775p-aggre2-noc";
		reg = <0x0 0x01700000 0x0 0x1b080>;
		#interconnect-cells = <2>;
		qcom,bcm-voters = <&apps_bcm_voter>;
		clocks = <&gcc GCC_AGGRE_UFS_CARD_AXI_CLK>,
			 <&rpmhcc RPMH_IPA_CLK>;
	};

	pcie_anoc: interconnect@1760000 {
		compatible = "qcom,sa8775p-pcie-anoc";
		reg = <0x0 0x01760000 0x0 0xc080>;
		#interconnect-cells = <2>;
		qcom,bcm-voters = <&apps_bcm_voter>;
	};

	gpdsp_anoc: interconnect@1780000 {
		compatible = "qcom,sa8775p-gpdsp-anoc";
		reg = <0x0 0x01780000 0x0 0xe080>;
		#interconnect-cells = <2>;
		qcom,bcm-voters = <&apps_bcm_voter>;
	};

	mmss_noc: interconnect@17a0000 {
		compatible = "qcom,sa8775p-mmss-noc";
		reg = <0x0 0x017a0000 0x0 0x40000>;
		#interconnect-cells = <2>;
		qcom,bcm-voters = <&apps_bcm_voter>;
	};

	pcie0_phy: phy@1c04000 {
		compatible = "qcom,sa8775p-qmp-gen4x2-pcie-phy";
		reg = <0x0 0x1c04000 0x0 0x2000>;

		clocks = <&gcc GCC_PCIE_0_PHY_AUX_CLK>,
			 <&gcc GCC_PCIE_0_CFG_AHB_CLK>,
			 <&gcc GCC_PCIE_CLKREF_EN>,
			 <&gcc GCC_PCIE_0_PHY_RCHNG_CLK>,
			 <&gcc GCC_PCIE_0_PIPE_CLK>,
			 <&gcc GCC_PCIE_0_PIPEDIV2_CLK>;
		clock-names = "aux",
			      "cfg_ahb",
			      "ref",
			      "rchng",
			      "pipe",
			      "pipediv2";

		assigned-clocks = <&gcc GCC_PCIE_0_PHY_RCHNG_CLK>;
		assigned-clock-rates = <100000000>;

		resets = <&gcc GCC_PCIE_0_PHY_BCR>;
		reset-names = "phy";

		#clock-cells = <0>;
		clock-output-names = "pcie_0_pipe_clk";

		#phy-cells = <0>;

		status = "disabled";
	};

	pcie1_phy: phy@1c14000 {
		compatible = "qcom,sa8775p-qmp-gen4x4-pcie-phy";
		reg = <0x0 0x1c14000 0x0 0x4000>;

		clocks = <&gcc GCC_PCIE_1_PHY_AUX_CLK>,
			 <&gcc GCC_PCIE_1_CFG_AHB_CLK>,
			 <&gcc GCC_PCIE_CLKREF_EN>,
			 <&gcc GCC_PCIE_1_PHY_RCHNG_CLK>,
			 <&gcc GCC_PCIE_1_PIPE_CLK>,
			 <&gcc GCC_PCIE_1_PIPEDIV2_CLK>;
		clock-names = "aux",
			      "cfg_ahb",
			      "ref",
			      "rchng",
			      "pipe",
			      "pipediv2";

		assigned-clocks = <&gcc GCC_PCIE_1_PHY_RCHNG_CLK>;
		assigned-clock-rates = <100000000>;

		resets = <&gcc GCC_PCIE_1_PHY_BCR>;
		reset-names = "phy";

		#clock-cells = <0>;
		clock-output-names = "pcie_1_pipe_clk";

		#phy-cells = <0>;

		status = "disabled";
	};

	ufs_mem_phy: phy@1d87000 {
		compatible = "qcom,sa8775p-qmp-ufs-phy";
		reg = <0x0 0x01d87000 0x0 0xe10>;
		/*
		 * Yes, GCC_EDP_REF_CLKREF_EN is correct in qref. It
		 * enables the CXO clock to eDP *and* UFS PHY.
		 */
		clocks = <&rpmhcc RPMH_CXO_CLK>,
			 <&gcc GCC_UFS_PHY_PHY_AUX_CLK>,
			 <&gcc GCC_EDP_REF_CLKREF_EN>;
		clock-names = "ref", "ref_aux", "qref";
		power-domains = <&gcc UFS_PHY_GDSC>;
		resets = <&ufs_mem_hc 0>;
		reset-names = "ufsphy";
		#phy-cells = <0>;
		status = "disabled";
	};

	ice: crypto@1d88000 {
		compatible = "qcom,sa8775p-inline-crypto-engine",
			     "qcom,inline-crypto-engine";
		reg = <0x0 0x01d88000 0x0 0x18000>;
		clocks = <&gcc GCC_UFS_PHY_ICE_CORE_CLK>,
			 <&gcc GCC_UFS_PHY_AHB_CLK>;
		clock-names = "core",
			      "iface";
		power-domains = <&gcc UFS_PHY_GDSC>;
	};

	lpass_ag_noc: interconnect@3c40000 {
		compatible = "qcom,sa8775p-lpass-ag-noc";
		reg = <0x0 0x03c40000 0x0 0x17200>;
		#interconnect-cells = <2>;
		qcom,bcm-voters = <&apps_bcm_voter>;
	};

	usb_0_hsphy: phy@88e4000 {
		compatible = "qcom,sa8775p-usb-hs-phy",
			     "qcom,usb-snps-hs-5nm-phy";
		reg = <0 0x088e4000 0 0x120>;
		clocks = <&rpmhcc RPMH_CXO_CLK>;
		clock-names = "ref";
		resets = <&gcc GCC_USB2_PHY_PRIM_BCR>;

		#phy-cells = <0>;

		status = "disabled";
	};

	usb_1_hsphy: phy@88e6000 {
		compatible = "qcom,sa8775p-usb-hs-phy",
			     "qcom,usb-snps-hs-5nm-phy";
		reg = <0 0x088e6000 0 0x120>;
		clocks = <&gcc GCC_USB_CLKREF_EN>;
		clock-names = "ref";
		resets = <&gcc GCC_USB2_PHY_SEC_BCR>;

		#phy-cells = <0>;

		status = "disabled";
	};

	usb_2_hsphy: phy@88e7000 {
		compatible = "qcom,sa8775p-usb-hs-phy",
			     "qcom,usb-snps-hs-5nm-phy";
		reg = <0 0x088e7000 0 0x120>;
		clocks = <&gcc GCC_USB_CLKREF_EN>;
		clock-names = "ref";
		resets = <&gcc GCC_USB3_PHY_TERT_BCR>;

		#phy-cells = <0>;

		status = "disabled";
	};

	usb_0_qmpphy: phy@88e8000 {
		compatible = "qcom,sa8775p-qmp-usb3-uni-phy";
		reg = <0 0x088e8000 0 0x2000>;

		clocks = <&gcc GCC_USB3_PRIM_PHY_AUX_CLK>,
			 <&gcc GCC_USB_CLKREF_EN>,
			 <&gcc GCC_USB3_PRIM_PHY_COM_AUX_CLK>,
			 <&gcc GCC_USB3_PRIM_PHY_PIPE_CLK>;
		clock-names = "aux", "ref", "com_aux", "pipe";

		resets = <&gcc GCC_USB3_PHY_PRIM_BCR>,
			 <&gcc GCC_USB3PHY_PHY_PRIM_BCR>;
		reset-names = "phy", "phy_phy";

		power-domains = <&gcc USB30_PRIM_GDSC>;

		#clock-cells = <0>;
		clock-output-names = "usb3_prim_phy_pipe_clk_src";

		#phy-cells = <0>;

		status = "disabled";
	};

	usb_1_qmpphy: phy@88ea000 {
		compatible = "qcom,sa8775p-qmp-usb3-uni-phy";
		reg = <0 0x088ea000 0 0x2000>;

		clocks = <&gcc GCC_USB3_SEC_PHY_AUX_CLK>,
			 <&gcc GCC_USB_CLKREF_EN>,
			 <&gcc GCC_USB3_SEC_PHY_COM_AUX_CLK>,
			 <&gcc GCC_USB3_SEC_PHY_PIPE_CLK>;
		clock-names = "aux", "ref", "com_aux", "pipe";

		resets = <&gcc GCC_USB3_PHY_SEC_BCR>,
			 <&gcc GCC_USB3PHY_PHY_SEC_BCR>;
		reset-names = "phy", "phy_phy";

		power-domains = <&gcc USB30_SEC_GDSC>;

		#clock-cells = <0>;
		clock-output-names = "usb3_sec_phy_pipe_clk_src";

		#phy-cells = <0>;

		status = "disabled";
	};

	refgen: regulator@891c000 {
		compatible = "qcom,sa8775p-refgen-regulator",
			     "qcom,sm8250-refgen-regulator";
		reg = <0x0 0x0891c000 0x0 0x84>;
	};

	dc_noc: interconnect@90e0000 {
		compatible = "qcom,sa8775p-dc-noc";
		reg = <0x0 0x090e0000 0x0 0x5080>;
		#interconnect-cells = <2>;
		qcom,bcm-voters = <&apps_bcm_voter>;
	};

	gem_noc: interconnect@9100000 {
		compatible = "qcom,sa8775p-gem-noc";
		reg = <0x0 0x09100000 0x0 0xf6080>;
		#interconnect-cells = <2>;
		qcom,bcm-voters = <&apps_bcm_voter>;
	};

	gpucc: clock-controller@3d90000 {
		compatible = "qcom,sa8775p-gpucc";
		reg = <0x0 0x03d90000 0x0 0xa000>;
		clocks = <&rpmhcc RPMH_CXO_CLK>,
			 <&gcc GCC_GPU_GPLL0_CLK_SRC>,
			 <&gcc GCC_GPU_GPLL0_DIV_CLK_SRC>;
		clock-names = "bi_tcxo",
			      "gcc_gpu_gpll0_clk_src",
			      "gcc_gpu_gpll0_div_clk_src";
		#clock-cells = <1>;
		#reset-cells = <1>;
		#power-domain-cells = <1>;
	};

	serdes0: phy@8901000 {
		compatible = "qcom,sa8775p-dwmac-sgmii-phy";
		reg = <0x0 0x08901000 0x0 0xe10>;
		clocks = <&gcc GCC_SGMI_CLKREF_EN>;
		clock-names = "sgmi_ref";
		#phy-cells = <0>;
		status = "disabled";
	};

	serdes1: phy@8902000 {
		compatible = "qcom,sa8775p-dwmac-sgmii-phy";
		reg = <0x0 0x08902000 0x0 0xe10>;
		clocks = <&gcc GCC_SGMI_CLKREF_EN>;
		clock-names = "sgmi_ref";
		#phy-cells = <0>;
		status = "disabled";
	};

	videocc: clock-controller@abf0000 {
		compatible = "qcom,sa8775p-videocc";
		reg = <0x0 0x0abf0000 0x0 0x10000>;
		clocks = <&gcc GCC_VIDEO_AHB_CLK>,
			 <&rpmhcc RPMH_CXO_CLK>,
			 <&rpmhcc RPMH_CXO_CLK_A>,
			 <&sleep_clk>;
		power-domains = <&rpmhpd SA8775P_MMCX>;
		#clock-cells = <1>;
		#reset-cells = <1>;
		#power-domain-cells = <1>;
	};

	camcc: clock-controller@ade0000 {
		compatible = "qcom,sa8775p-camcc";
		reg = <0x0 0x0ade0000 0x0 0x20000>;
		clocks = <&gcc GCC_CAMERA_AHB_CLK>,
			 <&rpmhcc RPMH_CXO_CLK>,
			 <&rpmhcc RPMH_CXO_CLK_A>,
			 <&sleep_clk>;
		power-domains = <&rpmhpd SA8775P_MMCX>;
		#clock-cells = <1>;
		#reset-cells = <1>;
		#power-domain-cells = <1>;
	};

	dispcc0: clock-controller@af00000 {
		compatible = "qcom,sa8775p-dispcc0";
		reg = <0x0 0x0af00000 0x0 0x20000>;
		clocks = <&gcc GCC_DISP_AHB_CLK>,
			 <&rpmhcc RPMH_CXO_CLK>,
			 <&rpmhcc RPMH_CXO_CLK_A>,
			 <&sleep_clk>,
			 <&mdss0_dp0_phy 0>, <&mdss0_dp0_phy 1>,
			 <&mdss0_dp1_phy 0>, <&mdss0_dp1_phy 1>,
			 <&mdss0_dsi0_phy DSI_BYTE_PLL_CLK>,
			 <&mdss0_dsi0_phy DSI_PIXEL_PLL_CLK>,
			 <&mdss0_dsi1_phy DSI_BYTE_PLL_CLK>,
			 <&mdss0_dsi1_phy DSI_PIXEL_PLL_CLK>;
		power-domains = <&rpmhpd SA8775P_MMCX>;
		#clock-cells = <1>;
		#reset-cells = <1>;
		#power-domain-cells = <1>;
	};

	apps_rsc: rsc@18200000 {
		compatible = "qcom,rpmh-rsc";
		reg = <0x0 0x18200000 0x0 0x10000>,
		      <0x0 0x18210000 0x0 0x10000>,
		      <0x0 0x18220000 0x0 0x10000>;
		reg-names = "drv-0", "drv-1", "drv-2";
		interrupts = <GIC_SPI 3 IRQ_TYPE_LEVEL_HIGH>,
		      <GIC_SPI 4 IRQ_TYPE_LEVEL_HIGH>,
		      <GIC_SPI 5 IRQ_TYPE_LEVEL_HIGH>;
		qcom,tcs-offset = <0xd00>;
		qcom,drv-id = <2>;
		qcom,tcs-config = <ACTIVE_TCS 2>,
				  <SLEEP_TCS 3>,
				  <WAKE_TCS 3>,
				  <CONTROL_TCS 0>;
		label = "apps_rsc";
		power-domains = <&system_pd>;

		apps_bcm_voter: bcm-voter {
			compatible = "qcom,bcm-voter";
		};

		rpmhcc: clock-controller {
			compatible = "qcom,sa8775p-rpmh-clk";
			#clock-cells = <1>;
			clock-names = "xo";
			clocks = <&xo_board_clk>;
		};

		rpmhpd: power-controller {
			compatible = "qcom,sa8775p-rpmhpd";
			#power-domain-cells = <1>;
			operating-points-v2 = <&rpmhpd_opp_table>;

			rpmhpd_opp_table: opp-table {
				compatible = "operating-points-v2";

				rpmhpd_opp_ret: opp-0 {
					opp-level = <RPMH_REGULATOR_LEVEL_RETENTION>;
				};

				rpmhpd_opp_min_svs: opp-1 {
					opp-level = <RPMH_REGULATOR_LEVEL_MIN_SVS>;
				};

				rpmhpd_opp_low_svs: opp-2 {
					opp-level = <RPMH_REGULATOR_LEVEL_LOW_SVS>;
				};

				rpmhpd_opp_svs: opp-3 {
					opp-level = <RPMH_REGULATOR_LEVEL_SVS>;
				};

				rpmhpd_opp_svs_l1: opp-4 {
					opp-level = <RPMH_REGULATOR_LEVEL_SVS_L1>;
				};

				rpmhpd_opp_nom: opp-5 {
					opp-level = <RPMH_REGULATOR_LEVEL_NOM>;
				};

				rpmhpd_opp_nom_l1: opp-6 {
					opp-level = <RPMH_REGULATOR_LEVEL_NOM_L1>;
				};

				rpmhpd_opp_nom_l2: opp-7 {
					opp-level = <RPMH_REGULATOR_LEVEL_NOM_L2>;
				};

				rpmhpd_opp_turbo: opp-8 {
					opp-level = <RPMH_REGULATOR_LEVEL_TURBO>;
				};

				rpmhpd_opp_turbo_l1: opp-9 {
					opp-level = <RPMH_REGULATOR_LEVEL_TURBO_L1>;
				};
			};
		};
	};

	epss_l3_cl0: interconnect@18590000 {
		compatible = "qcom,sa8775p-epss-l3",
			     "qcom,epss-l3";
		reg = <0x0 0x18590000 0x0 0x1000>;
		clocks = <&rpmhcc RPMH_CXO_CLK>, <&gcc GCC_GPLL0>;
		clock-names = "xo", "alternate";
		#interconnect-cells = <1>;
	};

	epss_l3_cl1: interconnect@18592000 {
		compatible = "qcom,sa8775p-epss-l3",
			     "qcom,epss-l3";
		reg = <0x0 0x18592000 0x0 0x1000>;
		clocks = <&rpmhcc RPMH_CXO_CLK>, <&gcc GCC_GPLL0>;
		clock-names = "xo", "alternate";
		#interconnect-cells = <1>;
	};

	dispcc1: clock-controller@22100000 {
		compatible = "qcom,sa8775p-dispcc1";
		reg = <0x0 0x22100000 0x0 0x20000>;
		clocks = <&gcc GCC_DISP_AHB_CLK>,
			 <&rpmhcc RPMH_CXO_CLK>,
			 <&rpmhcc RPMH_CXO_CLK_A>,
			 <&sleep_clk>,
			 <&mdss1_dp0_phy 0>, <&mdss1_dp0_phy 1>,
			 <&mdss1_dp1_phy 0>, <&mdss1_dp1_phy 1>,
			 <0>, <0>, <0>, <0>;
		power-domains = <&rpmhpd SA8775P_MMCX>;
		#clock-cells = <1>;
		#reset-cells = <1>;
		#power-domain-cells = <1>;
	};

	nspa_noc: interconnect@260c0000 {
		compatible = "qcom,sa8775p-nspa-noc";
		reg = <0x0 0x260c0000 0x0 0x16080>;
		#interconnect-cells = <2>;
		qcom,bcm-voters = <&apps_bcm_voter>;
	};

	nspb_noc: interconnect@2a0c0000 {
		compatible = "qcom,sa8775p-nspb-noc";
		reg = <0x0 0x2a0c0000 0x0 0x16080>;
		#interconnect-cells = <2>;
		qcom,bcm-voters = <&apps_bcm_voter>;
	};
};

&spi0 {
	clocks = <&gcc GCC_QUPV3_WRAP0_S0_CLK>;
	clock-names = "se";
	pinctrl-0 = <&qup_spi0_default>;
	pinctrl-names = "default";
	interconnects = <&clk_virt MASTER_QUP_CORE_0 QCOM_ICC_TAG_ALWAYS
			 &clk_virt SLAVE_QUP_CORE_0 QCOM_ICC_TAG_ALWAYS>,
			<&gem_noc MASTER_APPSS_PROC QCOM_ICC_TAG_ALWAYS
			 &config_noc SLAVE_QUP_0 QCOM_ICC_TAG_ALWAYS>,
			<&aggre2_noc MASTER_QUP_0 QCOM_ICC_TAG_ALWAYS
			 &mc_virt SLAVE_EBI1 QCOM_ICC_TAG_ALWAYS>;
	interconnect-names = "qup-core",
			     "qup-config",
			     "qup-memory";
	power-domains = <&rpmhpd SA8775P_CX>;
};

&spi1 {
	clocks = <&gcc GCC_QUPV3_WRAP0_S1_CLK>;
	clock-names = "se";
	pinctrl-0 = <&qup_spi1_default>;
	pinctrl-names = "default";
	interconnects = <&clk_virt MASTER_QUP_CORE_0 QCOM_ICC_TAG_ALWAYS
			 &clk_virt SLAVE_QUP_CORE_0 QCOM_ICC_TAG_ALWAYS>,
			<&gem_noc MASTER_APPSS_PROC QCOM_ICC_TAG_ALWAYS
			 &config_noc SLAVE_QUP_0 QCOM_ICC_TAG_ALWAYS>,
			<&aggre2_noc MASTER_QUP_0 QCOM_ICC_TAG_ALWAYS
			 &mc_virt SLAVE_EBI1 QCOM_ICC_TAG_ALWAYS>;
	interconnect-names = "qup-core",
			     "qup-config",
			     "qup-memory";
	power-domains = <&rpmhpd SA8775P_CX>;
};

&spi2 {
	clocks = <&gcc GCC_QUPV3_WRAP0_S2_CLK>;
	clock-names = "se";
	pinctrl-0 = <&qup_spi2_default>;
	pinctrl-names = "default";
	interconnects = <&clk_virt MASTER_QUP_CORE_0 QCOM_ICC_TAG_ALWAYS
			 &clk_virt SLAVE_QUP_CORE_0 QCOM_ICC_TAG_ALWAYS>,
			<&gem_noc MASTER_APPSS_PROC QCOM_ICC_TAG_ALWAYS
			 &config_noc SLAVE_QUP_0 QCOM_ICC_TAG_ALWAYS>,
			<&aggre2_noc MASTER_QUP_0 QCOM_ICC_TAG_ALWAYS
			 &mc_virt SLAVE_EBI1 QCOM_ICC_TAG_ALWAYS>;
	interconnect-names = "qup-core",
			     "qup-config",
			     "qup-memory";
	power-domains = <&rpmhpd SA8775P_CX>;
};

&spi3 {
	clocks = <&gcc GCC_QUPV3_WRAP0_S3_CLK>;
	clock-names = "se";
	pinctrl-0 = <&qup_spi3_default>;
	pinctrl-names = "default";
	interconnects = <&clk_virt MASTER_QUP_CORE_0 QCOM_ICC_TAG_ALWAYS
			 &clk_virt SLAVE_QUP_CORE_0 QCOM_ICC_TAG_ALWAYS>,
			<&gem_noc MASTER_APPSS_PROC QCOM_ICC_TAG_ALWAYS
			 &config_noc SLAVE_QUP_0 QCOM_ICC_TAG_ALWAYS>,
			<&aggre2_noc MASTER_QUP_0 QCOM_ICC_TAG_ALWAYS
			 &mc_virt SLAVE_EBI1 QCOM_ICC_TAG_ALWAYS>;
	interconnect-names = "qup-core",
			     "qup-config",
			     "qup-memory";
	power-domains = <&rpmhpd SA8775P_CX>;
};

&spi4 {
	clocks = <&gcc GCC_QUPV3_WRAP0_S4_CLK>;
	clock-names = "se";
	pinctrl-0 = <&qup_spi4_default>;
	pinctrl-names = "default";
	interconnects = <&clk_virt MASTER_QUP_CORE_0 QCOM_ICC_TAG_ALWAYS
			 &clk_virt SLAVE_QUP_CORE_0 QCOM_ICC_TAG_ALWAYS>,
			<&gem_noc MASTER_APPSS_PROC QCOM_ICC_TAG_ALWAYS
			 &config_noc SLAVE_QUP_0 QCOM_ICC_TAG_ALWAYS>,
			<&aggre2_noc MASTER_QUP_0 QCOM_ICC_TAG_ALWAYS
			 &mc_virt SLAVE_EBI1 QCOM_ICC_TAG_ALWAYS>;
	interconnect-names = "qup-core",
			     "qup-config",
			     "qup-memory";
	power-domains = <&rpmhpd SA8775P_CX>;
};

&spi5 {
	clocks = <&gcc GCC_QUPV3_WRAP0_S5_CLK>;
	clock-names = "se";
	pinctrl-0 = <&qup_spi5_default>;
	pinctrl-names = "default";
	interconnects = <&clk_virt MASTER_QUP_CORE_0 QCOM_ICC_TAG_ALWAYS
			 &clk_virt SLAVE_QUP_CORE_0 QCOM_ICC_TAG_ALWAYS>,
			<&gem_noc MASTER_APPSS_PROC QCOM_ICC_TAG_ALWAYS
			 &config_noc SLAVE_QUP_0 QCOM_ICC_TAG_ALWAYS>,
			<&aggre2_noc MASTER_QUP_0 QCOM_ICC_TAG_ALWAYS
			 &mc_virt SLAVE_EBI1 QCOM_ICC_TAG_ALWAYS>;
	interconnect-names = "qup-core",
			     "qup-config",
			     "qup-memory";
	power-domains = <&rpmhpd SA8775P_CX>;
};

&spi7 {
	clocks = <&gcc GCC_QUPV3_WRAP1_S0_CLK>;
	clock-names = "se";
	pinctrl-0 = <&qup_spi7_default>;
	pinctrl-names = "default";
	interconnects = <&clk_virt MASTER_QUP_CORE_1 QCOM_ICC_TAG_ALWAYS
			 &clk_virt SLAVE_QUP_CORE_1 QCOM_ICC_TAG_ALWAYS>,
			<&gem_noc MASTER_APPSS_PROC QCOM_ICC_TAG_ALWAYS
			 &config_noc SLAVE_QUP_1 QCOM_ICC_TAG_ALWAYS>,
			<&aggre2_noc MASTER_QUP_1 QCOM_ICC_TAG_ALWAYS
			 &mc_virt SLAVE_EBI1 QCOM_ICC_TAG_ALWAYS>;
	interconnect-names = "qup-core",
			     "qup-config",
			     "qup-memory";
	power-domains = <&rpmhpd SA8775P_CX>;
};

&spi8 {
	clocks = <&gcc GCC_QUPV3_WRAP1_S1_CLK>;
	clock-names = "se";
	pinctrl-0 = <&qup_spi8_default>;
	pinctrl-names = "default";
	interconnects = <&clk_virt MASTER_QUP_CORE_1 QCOM_ICC_TAG_ALWAYS
			 &clk_virt SLAVE_QUP_CORE_1 QCOM_ICC_TAG_ALWAYS>,
			<&gem_noc MASTER_APPSS_PROC QCOM_ICC_TAG_ALWAYS
			 &config_noc SLAVE_QUP_1 QCOM_ICC_TAG_ALWAYS>,
			<&aggre2_noc MASTER_QUP_1 QCOM_ICC_TAG_ALWAYS
			 &mc_virt SLAVE_EBI1 QCOM_ICC_TAG_ALWAYS>;
	interconnect-names = "qup-core",
			     "qup-config",
			     "qup-memory";
	power-domains = <&rpmhpd SA8775P_CX>;
};

&spi9 {
	clocks = <&gcc GCC_QUPV3_WRAP1_S2_CLK>;
	clock-names = "se";
	pinctrl-0 = <&qup_spi9_default>;
	pinctrl-names = "default";
	interconnects = <&clk_virt MASTER_QUP_CORE_1 QCOM_ICC_TAG_ALWAYS
			 &clk_virt SLAVE_QUP_CORE_1 QCOM_ICC_TAG_ALWAYS>,
			<&gem_noc MASTER_APPSS_PROC QCOM_ICC_TAG_ALWAYS
			 &config_noc SLAVE_QUP_1 QCOM_ICC_TAG_ALWAYS>,
			<&aggre2_noc MASTER_QUP_1 QCOM_ICC_TAG_ALWAYS
			 &mc_virt SLAVE_EBI1 QCOM_ICC_TAG_ALWAYS>;
	interconnect-names = "qup-core",
			     "qup-config",
			     "qup-memory";
	power-domains = <&rpmhpd SA8775P_CX>;
};

&spi10 {
	clocks = <&gcc GCC_QUPV3_WRAP1_S3_CLK>;
	clock-names = "se";
	pinctrl-0 = <&qup_spi10_default>;
	pinctrl-names = "default";
	interconnects = <&clk_virt MASTER_QUP_CORE_1 QCOM_ICC_TAG_ALWAYS
			 &clk_virt SLAVE_QUP_CORE_1 QCOM_ICC_TAG_ALWAYS>,
			<&gem_noc MASTER_APPSS_PROC QCOM_ICC_TAG_ALWAYS
			 &config_noc SLAVE_QUP_1 QCOM_ICC_TAG_ALWAYS>,
			<&aggre2_noc MASTER_QUP_1 QCOM_ICC_TAG_ALWAYS
			 &mc_virt SLAVE_EBI1 QCOM_ICC_TAG_ALWAYS>;
	interconnect-names = "qup-core",
			     "qup-config",
			     "qup-memory";
	power-domains = <&rpmhpd SA8775P_CX>;
};

&spi11 {
	clocks = <&gcc GCC_QUPV3_WRAP1_S4_CLK>;
	clock-names = "se";
	pinctrl-0 = <&qup_spi11_default>;
	pinctrl-names = "default";
	interconnects = <&clk_virt MASTER_QUP_CORE_1 QCOM_ICC_TAG_ALWAYS
			 &clk_virt SLAVE_QUP_CORE_1 QCOM_ICC_TAG_ALWAYS>,
			<&gem_noc MASTER_APPSS_PROC QCOM_ICC_TAG_ALWAYS
			 &config_noc SLAVE_QUP_1 QCOM_ICC_TAG_ALWAYS>,
			<&aggre2_noc MASTER_QUP_1 QCOM_ICC_TAG_ALWAYS
			 &mc_virt SLAVE_EBI1 QCOM_ICC_TAG_ALWAYS>;
	interconnect-names = "qup-core",
			     "qup-config",
			     "qup-memory";
	power-domains = <&rpmhpd SA8775P_CX>;
};

&spi12 {
	clocks = <&gcc GCC_QUPV3_WRAP1_S5_CLK>;
	clock-names = "se";
	pinctrl-0 = <&qup_spi12_default>;
	pinctrl-names = "default";
	interconnects = <&clk_virt MASTER_QUP_CORE_1 QCOM_ICC_TAG_ALWAYS
			 &clk_virt SLAVE_QUP_CORE_1 QCOM_ICC_TAG_ALWAYS>,
			<&gem_noc MASTER_APPSS_PROC QCOM_ICC_TAG_ALWAYS
			 &config_noc SLAVE_QUP_1 QCOM_ICC_TAG_ALWAYS>,
			<&aggre2_noc MASTER_QUP_1 QCOM_ICC_TAG_ALWAYS
			 &mc_virt SLAVE_EBI1 QCOM_ICC_TAG_ALWAYS>;
	interconnect-names = "qup-core",
			     "qup-config",
			     "qup-memory";
	power-domains = <&rpmhpd SA8775P_CX>;
};

&spi14 {
	clocks = <&gcc GCC_QUPV3_WRAP2_S0_CLK>;
	clock-names = "se";
	pinctrl-0 = <&qup_spi14_default>;
	pinctrl-names = "default";
	interconnects = <&clk_virt MASTER_QUP_CORE_2 QCOM_ICC_TAG_ALWAYS
			 &clk_virt SLAVE_QUP_CORE_2 QCOM_ICC_TAG_ALWAYS>,
			<&gem_noc MASTER_APPSS_PROC QCOM_ICC_TAG_ALWAYS
			 &config_noc SLAVE_QUP_2 QCOM_ICC_TAG_ALWAYS>,
			<&aggre2_noc MASTER_QUP_2 QCOM_ICC_TAG_ALWAYS
			 &mc_virt SLAVE_EBI1 QCOM_ICC_TAG_ALWAYS>;
	interconnect-names = "qup-core",
			     "qup-config",
			     "qup-memory";
	power-domains = <&rpmhpd SA8775P_CX>;
};

&spi15 {
	clocks = <&gcc GCC_QUPV3_WRAP2_S1_CLK>;
	clock-names = "se";
	pinctrl-0 = <&qup_spi15_default>;
	pinctrl-names = "default";
	interconnects = <&clk_virt MASTER_QUP_CORE_2 QCOM_ICC_TAG_ALWAYS
			 &clk_virt SLAVE_QUP_CORE_2 QCOM_ICC_TAG_ALWAYS>,
			<&gem_noc MASTER_APPSS_PROC QCOM_ICC_TAG_ALWAYS
			 &config_noc SLAVE_QUP_2 QCOM_ICC_TAG_ALWAYS>,
			<&aggre2_noc MASTER_QUP_2 QCOM_ICC_TAG_ALWAYS
			 &mc_virt SLAVE_EBI1 QCOM_ICC_TAG_ALWAYS>;
	interconnect-names = "qup-core",
			     "qup-config",
			     "qup-memory";
	power-domains = <&rpmhpd SA8775P_CX>;
};

&spi16 {
	clocks = <&gcc GCC_QUPV3_WRAP2_S2_CLK>;
	clock-names = "se";
	pinctrl-0 = <&qup_spi16_default>;
	pinctrl-names = "default";
	interconnects = <&clk_virt MASTER_QUP_CORE_2 QCOM_ICC_TAG_ALWAYS
			 &clk_virt SLAVE_QUP_CORE_2 QCOM_ICC_TAG_ALWAYS>,
			<&gem_noc MASTER_APPSS_PROC QCOM_ICC_TAG_ALWAYS
			 &config_noc SLAVE_QUP_2 QCOM_ICC_TAG_ALWAYS>,
			<&aggre2_noc MASTER_QUP_2 QCOM_ICC_TAG_ALWAYS
			 &mc_virt SLAVE_EBI1 QCOM_ICC_TAG_ALWAYS>;
	interconnect-names = "qup-core",
			     "qup-config",
			     "qup-memory";
	power-domains = <&rpmhpd SA8775P_CX>;
};

&spi17 {
	clocks = <&gcc GCC_QUPV3_WRAP2_S3_CLK>;
	clock-names = "se";
	pinctrl-0 = <&qup_spi17_default>;
	pinctrl-names = "default";
	interconnects = <&clk_virt MASTER_QUP_CORE_2 QCOM_ICC_TAG_ALWAYS
			 &clk_virt SLAVE_QUP_CORE_2 QCOM_ICC_TAG_ALWAYS>,
			<&gem_noc MASTER_APPSS_PROC QCOM_ICC_TAG_ALWAYS
			 &config_noc SLAVE_QUP_2 QCOM_ICC_TAG_ALWAYS>,
			<&aggre2_noc MASTER_QUP_2 QCOM_ICC_TAG_ALWAYS
			 &mc_virt SLAVE_EBI1 QCOM_ICC_TAG_ALWAYS>;
	interconnect-names = "qup-core",
			     "qup-config",
			     "qup-memory";
	power-domains = <&rpmhpd SA8775P_CX>;
};

&spi18 {
	clocks = <&gcc GCC_QUPV3_WRAP2_S4_CLK>;
	clock-names = "se";
	pinctrl-0 = <&qup_spi18_default>;
	pinctrl-names = "default";
	interconnects = <&clk_virt MASTER_QUP_CORE_2 QCOM_ICC_TAG_ALWAYS
			 &clk_virt SLAVE_QUP_CORE_2 QCOM_ICC_TAG_ALWAYS>,
			<&gem_noc MASTER_APPSS_PROC QCOM_ICC_TAG_ALWAYS
			 &config_noc SLAVE_QUP_2 QCOM_ICC_TAG_ALWAYS>,
			<&aggre2_noc MASTER_QUP_2 QCOM_ICC_TAG_ALWAYS
			 &mc_virt SLAVE_EBI1 QCOM_ICC_TAG_ALWAYS>;
	interconnect-names = "qup-core",
			     "qup-config",
			     "qup-memory";
	power-domains = <&rpmhpd SA8775P_CX>;
};

&spi19 {
	clocks = <&gcc GCC_QUPV3_WRAP2_S5_CLK>;
	clock-names = "se";
	pinctrl-0 = <&qup_spi19_default>;
	pinctrl-names = "default";
	interconnects = <&clk_virt MASTER_QUP_CORE_2 QCOM_ICC_TAG_ALWAYS
			 &clk_virt SLAVE_QUP_CORE_2 QCOM_ICC_TAG_ALWAYS>,
			<&gem_noc MASTER_APPSS_PROC QCOM_ICC_TAG_ALWAYS
			 &config_noc SLAVE_QUP_2 QCOM_ICC_TAG_ALWAYS>,
			<&aggre2_noc MASTER_QUP_2 QCOM_ICC_TAG_ALWAYS
			 &mc_virt SLAVE_EBI1 QCOM_ICC_TAG_ALWAYS>;
	interconnect-names = "qup-core",
			     "qup-config",
			     "qup-memory";
	power-domains = <&rpmhpd SA8775P_CX>;
};

&spi20 {
	clocks = <&gcc GCC_QUPV3_WRAP2_S6_CLK>;
	clock-names = "se";
	pinctrl-0 = <&qup_spi20_default>;
	pinctrl-names = "default";
	interconnects = <&clk_virt MASTER_QUP_CORE_2 QCOM_ICC_TAG_ALWAYS
			 &clk_virt SLAVE_QUP_CORE_2 QCOM_ICC_TAG_ALWAYS>,
			<&gem_noc MASTER_APPSS_PROC QCOM_ICC_TAG_ALWAYS
			 &config_noc SLAVE_QUP_2 QCOM_ICC_TAG_ALWAYS>,
			<&aggre2_noc MASTER_QUP_2 QCOM_ICC_TAG_ALWAYS
			 &mc_virt SLAVE_EBI1 QCOM_ICC_TAG_ALWAYS>;
	interconnect-names = "qup-core",
			     "qup-config",
			     "qup-memory";
	power-domains = <&rpmhpd SA8775P_CX>;
};

&spi21 {
	clocks = <&gcc GCC_QUPV3_WRAP3_S0_CLK>;
	clock-names = "se";
	pinctrl-0 = <&qup_spi21_default>;
	pinctrl-names = "default";
	interconnects = <&clk_virt MASTER_QUP_CORE_3 QCOM_ICC_TAG_ALWAYS
			&clk_virt SLAVE_QUP_CORE_3 QCOM_ICC_TAG_ALWAYS>,
		   <&gem_noc MASTER_APPSS_PROC QCOM_ICC_TAG_ALWAYS
			&config_noc SLAVE_QUP_3 QCOM_ICC_TAG_ALWAYS>,
		   <&aggre1_noc MASTER_QUP_3 QCOM_ICC_TAG_ALWAYS
			&mc_virt SLAVE_EBI1 QCOM_ICC_TAG_ALWAYS>;
	interconnect-names = "qup-core",
				 "qup-config",
				 "qup-memory";
	power-domains = <&rpmhpd SA8775P_CX>;
};

&tlmm {
	dp0_hot_plug_det: dp0-hot-plug-det-state {
		pins = "gpio101";
		function = "edp0_hot";
		bias-disable;
	};

	dp1_hot_plug_det: dp1-hot-plug-det-state {
		pins = "gpio102";
		function = "edp1_hot";
		bias-disable;
	};

	hs0_mi2s_active: hs0-mi2s-active-state {
		pins = "gpio114", "gpio115", "gpio116", "gpio117";
		function = "hs0_mi2s";
		drive-strength = <8>;
		bias-disable;
	};

	hs2_mi2s_active: hs2-mi2s-active-state {
		pins = "gpio122", "gpio123", "gpio124", "gpio125";
		function = "hs2_mi2s";
		drive-strength = <8>;
		bias-disable;
	};

	cci0_0_default: cci0-0-default-state {
		pins = "gpio60", "gpio61";
		function = "cci_i2c";
		drive-strength = <2>;
		bias-pull-up = <2200>;
	};

	cci0_0_sleep: cci0-0-sleep-state {
		pins = "gpio60", "gpio61";
		function = "cci_i2c";
		drive-strength = <2>;
		bias-pull-down;
	};

	cci0_1_default: cci0-1-default-state {
		pins = "gpio52", "gpio53";
		function = "cci_i2c";
		drive-strength = <2>;
		bias-pull-up = <2200>;
	};

	cci0_1_sleep: cci0-1-sleep-state {
		pins = "gpio52", "gpio53";
		function = "cci_i2c";
		drive-strength = <2>;
		bias-pull-down;
	};

	cci1_0_default: cci1-0-default-state {
		pins = "gpio62", "gpio63";
		function = "cci_i2c";
		drive-strength = <2>;
		bias-pull-up = <2200>;
	};

	cci1_0_sleep: cci1-0-sleep-state {
		pins = "gpio62", "gpio63";
		function = "cci_i2c";
		drive-strength = <2>;
		bias-pull-down;
	};

	cci1_1_default: cci1-1-default-state {
		pins = "gpio54", "gpio55";
		function = "cci_i2c";
		drive-strength = <2>;
		bias-pull-up = <2200>;
	};

	cci1_1_sleep: cci1-1-sleep-state {
		pins = "gpio54", "gpio55";
		function = "cci_i2c";
		drive-strength = <2>;
		bias-pull-down;
	};

	cci2_0_default: cci2-0-default-state {
		pins = "gpio64", "gpio65";
		function = "cci_i2c";
		drive-strength = <2>;
		bias-pull-up = <2200>;
	};

	cci2_0_sleep: cci2-0-sleep-state {
		pins = "gpio64", "gpio65";
		function = "cci_i2c";
		drive-strength = <2>;
		bias-pull-down;
	};

	cci2_1_default: cci2-1-default-state {
		pins = "gpio56", "gpio57";
		function = "cci_i2c";
		drive-strength = <2>;
		bias-pull-up = <2200>;
	};

	cci2_1_sleep: cci2-1-sleep-state {
		pins = "gpio56", "gpio57";
		function = "cci_i2c";
		drive-strength = <2>;
		bias-pull-down;
	};

	cci3_0_default: cci3-0-default-state {
		pins = "gpio66", "gpio67";
		function = "cci_i2c";
		drive-strength = <2>;
		bias-pull-up = <2200>;
	};

	cci3_0_sleep: cci3-0-sleep-state {
		pins = "gpio66", "gpio67";
		function = "cci_i2c";
		drive-strength = <2>;
		bias-pull-down;
	};

	cci3_1_default: cci3-1-default-state {
		pins = "gpio58", "gpio59";
		function = "cci_i2c";
		drive-strength = <2>;
		bias-pull-up = <2200>;
	};

	cci3_1_sleep: cci3-1-sleep-state {
		pins = "gpio58", "gpio59";
		function = "cci_i2c";
		drive-strength = <2>;
		bias-pull-down;
	};

	qup_i2c0_default: qup-i2c0-state {
		pins = "gpio20", "gpio21";
		function = "qup0_se0";
	};

	qup_i2c1_default: qup-i2c1-state {
		pins = "gpio24", "gpio25";
		function = "qup0_se1";
	};

	qup_i2c2_default: qup-i2c2-state {
		pins = "gpio36", "gpio37";
		function = "qup0_se2";
	};

	qup_i2c3_default: qup-i2c3-state {
		pins = "gpio28", "gpio29";
		function = "qup0_se3";
	};

	qup_i2c4_default: qup-i2c4-state {
		pins = "gpio32", "gpio33";
		function = "qup0_se4";
	};

	qup_i2c5_default: qup-i2c5-state {
		pins = "gpio36", "gpio37";
		function = "qup0_se5";
	};

	qup_i2c7_default: qup-i2c7-state {
		pins = "gpio40", "gpio41";
		function = "qup1_se0";
	};

	qup_i2c8_default: qup-i2c8-state {
		pins = "gpio42", "gpio43";
		function = "qup1_se1";
	};

	qup_i2c9_default: qup-i2c9-state {
		pins = "gpio46", "gpio47";
		function = "qup1_se2";
	};

	qup_i2c10_default: qup-i2c10-state {
		pins = "gpio44", "gpio45";
		function = "qup1_se3";
	};

	qup_i2c11_default: qup-i2c11-state {
		pins = "gpio48", "gpio49";
		function = "qup1_se4";
	};

	qup_i2c12_default: qup-i2c12-state {
		pins = "gpio52", "gpio53";
		function = "qup1_se5";
	};

	qup_i2c13_default: qup-i2c13-state {
		pins = "gpio56", "gpio57";
		function = "qup1_se6";
	};

	qup_i2c14_default: qup-i2c14-state {
		pins = "gpio80", "gpio81";
		function = "qup2_se0";
	};

	qup_i2c15_default: qup-i2c15-state {
		pins = "gpio84", "gpio85";
		function = "qup2_se1";
	};

	qup_i2c16_default: qup-i2c16-state {
		pins = "gpio86", "gpio87";
		function = "qup2_se2";
	};

	qup_i2c17_default: qup-i2c17-state {
		pins = "gpio91", "gpio92";
		function = "qup2_se3";
	};

	qup_i2c18_default: qup-i2c18-state {
		pins = "gpio95", "gpio96";
		function = "qup2_se4";
	};

	qup_i2c19_default: qup-i2c19-state {
		pins = "gpio99", "gpio100";
		function = "qup2_se5";
	};

	qup_i2c20_default: qup-i2c20-state {
		pins = "gpio97", "gpio98";
		function = "qup2_se6";
	};

	qup_i2c21_default: qup-i2c21-state {
		pins = "gpio13", "gpio14";
		function = "qup3_se0";
	};

	qup_spi0_default: qup-spi0-state {
		pins = "gpio20", "gpio21", "gpio22", "gpio23";
		function = "qup0_se0";
	};

	qup_spi1_default: qup-spi1-state {
		pins = "gpio24", "gpio25", "gpio26", "gpio27";
		function = "qup0_se1";
	};

	qup_spi2_default: qup-spi2-state {
		pins = "gpio36", "gpio37", "gpio38", "gpio39";
		function = "qup0_se2";
	};

	qup_spi3_default: qup-spi3-state {
		pins = "gpio28", "gpio29", "gpio30", "gpio31";
		function = "qup0_se3";
	};

	qup_spi4_default: qup-spi4-state {
		pins = "gpio32", "gpio33", "gpio34", "gpio35";
		function = "qup0_se4";
	};

	qup_spi5_default: qup-spi5-state {
		pins = "gpio36", "gpio37", "gpio38", "gpio39";
		function = "qup0_se5";
	};

	qup_spi7_default: qup-spi7-state {
		pins = "gpio40", "gpio41", "gpio42", "gpio43";
		function = "qup1_se0";
	};

	qup_spi8_default: qup-spi8-state {
		pins = "gpio42", "gpio43", "gpio40", "gpio41";
		function = "qup1_se1";
	};

	qup_spi9_default: qup-spi9-state {
		pins = "gpio46", "gpio47", "gpio44", "gpio45";
		function = "qup1_se2";
	};

	qup_spi10_default: qup-spi10-state {
		pins = "gpio44", "gpio45", "gpio46", "gpio47";
		function = "qup1_se3";
	};

	qup_spi11_default: qup-spi11-state {
		pins = "gpio48", "gpio49", "gpio50", "gpio51";
		function = "qup1_se4";
	};

	qup_spi12_default: qup-spi12-state {
		pins = "gpio52", "gpio53", "gpio54", "gpio55";
		function = "qup1_se5";
	};

	qup_spi14_default: qup-spi14-state {
		pins = "gpio80", "gpio81", "gpio82", "gpio83";
		function = "qup2_se0";
	};

	qup_spi15_default: qup-spi15-state {
		pins = "gpio84", "gpio85", "gpio99", "gpio100";
		function = "qup2_se1";
	};

	qup_spi16_default: qup-spi16-state {
		pins = "gpio86", "gpio87", "gpio88", "gpio89";
		function = "qup2_se2";
	};

	qup_spi17_default: qup-spi17-state {
		pins = "gpio91", "gpio92", "gpio93", "gpio94";
		function = "qup2_se3";
	};

	qup_spi18_default: qup-spi18-state {
		pins = "gpio95", "gpio96", "gpio97", "gpio98";
		function = "qup2_se4";
	};

	qup_spi19_default: qup-spi19-state {
		pins = "gpio99", "gpio100", "gpio84", "gpio85";
		function = "qup2_se5";
	};

	qup_spi20_default: qup-spi20-state {
		pins = "gpio97", "gpio98", "gpio95", "gpio96";
		function = "qup2_se6";
	};

	qup_spi21_default: qup-spi21-state {
		pins = "gpio13", "gpio14", "gpio15", "gpio16";
		function = "qup3_se0";
	};

	qup_uart0_default: qup-uart0-state {
		qup_uart0_cts: qup-uart0-cts-pins {
			pins = "gpio20";
			function = "qup0_se0";
		};

		qup_uart0_rts: qup-uart0-rts-pins {
			pins = "gpio21";
			function = "qup0_se0";
		};

		qup_uart0_tx: qup-uart0-tx-pins {
			pins = "gpio22";
			function = "qup0_se0";
		};

		qup_uart0_rx: qup-uart0-rx-pins {
			pins = "gpio23";
			function = "qup0_se0";
		};
	};

	qup_uart1_default: qup-uart1-state {
		qup_uart1_cts: qup-uart1-cts-pins {
			pins = "gpio24";
			function = "qup0_se1";
		};

		qup_uart1_rts: qup-uart1-rts-pins {
			pins = "gpio25";
			function = "qup0_se1";
		};

		qup_uart1_tx: qup-uart1-tx-pins {
			pins = "gpio26";
			function = "qup0_se1";
		};

		qup_uart1_rx: qup-uart1-rx-pins {
			pins = "gpio27";
			function = "qup0_se1";
		};
	};

	qup_uart2_default: qup-uart2-state {
		qup_uart2_cts: qup-uart2-cts-pins {
			pins = "gpio36";
			function = "qup0_se2";
		};

		qup_uart2_rts: qup-uart2-rts-pins {
			pins = "gpio37";
			function = "qup0_se2";
		};

		qup_uart2_tx: qup-uart2-tx-pins {
			pins = "gpio38";
			function = "qup0_se2";
		};

		qup_uart2_rx: qup-uart2-rx-pins {
			pins = "gpio39";
			function = "qup0_se2";
		};
	};

	qup_uart3_default: qup-uart3-state {
		qup_uart3_cts: qup-uart3-cts-pins {
			pins = "gpio28";
			function = "qup0_se3";
		};

		qup_uart3_rts: qup-uart3-rts-pins {
			pins = "gpio29";
			function = "qup0_se3";
		};

		qup_uart3_tx: qup-uart3-tx-pins {
			pins = "gpio30";
			function = "qup0_se3";
		};

		qup_uart3_rx: qup-uart3-rx-pins {
			pins = "gpio31";
			function = "qup0_se3";
		};
	};

	qup_uart4_default: qup-uart4-state {
		qup_uart4_cts: qup-uart4-cts-pins {
			pins = "gpio32";
			function = "qup0_se4";
		};

		qup_uart4_rts: qup-uart4-rts-pins {
			pins = "gpio33";
			function = "qup0_se4";
		};

		qup_uart4_tx: qup-uart4-tx-pins {
			pins = "gpio34";
			function = "qup0_se4";
		};

		qup_uart4_rx: qup-uart4-rx-pins {
			pins = "gpio35";
			function = "qup0_se4";
		};
	};

	qup_uart5_default: qup-uart5-state {
		qup_uart5_cts: qup-uart5-cts-pins {
			pins = "gpio36";
			function = "qup0_se5";
		};

		qup_uart5_rts: qup-uart5-rts-pins {
			pins = "gpio37";
			function = "qup0_se5";
		};

		qup_uart5_tx: qup-uart5-tx-pins {
			pins = "gpio38";
			function = "qup0_se5";
		};

		qup_uart5_rx: qup-uart5-rx-pins {
			pins = "gpio39";
			function = "qup0_se5";
		};
	};

	qup_uart7_default: qup-uart7-state {
		qup_uart7_cts: qup-uart7-cts-pins {
			pins = "gpio40";
			function = "qup1_se0";
		};

		qup_uart7_rts: qup-uart7-rts-pins {
			pins = "gpio41";
			function = "qup1_se0";
		};

		qup_uart7_tx: qup-uart7-tx-pins {
			pins = "gpio42";
			function = "qup1_se0";
		};

		qup_uart7_rx: qup-uart7-rx-pins {
			pins = "gpio43";
			function = "qup1_se0";
		};
	};

	qup_uart8_default: qup-uart8-state {
		qup_uart8_cts: qup-uart8-cts-pins {
			pins = "gpio42";
			function = "qup1_se1";
		};

		qup_uart8_rts: qup-uart8-rts-pins {
			pins = "gpio43";
			function = "qup1_se1";
		};

		qup_uart8_tx: qup-uart8-tx-pins {
			pins = "gpio40";
			function = "qup1_se1";
		};

		qup_uart8_rx: qup-uart8-rx-pins {
			pins = "gpio41";
			function = "qup1_se1";
		};
	};

	qup_uart9_default: qup-uart9-state {
		qup_uart9_cts: qup-uart9-cts-pins {
			pins = "gpio46";
			function = "qup1_se2";
		};

		qup_uart9_rts: qup-uart9-rts-pins {
			pins = "gpio47";
			function = "qup1_se2";
		};

		qup_uart9_tx: qup-uart9-tx-pins {
			pins = "gpio44";
			function = "qup1_se2";
		};

		qup_uart9_rx: qup-uart9-rx-pins {
			pins = "gpio45";
			function = "qup1_se2";
		};
	};

	qup_uart10_default: qup-uart10-state {
		pins = "gpio46", "gpio47";
		function = "qup1_se3";
	};

	qup_uart11_default: qup-uart11-state {
		qup_uart11_cts: qup-uart11-cts-pins {
			pins = "gpio48";
			function = "qup1_se4";
		};

		qup_uart11_rts: qup-uart11-rts-pins {
			pins = "gpio49";
			function = "qup1_se4";
		};

		qup_uart11_tx: qup-uart11-tx-pins {
			pins = "gpio50";
			function = "qup1_se4";
		};

		qup_uart11_rx: qup-uart11-rx-pins {
			pins = "gpio51";
			function = "qup1_se4";
		};
	};

	qup_uart12_default: qup-uart12-state {
		qup_uart12_cts: qup-uart12-cts-pins {
			pins = "gpio52";
			function = "qup1_se5";
		};

		qup_uart12_rts: qup-uart12-rts-pins {
			pins = "gpio53";
			function = "qup1_se5";
		};

		qup_uart12_tx: qup-uart12-tx-pins {
			pins = "gpio54";
			function = "qup1_se5";
		};

		qup_uart12_rx: qup-uart12-rx-pins {
			pins = "gpio55";
			function = "qup1_se5";
		};
	};

	qup_uart14_default: qup-uart14-state {
		qup_uart14_cts: qup-uart14-cts-pins {
			pins = "gpio80";
			function = "qup2_se0";
		};

		qup_uart14_rts: qup-uart14-rts-pins {
			pins = "gpio81";
			function = "qup2_se0";
		};

		qup_uart14_tx: qup-uart14-tx-pins {
			pins = "gpio82";
			function = "qup2_se0";
		};

		qup_uart14_rx: qup-uart14-rx-pins {
			pins = "gpio83";
			function = "qup2_se0";
		};
	};

	qup_uart15_default: qup-uart15-state {
		qup_uart15_cts: qup-uart15-cts-pins {
			pins = "gpio84";
			function = "qup2_se1";
		};

		qup_uart15_rts: qup-uart15-rts-pins {
			pins = "gpio85";
			function = "qup2_se1";
		};

		qup_uart15_tx: qup-uart15-tx-pins {
			pins = "gpio99";
			function = "qup2_se1";
		};

		qup_uart15_rx: qup-uart15-rx-pins {
			pins = "gpio100";
			function = "qup2_se1";
		};
	};

	qup_uart16_default: qup-uart16-state {
		qup_uart16_cts: qup-uart16-cts-pins {
			pins = "gpio86";
			function = "qup2_se2";
		};

		qup_uart16_rts: qup-uart16-rts-pins {
			pins = "gpio87";
			function = "qup2_se2";
		};

		qup_uart16_tx: qup-uart16-tx-pins {
			pins = "gpio88";
			function = "qup2_se2";
		};

		qup_uart16_rx: qup-uart16-rx-pins {
			pins = "gpio89";
			function = "qup2_se2";
		};
	};

	qup_uart17_default: qup-uart17-state {
		qup_uart17_cts: qup-uart17-cts-pins {
			pins = "gpio91";
			function = "qup2_se3";
		};

		qup_uart17_rts: qup0-uart17-rts-pins {
			pins = "gpio92";
			function = "qup2_se3";
		};

		qup_uart17_tx: qup0-uart17-tx-pins {
			pins = "gpio93";
			function = "qup2_se3";
		};

		qup_uart17_rx: qup0-uart17-rx-pins {
			pins = "gpio94";
			function = "qup2_se3";
		};
	};

	qup_uart18_default: qup-uart18-state {
		qup_uart18_cts: qup-uart18-cts-pins {
			pins = "gpio95";
			function = "qup2_se4";
		};

		qup_uart18_rts: qup-uart18-rts-pins {
			pins = "gpio96";
			function = "qup2_se4";
		};

		qup_uart18_tx: qup-uart18-tx-pins {
			pins = "gpio97";
			function = "qup2_se4";
		};

		qup_uart18_rx: qup-uart18-rx-pins {
			pins = "gpio98";
			function = "qup2_se4";
		};
	};

	qup_uart19_default: qup-uart19-state {
		qup_uart19_cts: qup-uart19-cts-pins {
			pins = "gpio99";
			function = "qup2_se5";
		};

		qup_uart19_rts: qup-uart19-rts-pins {
			pins = "gpio100";
			function = "qup2_se5";
		};

		qup_uart19_tx: qup-uart19-tx-pins {
			pins = "gpio84";
			function = "qup2_se5";
		};

		qup_uart19_rx: qup-uart19-rx-pins {
			pins = "gpio85";
			function = "qup2_se5";
		};
	};

	qup_uart20_default: qup-uart20-state {
		qup_uart20_cts: qup-uart20-cts-pins {
			pins = "gpio97";
			function = "qup2_se6";
		};

		qup_uart20_rts: qup-uart20-rts-pins {
			pins = "gpio98";
			function = "qup2_se6";
		};

		qup_uart20_tx: qup-uart20-tx-pins {
			pins = "gpio95";
			function = "qup2_se6";
		};

		qup_uart20_rx: qup-uart20-rx-pins {
			pins = "gpio96";
			function = "qup2_se6";
		};
	};

	qup_uart21_default: qup-uart21-state {
		qup_uart21_cts: qup-uart21-cts-pins {
			pins = "gpio13";
			function = "qup3_se0";
		};

		qup_uart21_rts: qup-uart21-rts-pins {
			pins = "gpio14";
			function = "qup3_se0";
		};

		qup_uart21_tx: qup-uart21-tx-pins {
			pins = "gpio15";
			function = "qup3_se0";
		};

		qup_uart21_rx: qup-uart21-rx-pins {
			pins = "gpio16";
			function = "qup3_se0";
		};
	};

	sdc_default: sdc-default-state {
		clk-pins {
			pins = "sdc1_clk";
			drive-strength = <16>;
			bias-disable;
		};

		cmd-pins {
			pins = "sdc1_cmd";
			drive-strength = <10>;
			bias-pull-up;
		};

		data-pins {
			pins = "sdc1_data";
			drive-strength = <10>;
			bias-pull-up;
		};
	};

	sdc_sleep: sdc-sleep-state {
		clk-pins {
			pins = "sdc1_clk";
			drive-strength = <2>;
			bias-bus-hold;
		};

		cmd-pins {
			pins = "sdc1_cmd";
			drive-strength = <2>;
			bias-bus-hold;
		};

		data-pins {
			pins = "sdc1_data";
			drive-strength = <2>;
			bias-bus-hold;
		};
	};
};

&uart0 {
	clocks = <&gcc GCC_QUPV3_WRAP0_S0_CLK>;
	clock-names = "se";
	pinctrl-0 = <&qup_uart0_default>;
	pinctrl-names = "default";
	interconnects = <&clk_virt MASTER_QUP_CORE_0 QCOM_ICC_TAG_ALWAYS
			 &clk_virt SLAVE_QUP_CORE_0 QCOM_ICC_TAG_ALWAYS>,
			<&gem_noc MASTER_APPSS_PROC QCOM_ICC_TAG_ALWAYS
			 &config_noc SLAVE_QUP_0 QCOM_ICC_TAG_ALWAYS>;
	interconnect-names = "qup-core", "qup-config";
	power-domains = <&rpmhpd SA8775P_CX>;
};

&uart1 {
	clocks = <&gcc GCC_QUPV3_WRAP0_S1_CLK>;
	clock-names = "se";
	pinctrl-0 = <&qup_uart1_default>;
	pinctrl-names = "default";
	interconnects = <&clk_virt MASTER_QUP_CORE_0 QCOM_ICC_TAG_ALWAYS
			 &clk_virt SLAVE_QUP_CORE_0 QCOM_ICC_TAG_ALWAYS>,
			<&gem_noc MASTER_APPSS_PROC QCOM_ICC_TAG_ALWAYS
			 &config_noc SLAVE_QUP_0 QCOM_ICC_TAG_ALWAYS>;
	interconnect-names = "qup-core", "qup-config";
	power-domains = <&rpmhpd SA8775P_CX>;
};

&uart2 {
	clocks = <&gcc GCC_QUPV3_WRAP0_S2_CLK>;
	clock-names = "se";
	pinctrl-0 = <&qup_uart2_default>;
	pinctrl-names = "default";
	interconnects = <&clk_virt MASTER_QUP_CORE_0 QCOM_ICC_TAG_ALWAYS
			 &clk_virt SLAVE_QUP_CORE_0 QCOM_ICC_TAG_ALWAYS>,
			<&gem_noc MASTER_APPSS_PROC QCOM_ICC_TAG_ALWAYS
			 &config_noc SLAVE_QUP_0 QCOM_ICC_TAG_ALWAYS>;
	interconnect-names = "qup-core", "qup-config";
	power-domains = <&rpmhpd SA8775P_CX>;
};

&uart3 {
	clocks = <&gcc GCC_QUPV3_WRAP0_S3_CLK>;
	clock-names = "se";
	pinctrl-0 = <&qup_uart3_default>;
	pinctrl-names = "default";
	interconnects = <&clk_virt MASTER_QUP_CORE_0 QCOM_ICC_TAG_ALWAYS
			 &clk_virt SLAVE_QUP_CORE_0 QCOM_ICC_TAG_ALWAYS>,
			<&gem_noc MASTER_APPSS_PROC QCOM_ICC_TAG_ALWAYS
			 &config_noc SLAVE_QUP_0 QCOM_ICC_TAG_ALWAYS>;
	interconnect-names = "qup-core", "qup-config";
	power-domains = <&rpmhpd SA8775P_CX>;
};

&uart4 {
	clocks = <&gcc GCC_QUPV3_WRAP0_S4_CLK>;
	clock-names = "se";
	pinctrl-0 = <&qup_uart4_default>;
	pinctrl-names = "default";
	interconnects = <&clk_virt MASTER_QUP_CORE_0 QCOM_ICC_TAG_ALWAYS
			 &clk_virt SLAVE_QUP_CORE_0 QCOM_ICC_TAG_ALWAYS>,
			<&gem_noc MASTER_APPSS_PROC QCOM_ICC_TAG_ALWAYS
			 &config_noc SLAVE_QUP_0 QCOM_ICC_TAG_ALWAYS>;
	interconnect-names = "qup-core", "qup-config";
	power-domains = <&rpmhpd SA8775P_CX>;
};

&uart5 {
	clocks = <&gcc GCC_QUPV3_WRAP0_S5_CLK>;
	clock-names = "se";
	pinctrl-0 = <&qup_uart5_default>;
	pinctrl-names = "default";
	interconnects = <&clk_virt MASTER_QUP_CORE_0 QCOM_ICC_TAG_ALWAYS
			 &clk_virt SLAVE_QUP_CORE_0 QCOM_ICC_TAG_ALWAYS>,
			<&gem_noc MASTER_APPSS_PROC QCOM_ICC_TAG_ALWAYS
			 &config_noc SLAVE_QUP_0 QCOM_ICC_TAG_ALWAYS>;
	interconnect-names = "qup-core", "qup-config";
	power-domains = <&rpmhpd SA8775P_CX>;
};

&uart7 {
	clock-names = "se";
	clocks = <&gcc GCC_QUPV3_WRAP1_S0_CLK>;
	pinctrl-0 = <&qup_uart7_default>;
	pinctrl-names = "default";
	interconnect-names = "qup-core", "qup-config";
	interconnects = <&clk_virt MASTER_QUP_CORE_1 QCOM_ICC_TAG_ALWAYS
			 &clk_virt SLAVE_QUP_CORE_1 QCOM_ICC_TAG_ALWAYS>,
			<&gem_noc MASTER_APPSS_PROC QCOM_ICC_TAG_ALWAYS
			 &config_noc SLAVE_QUP_1 QCOM_ICC_TAG_ALWAYS>;
	power-domains = <&rpmhpd SA8775P_CX>;
	operating-points-v2 = <&qup_opp_table_100mhz>;
};

&uart8 {
	clock-names = "se";
	clocks = <&gcc GCC_QUPV3_WRAP1_S1_CLK>;
	pinctrl-0 = <&qup_uart8_default>;
	pinctrl-names = "default";
	interconnect-names = "qup-core", "qup-config";
	interconnects = <&clk_virt MASTER_QUP_CORE_1 QCOM_ICC_TAG_ALWAYS
			 &clk_virt SLAVE_QUP_CORE_1 QCOM_ICC_TAG_ALWAYS>,
			<&gem_noc MASTER_APPSS_PROC QCOM_ICC_TAG_ALWAYS
			 &config_noc SLAVE_QUP_1 QCOM_ICC_TAG_ALWAYS>;
	power-domains = <&rpmhpd SA8775P_CX>;
	operating-points-v2 = <&qup_opp_table_100mhz>;
};

&uart9 {
	clocks = <&gcc GCC_QUPV3_WRAP1_S2_CLK>;
	clock-names = "se";
	pinctrl-0 = <&qup_uart9_default>;
	pinctrl-names = "default";
	interconnects = <&clk_virt MASTER_QUP_CORE_1 QCOM_ICC_TAG_ALWAYS
			 &clk_virt SLAVE_QUP_CORE_1 QCOM_ICC_TAG_ALWAYS>,
			<&gem_noc MASTER_APPSS_PROC QCOM_ICC_TAG_ALWAYS
			 &config_noc SLAVE_QUP_1 QCOM_ICC_TAG_ALWAYS>;
	interconnect-names = "qup-core", "qup-config";
	power-domains = <&rpmhpd SA8775P_CX>;
};

&uart10 {
	clock-names = "se";
	clocks = <&gcc GCC_QUPV3_WRAP1_S3_CLK>;
	pinctrl-0 = <&qup_uart10_default>;
	pinctrl-names = "default";
	interconnect-names = "qup-core", "qup-config";
	interconnects = <&clk_virt MASTER_QUP_CORE_1 0
			 &clk_virt SLAVE_QUP_CORE_1 0>,
			<&gem_noc MASTER_APPSS_PROC 0
			 &config_noc SLAVE_QUP_1 0>;
	power-domains = <&rpmhpd SA8775P_CX>;
	operating-points-v2 = <&qup_opp_table_100mhz>;
};

&uart11 {
	clock-names = "se";
	clocks = <&gcc GCC_QUPV3_WRAP1_S4_CLK>;
	pinctrl-0 = <&qup_uart11_default>;
	pinctrl-names = "default";
	interconnect-names = "qup-core", "qup-config";
	interconnects = <&clk_virt MASTER_QUP_CORE_1 QCOM_ICC_TAG_ALWAYS
			 &clk_virt SLAVE_QUP_CORE_1 QCOM_ICC_TAG_ALWAYS>,
			<&gem_noc MASTER_APPSS_PROC QCOM_ICC_TAG_ALWAYS
			 &config_noc SLAVE_QUP_1 QCOM_ICC_TAG_ALWAYS>;
	power-domains = <&rpmhpd SA8775P_CX>;
	operating-points-v2 = <&qup_opp_table_100mhz>;
};

&uart12 {
	clocks = <&gcc GCC_QUPV3_WRAP1_S5_CLK>;
	clock-names = "se";
	pinctrl-0 = <&qup_uart12_default>;
	pinctrl-names = "default";
	interconnects = <&clk_virt MASTER_QUP_CORE_1 QCOM_ICC_TAG_ALWAYS
			 &clk_virt SLAVE_QUP_CORE_1 QCOM_ICC_TAG_ALWAYS>,
			<&gem_noc MASTER_APPSS_PROC QCOM_ICC_TAG_ALWAYS
			 &config_noc SLAVE_QUP_1 QCOM_ICC_TAG_ALWAYS>;
	interconnect-names = "qup-core", "qup-config";
	power-domains = <&rpmhpd SA8775P_CX>;
};

&uart14 {
	clocks = <&gcc GCC_QUPV3_WRAP2_S0_CLK>;
	clock-names = "se";
	pinctrl-0 = <&qup_uart14_default>;
	pinctrl-names = "default";
	interconnects = <&clk_virt MASTER_QUP_CORE_2 QCOM_ICC_TAG_ALWAYS
			 &clk_virt SLAVE_QUP_CORE_2 QCOM_ICC_TAG_ALWAYS>,
			<&gem_noc MASTER_APPSS_PROC QCOM_ICC_TAG_ALWAYS
			 &config_noc SLAVE_QUP_2 QCOM_ICC_TAG_ALWAYS>;
	interconnect-names = "qup-core", "qup-config";
	power-domains = <&rpmhpd SA8775P_CX>;
};

&uart15 {
	clocks = <&gcc GCC_QUPV3_WRAP2_S1_CLK>;
	clock-names = "se";
	pinctrl-0 = <&qup_uart15_default>;
	pinctrl-names = "default";
	interconnects = <&clk_virt MASTER_QUP_CORE_2 QCOM_ICC_TAG_ALWAYS
			 &clk_virt SLAVE_QUP_CORE_2 QCOM_ICC_TAG_ALWAYS>,
			<&gem_noc MASTER_APPSS_PROC QCOM_ICC_TAG_ALWAYS
			 &config_noc SLAVE_QUP_2 QCOM_ICC_TAG_ALWAYS>;
	interconnect-names = "qup-core", "qup-config";
	power-domains = <&rpmhpd SA8775P_CX>;
};

&uart16 {
	clocks = <&gcc GCC_QUPV3_WRAP2_S2_CLK>;
	clock-names = "se";
	pinctrl-0 = <&qup_uart16_default>;
	pinctrl-names = "default";
	interconnects = <&clk_virt MASTER_QUP_CORE_2 QCOM_ICC_TAG_ALWAYS
			 &clk_virt SLAVE_QUP_CORE_2 QCOM_ICC_TAG_ALWAYS>,
			<&gem_noc MASTER_APPSS_PROC QCOM_ICC_TAG_ALWAYS
			 &config_noc SLAVE_QUP_2 QCOM_ICC_TAG_ALWAYS>;
	interconnect-names = "qup-core", "qup-config";
	power-domains = <&rpmhpd SA8775P_CX>;
};

&uart17 {
	clocks = <&gcc GCC_QUPV3_WRAP2_S3_CLK>;
	clock-names = "se";
	pinctrl-0 = <&qup_uart17_default>;
	pinctrl-names = "default";
	interconnects = <&clk_virt MASTER_QUP_CORE_2 QCOM_ICC_TAG_ALWAYS
			 &clk_virt SLAVE_QUP_CORE_2 QCOM_ICC_TAG_ALWAYS>,
			<&gem_noc MASTER_APPSS_PROC QCOM_ICC_TAG_ALWAYS
			 &config_noc SLAVE_QUP_2 QCOM_ICC_TAG_ALWAYS>;
	interconnect-names = "qup-core", "qup-config";
	power-domains = <&rpmhpd SA8775P_CX>;
};

&uart18 {
	clocks = <&gcc GCC_QUPV3_WRAP2_S4_CLK>;
	clock-names = "se";
	pinctrl-0 = <&qup_uart18_default>;
	pinctrl-names = "default";
	interconnects = <&clk_virt MASTER_QUP_CORE_2 QCOM_ICC_TAG_ALWAYS
			 &clk_virt SLAVE_QUP_CORE_2 QCOM_ICC_TAG_ALWAYS>,
			<&gem_noc MASTER_APPSS_PROC QCOM_ICC_TAG_ALWAYS
			 &config_noc SLAVE_QUP_2 QCOM_ICC_TAG_ALWAYS>;
	interconnect-names = "qup-core", "qup-config";
	power-domains = <&rpmhpd SA8775P_CX>;
};

&uart19 {
	clocks = <&gcc GCC_QUPV3_WRAP2_S5_CLK>;
	clock-names = "se";
	pinctrl-0 = <&qup_uart19_default>;
	pinctrl-names = "default";
	interconnects = <&clk_virt MASTER_QUP_CORE_2 QCOM_ICC_TAG_ALWAYS
			 &clk_virt SLAVE_QUP_CORE_2 QCOM_ICC_TAG_ALWAYS>,
			<&gem_noc MASTER_APPSS_PROC QCOM_ICC_TAG_ALWAYS
			 &config_noc SLAVE_QUP_2 QCOM_ICC_TAG_ALWAYS>;
	interconnect-names = "qup-core", "qup-config";
	power-domains = <&rpmhpd SA8775P_CX>;
};

&uart20 {
	clocks = <&gcc GCC_QUPV3_WRAP2_S6_CLK>;
	clock-names = "se";
	pinctrl-0 = <&qup_uart20_default>;
	pinctrl-names = "default";
	interconnects = <&clk_virt MASTER_QUP_CORE_2 QCOM_ICC_TAG_ALWAYS
			 &clk_virt SLAVE_QUP_CORE_2 QCOM_ICC_TAG_ALWAYS>,
			<&gem_noc MASTER_APPSS_PROC QCOM_ICC_TAG_ALWAYS
			 &config_noc SLAVE_QUP_2 QCOM_ICC_TAG_ALWAYS>;
	interconnect-names = "qup-core", "qup-config";
	power-domains = <&rpmhpd SA8775P_CX>;
};

&uart21 {
	clock-names = "se";
	clocks = <&gcc GCC_QUPV3_WRAP3_S0_CLK>;
	interconnect-names = "qup-core", "qup-config";
	pinctrl-0 = <&qup_uart21_default>;
	pinctrl-names = "default";
	interconnects = <&clk_virt MASTER_QUP_CORE_3 QCOM_ICC_TAG_ALWAYS
			 &clk_virt SLAVE_QUP_CORE_3 QCOM_ICC_TAG_ALWAYS>,
			<&gem_noc MASTER_APPSS_PROC QCOM_ICC_TAG_ALWAYS
			 &config_noc SLAVE_QUP_3 QCOM_ICC_TAG_ALWAYS>;
	power-domains = <&rpmhpd SA8775P_CX>;
	operating-points-v2 = <&qup_opp_table_100mhz>;
};

&ufs_mem_hc {
	phys = <&ufs_mem_phy>;
	phy-names = "ufsphy";
	#reset-cells = <1>;
	resets = <&gcc GCC_UFS_PHY_BCR>;
	reset-names = "rst";
	power-domains = <&gcc UFS_PHY_GDSC>;
	required-opps = <&rpmhpd_opp_nom>;
	clocks = <&gcc GCC_UFS_PHY_AXI_CLK>,
		 <&gcc GCC_AGGRE_UFS_PHY_AXI_CLK>,
		 <&gcc GCC_UFS_PHY_AHB_CLK>,
		 <&gcc GCC_UFS_PHY_UNIPRO_CORE_CLK>,
		 <&rpmhcc RPMH_CXO_CLK>,
		 <&gcc GCC_UFS_PHY_TX_SYMBOL_0_CLK>,
		 <&gcc GCC_UFS_PHY_RX_SYMBOL_0_CLK>,
		 <&gcc GCC_UFS_PHY_RX_SYMBOL_1_CLK>;
	clock-names = "core_clk",
		      "bus_aggr_clk",
		      "iface_clk",
		      "core_clk_unipro",
		      "ref_clk",
		      "tx_lane0_sync_clk",
		      "rx_lane0_sync_clk",
		      "rx_lane1_sync_clk";
	freq-table-hz = <75000000 300000000>,
			<0 0>,
			<0 0>,
			<75000000 300000000>,
			<0 0>,
			<0 0>,
			<0 0>,
			<0 0>;
	qcom,ice = <&ice>;
};

&usb_0 {
	clocks = <&gcc GCC_CFG_NOC_USB3_PRIM_AXI_CLK>,
		 <&gcc GCC_USB30_PRIM_MASTER_CLK>,
		 <&gcc GCC_AGGRE_USB3_PRIM_AXI_CLK>,
		 <&gcc GCC_USB30_PRIM_SLEEP_CLK>,
		 <&gcc GCC_USB30_PRIM_MOCK_UTMI_CLK>;
	clock-names = "cfg_noc", "core", "iface", "sleep", "mock_utmi";
	assigned-clocks = <&gcc GCC_USB30_PRIM_MOCK_UTMI_CLK>,
			  <&gcc GCC_USB30_PRIM_MASTER_CLK>;
	assigned-clock-rates = <19200000>, <200000000>;

	power-domains = <&gcc USB30_PRIM_GDSC>;
	required-opps = <&rpmhpd_opp_nom>;

	resets = <&gcc GCC_USB30_PRIM_BCR>;

	interconnects = <&aggre1_noc MASTER_USB3_0 0 &mc_virt SLAVE_EBI1 0>,
			<&gem_noc MASTER_APPSS_PROC 0 &config_noc SLAVE_USB3_0 0>;
	interconnect-names = "usb-ddr", "apps-usb";

	phys = <&usb_0_hsphy>, <&usb_0_qmpphy>;
	phy-names = "usb2-phy", "usb3-phy";
};

&usb_1 {
	clocks = <&gcc GCC_CFG_NOC_USB3_SEC_AXI_CLK>,
		 <&gcc GCC_USB30_SEC_MASTER_CLK>,
		 <&gcc GCC_AGGRE_USB3_SEC_AXI_CLK>,
		 <&gcc GCC_USB30_SEC_SLEEP_CLK>,
		 <&gcc GCC_USB30_SEC_MOCK_UTMI_CLK>;
	clock-names = "cfg_noc", "core", "iface", "sleep", "mock_utmi";

	assigned-clocks = <&gcc GCC_USB30_SEC_MOCK_UTMI_CLK>,
			  <&gcc GCC_USB30_SEC_MASTER_CLK>;
	assigned-clock-rates = <19200000>, <200000000>;

	power-domains = <&gcc USB30_SEC_GDSC>;
	required-opps = <&rpmhpd_opp_nom>;

	resets = <&gcc GCC_USB30_SEC_BCR>;

	interconnects = <&aggre1_noc MASTER_USB3_1 0 &mc_virt SLAVE_EBI1 0>,
			<&gem_noc MASTER_APPSS_PROC 0 &config_noc SLAVE_USB3_1 0>;
	interconnect-names = "usb-ddr", "apps-usb";

	phys = <&usb_1_hsphy>, <&usb_1_qmpphy>;
	phy-names = "usb2-phy", "usb3-phy";
};

&usb_2 {
	clocks = <&gcc GCC_CFG_NOC_USB2_PRIM_AXI_CLK>,
		 <&gcc GCC_USB20_MASTER_CLK>,
		 <&gcc GCC_AGGRE_USB2_PRIM_AXI_CLK>,
		 <&gcc GCC_USB20_SLEEP_CLK>,
		 <&gcc GCC_USB20_MOCK_UTMI_CLK>;
	clock-names = "cfg_noc", "core", "iface", "sleep", "mock_utmi";

	assigned-clocks = <&gcc GCC_USB20_MOCK_UTMI_CLK>,
			  <&gcc GCC_USB20_MASTER_CLK>;
	assigned-clock-rates = <19200000>, <200000000>;

	power-domains = <&gcc USB20_PRIM_GDSC>;
	required-opps = <&rpmhpd_opp_nom>;

	resets = <&gcc GCC_USB20_PRIM_BCR>;

	interconnects = <&aggre1_noc MASTER_USB2 0 &mc_virt SLAVE_EBI1 0>,
			<&gem_noc MASTER_APPSS_PROC 0 &config_noc SLAVE_USB2 0>;
	interconnect-names = "usb-ddr", "apps-usb";

	phys = <&usb_2_hsphy>;
	phy-names = "usb2-phy";
};
