// SPDX-License-Identifier: BSD-3-Clause
/*
 * Copyright (c) Qualcomm Technologies, Inc. and/or its subsidiaries.
 */

/dts-v1/;

#include "mahua.dtsi"
#include "glymur-qcb.dtsi"

/ {
	model = "Qualcomm Technologies, Inc. Mahua QCB";
	compatible = "qcom,mahua-qcb", "qcom,mahua";
};

&tcsr {
	vdda-qrefrpt0-0p9-supply = <&vreg_l2f1>;
	vdda-qrefrpt1-0p9-supply = <&vreg_l2f1>;
	vdda-qrefrpt2-0p9-supply = <&vreg_l2f1>;
	vdda-qrefrpt3-0p9-supply = <&vreg_l1f1>;
	vdda-qrefrpt4-0p9-supply = <&vreg_l2h0>;
	vdda-qrefrpt5-0p9-supply = <&vreg_l2h0>;
	vdda-qrefrx0-0p9-supply = <&vreg_l2f1>;
	vdda-qrefrx1-0p9-supply = <&vreg_l2f1>;
	vdda-qrefrx2-0p9-supply = <&vreg_l2f1>;
	vdda-qrefrx3-0p9-supply = <&vreg_l2h0>;
	vdda-qreftx1-0p9-supply = <&vreg_l1f1>;
	vdda-refgen3-0p9-supply = <&vreg_l1f1>;
	vdda-refgen3-1p2-supply = <&vreg_l4f1>;
};
