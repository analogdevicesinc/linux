// SPDX-License-Identifier: GPL-2.0
/*
 * SM7125 Samsung Galaxy A52 (a52q) specific device tree source
 *
 * Copyright (c) 2026, Erikas Bitovtas. All rights reserved.
 */

/dts-v1/;

#include "sm7125-samsung-common.dtsi"

/ {
	model = "Samsung Galaxy A52";
	compatible = "samsung,a52q", "qcom,sm7125";
	qcom,board-id = <0x22 0x6>;
};

&rmtfs_mem {
	reg = <0x0 0xf4f00000 0x0 0x202000>;
};
