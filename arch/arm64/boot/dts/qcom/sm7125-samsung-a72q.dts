// SPDX-License-Identifier: GPL-2.0
/*
 * SM7125 Samsung Galaxy A72 (a72q) specific device tree source
 *
 * Copyright (c) 2026, Erikas Bitovtas. All rights reserved.
 */

/dts-v1/;

#include "sm7125-samsung-common.dtsi"

/ {
	model = "Samsung Galaxy A72";
	compatible = "samsung,a72q", "qcom,sm7125";
	qcom,board-id = <0x22 0x5>;
};

&rmtfs_mem {
	reg = <0x0 0xf3700000 0x0 0x202000>;
};
