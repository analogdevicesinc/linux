// SPDX-License-Identifier: BSD-3-Clause
/*
 * Extra EL2 overlay for platforms where Linux programs remoteproc
 * IOMMU streams because PAS is available.
 *
 * Do not apply this on current WoA firmware. Those DSPs are started
 * by the bootloader and rely on the SMMU SID bypass set up in
 * qcom_smmu_cfg_probe(). Attaching iommus here replaces that bypass
 * with an empty translated context and faults SID 0x1000.
 */

/dts-v1/;
/plugin/;

&remoteproc_adsp {
	iommus = <&apps_smmu 0x1000 0x80>;
};

&remoteproc_cdsp {
	iommus = <&apps_smmu 0x0c00 0x0>;
};
