// SPDX-License-Identifier: GPL-2.0
/*
 * Analog Devices AD9081-FMC-EBZ
 * https://wiki.analog.com/resources/tools-software/linux-drivers/iio-mxfe/ad9081
 * https://wiki.analog.com/resources/eval/user-guides/ad9081_fmca_ebz/ad9081_fmca_ebz_hdl
 *
 * hdl_project: <ad9081_fmca_ebz/vck190>
 * board_revision: <>
 *
 * Copyright (C) 2019-2020 Analog Devices Inc.
 */


#include "versal-vck190-reva-ad9081-204c-txmode22-rxmode23.dts"


&trx0_ad9081 {
	compatible = "adi,ad9082";
};
