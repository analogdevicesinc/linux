// SPDX-License-Identifier: GPL-2.0
/*
 * Analog Devices AD9084 RevC
 * https://wiki.analog.com/resources/tools-software/linux-drivers/iio-mxfe/ad9084
 * https://wiki.analog.com/resources/eval/user-guides/ad9084_fmca_ebz/ad9084_fmca_ebz_hdl
 *
 * hdl_project: <ad9084_fmca_ebz/vck190>
 * board_revision: <Rev.C>
 *
 * Copyright (C) 2025 Analog Devices Inc.
 */

#define DEVICE_PROFILE_NAME     "204C_M4_L4_NP16_20p0_4x4.bin"


#define HMC7044_PLL2_FREQ       (2500000000) // 2.5 GHz (2150...3200 MHz range)
#define AION_VCO_FREQ_HZ        (2500000000) // 2.5 GHz (2375...2625 MHz range)

#define SYSREF_CLK_MHz          (9765625)

#define WITH_AION 1

#include "versal-vck190-reva-ad9084.dts"
