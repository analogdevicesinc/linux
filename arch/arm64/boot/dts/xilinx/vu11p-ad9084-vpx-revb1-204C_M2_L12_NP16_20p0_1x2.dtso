// SPDX-License-Identifier: GPL-2.0
/dts-v1/;
/plugin/;

#include "vu11p-ad9084-vpx-revb-204C_M2_L12_NP16_20p0_1x2.dtso"

// RevB-1 uses LTC6955 (not -1) so not divider for ADF4382
&adf4382 {
	clocks = <&clkin_125>;
};
