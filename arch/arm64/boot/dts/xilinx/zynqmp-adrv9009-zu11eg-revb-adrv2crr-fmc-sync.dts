// SPDX-License-Identifier: GPL-2.0
/*
 * dts file for ADRV2CRR-FMC using ADRV9009-ZU11EG Rev.B System on Module
 *
 * Copyright (C) 2019 Analog Devices Inc.
 *
 */

#include "zynqmp-adrv9009-zu11eg-reva-adrv2crr-fmc-sync.dts"
#include "zynqmp-adrv9009-zu11eg-revb.dtsi"

&dwc3_0 {
	status = "okay";
	dr_mode = "otg";
};
