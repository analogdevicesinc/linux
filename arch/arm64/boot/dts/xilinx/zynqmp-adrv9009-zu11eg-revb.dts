// SPDX-License-Identifier: GPL-2.0
/*
 * dts file for ADRV2CRR-FMC using ADRV9009-ZU11EG Rev.B System on Module
 *
 * Copyright (C) 2019 Analog Devices Inc.
 *
 * Summary of RevA -> RevB changes:
 *
 * OUT 1,3,8,9	-- LVPECL force & force to logic zero
 * OUT 6,7	-- CML no pull-up(will be LVPECL on rev C)
 */

#include "zynqmp-adrv9009-zu11eg-reva.dts"
#include "zynqmp-adrv9009-zu11eg-revb.dtsi"

