// SPDX-License-Identifier: GPL-2.0
/*
 * dts file for Analog Devices, Inc. Jupiter SDR
 *
 * hdl_project: <jupiter_sdr>
 * board_revision: <>
 *
 * Copyright (C) 2024 Analog Devices Inc.
 */

/dts-v1/;

#include "zynqmp-jupiter-sdr.dtsi"

&axi_adrv9002_core_tx1 {
	compatible = "adi,axi-adrv9002-rx2tx2-1.0";
};

&adc0_adrv9002 {
	compatible = "adi,adrv9002-rx2tx2";
	ssi-sync-gpios = <&gpio 85 GPIO_ACTIVE_HIGH>;
	clock-output-names = "rx1_sampl_clk", "tx1_sampl_clk", "tdd1_intf_clk";

	adi,ssi-fixed-delays {
		adi,rx1-clk-delay = <0>;
		adi,rx1-data-delay = <3>;
		adi,rx2-clk-delay = <6>;
		adi,rx2-data-delay = <6>;
		adi,tx1-clk-delay = <0>;
		adi,tx1-data-delay = <3>;
		adi,tx2-clk-delay = <0>;
		adi,tx2-data-delay = <3>;
	};
};
