// SPDX-License-Identifier: GPL-2.0
/*
 * ADIN1100 Eval board on ZCU102 carrier
 *
 * hdl_project: <>
 * board_revision: <>
 *
 * Copyright 2020 Analog Devices Inc.
 */
#include "zynqmp-zcu102-rev1.0.dts"
#include "adi-adin1100-mii.dtsi"
