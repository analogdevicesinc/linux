// SPDX-License-Identifier: GPL-2.0
/*
 * Analog Devices ADRV9029
 * https://wiki.analog.com/resources/eval/user-guides/adrv9025
 * https://wiki.analog.com/resources/tools-software/linux-drivers/iio-transceiver/adrv9025
 *
 * hdl_project: <adrv9026/zcu102>
 * board_revision: <>
 *
 * Copyright (C) 2020-2026 Analog Devices Inc.
 */

#include "zynqmp-zcu102-rev10-adrv9025.dts"

&trx0_adrv9025 {
	compatible = "adi,adrv9029";
};
