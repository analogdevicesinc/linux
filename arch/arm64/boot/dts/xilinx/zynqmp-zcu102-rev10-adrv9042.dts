// SPDX-License-Identifier: GPL-2.0
/*
 * Analog Devices ADRV9042
 * https://developer.analog.com/docs/system-level/solutions/reference-designs/eval-adrv904x/
 * https://developer.analog.com/docs/linux/drivers/iio-transceiver/adrv904x/
 *
 * hdl_project: <adrv904x/zcu102>
 * board_revision: <>
 *
 * Copyright (C) 2020-2026 Analog Devices Inc.
 */

#include "zynqmp-zcu102-rev10-adrv904x.dts"

&trx0_adrv904x {
	compatible = "adi,adrv9042";
};
