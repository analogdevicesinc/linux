// SPDX-License-Identifier: GPL-2.0
/*
 * ADIN PHY FMC board
 * https://wiki.analog.com/resources/tools-software/linux-drivers/net-phy/adin
 *
 * hdl_project: <cn0506/zcu102>
 * board_revision: <>
 *
 * Copyright 2020 Analog Devices Inc.
 */
#include "zynqmp-zcu102-rev1.0.dts"
#include "adi-cn0506-rmii.dtsi"

/ {
	fpga_axi: fpga-axi@0 {
		interrupt-parent = <&gic>;
		compatible = "simple-bus";
		#address-cells = <0x1>;
		#size-cells = <0x1>;
		ranges = <0 0 0 0xffffffff>;

		axi_sysid_0: axi-sysid-0@85000000 {
			compatible = "adi,axi-sysid-1.00.a";
			reg = <0x85000000 0x2000>;
		};
	};
};
