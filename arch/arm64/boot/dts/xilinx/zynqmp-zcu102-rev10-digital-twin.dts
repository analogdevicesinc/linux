// SPDX-License-Identifier: GPL-2.0
/*
 * Analog Devices AD9081-FMC-EBZ
 * https://wiki.analog.com/resources/eval/user-guides/quadmxfe/quick-start
 * https://wiki.analog.com/resources/tools-software/linux-drivers/iio-mxfe/ad9081
 *
 * hdl_project: <ad9081_fmca_ebz/zcu102>
 * board_revision: <>
 *
 * Copyright (C) 2021 Analog Devices Inc.
 */

// JESD204C use case with 6.6 Gbps lane rate using REFCLK 100MHz

// HDL Synthesis Parameters:
// JESD_MODE=64B66B
// RX_LANE_RATE=6.6
// TX_LANE_RATE=6.6
// RX_JESD_M=1
// RX_JESD_L=8
// RX_JESD_S=4
// RX_JESD_NP=16
// RX_NUM_LINKS=1
// RX_TPL_WIDTH=16
// TX_JESD_M=1
// TX_JESD_L=8
// TX_JESD_S=4
// TX_JESD_NP=16
// TX_NUM_LINKS=1
// TX_TPL_WIDTH=16
// TDD_SUPPORT=0
// SHARED_DEVCLK=0

#include <dt-bindings/iio/adc/adi,ad9081.h>
#include "zynqmp-zcu102-rev10-digital-twin-default.dtsi"

// this is the dts for the zcu102 digital twin

&axi_ad9081_core_tx {
	single-shot-output-gpios = <&gpio 139 0>;
};

