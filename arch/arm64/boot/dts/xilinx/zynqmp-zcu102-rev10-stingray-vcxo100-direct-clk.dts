// SPDX-License-Identifier: GPL-2.0
/*
 * Analog Devices Stingray
 * https://wiki.analog.com/resources/eval/user-guides/quadmxfe/quick-start
 * https://wiki.analog.com/resources/tools-software/linux-drivers/iio-mxfe/ad9081
 *
 * hdl_project: <ad9081_fmca_ebz_x_band/zcu102>
 * board_revision: <>
 *
 * Copyright (C) 2019-2020 Analog Devices Inc.
 */

#include "zynqmp-zcu102-rev10-stingray-vcxo100.dts"

/ {
	clocks {
		direct_clk_12000m: clock@1 {
			#clock-cells = <0>;
			compatible = "fixed-clock";
			clock-frequency = <1200000000>;	/* DAC_FREQUENCY / 10 */
			clock-output-names = "direct_clk_12000m";
		};
	};
};

&trx0_ad9081 {
	clocks = <&direct_clk_12000m>;	/* dev_clk */
	dev_clk-clock-scales = <1 10>;
};
