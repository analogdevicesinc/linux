// SPDX-License-Identifier: GPL-2.0
/*
 * Analog Devices AD9081-FMC-EBZ
 * https://wiki.analog.com/resources/tools-software/linux-drivers/iio-mxfe/ad9081
 * https://wiki.analog.com/resources/eval/user-guides/ad9081_fmca_ebz/ad9081_fmca_ebz_hdl
 *
 * hdl_project: <ad9081_fmca_ebz/vcu118>
 * board_revision: <>
 *
 * Copyright (C) 2019-2020 Analog Devices Inc.
 */

#include "vcu118_ad9081_204c_txmode_23_rxmode_25.dts"

/*
 * There are different versions of the AD9081-FMC-EBZ & AD9082-FMC-EBZ
 * VCXO = 122.880 MHz, XO = 122.880MHz (AD9081-FMC-EBZ & AD9082-FMC-EBZ)
 * VCXO = 100.000 MHz, XO = 100.000MHz (AD9081-FMC-EBZ-A2 & AD9082-FMC-EBZ-A2)
 * To determine which board is which, read the freqency printed on the VCXO
 * or use the fru-dump utility:
 * #fru-dump -b /sys/bus/i2c/devices/15-0050/eeprom
 */

&hmc7044 {
	adi,pll1-clkin-frequencies = <100000000 10000000 0 0>;
	adi,vcxo-frequency = <100000000>;
};
