// SPDX-License-Identifier: GPL-2.0
/*
 * Analog Devices AD9084 RevC
 * https://wiki.analog.com/resources/tools-software/linux-drivers/iio-mxfe/ad9084
 * https://wiki.analog.com/resources/eval/user-guides/ad9084_fmca_ebz/ad9084_fmca_ebz_hdl
 *
 * hdl_project: <ad9084_ebz/vcu118>
 * board_revision: <Rev.C>
 *
 * make RX_JESD_L=4 TX_JESD_L=4 AION_ENABLE=1 FSRC_ENABLE=1
 *
 * Copyright (C) 2026 Analog Devices Inc.
 */

#define DEVICE_PROFILE_NAME	"204C_L4_M4_NP16_20p0_4x4_fsrc_5_4.bin"

#define HMC7044_PLL2_FREQ	(2500000000) // 2.5 GHz (2150...3200 MHz range)
#define AION_VCO_FREQ_HZ	(2500000000) // 2.5 GHz (2375...2625 MHz range)

#define OUT_CLK_SELECT		XCVR_PROGDIV_CLK
#define SYS_CLK_SELECT		XCVR_QPLL

#define SYSREF_CLK_MHz		(9765625)

#define WITH_AION 1
#define WITH_AXI_AION_TRIG 1
#define WITH_FSRC 1
#define WITH_FSRC_TRIG 1
#define WITH_FSRC_PROFILE_RATIO 0
#define ASYNM_A_B_MODE 0

#include "vcu118_ad9084.dts"
