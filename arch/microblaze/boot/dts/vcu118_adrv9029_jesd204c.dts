// SPDX-License-Identifier: GPL-2.0
/*
 * Analog Devices ADRV9029 (JESD204C)
 * https://wiki.analog.com/resources/eval/user-guides/adrv9025
 * https://wiki.analog.com/resources/tools-software/linux-drivers/iio-transceiver/adrv9025
 *
 * hdl_project: <adrv9026/vcu118>
 * board_revision: <>
 *
 * Copyright (C) 2020-2026 Analog Devices Inc.
 */

#include "vcu118_adrv9025_jesd204c.dts"

&trx0_adrv9025 {
	compatible = "adi,adrv9029";
};
