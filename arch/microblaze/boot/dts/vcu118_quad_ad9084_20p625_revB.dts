// SPDX-License-Identifier: GPL-2.0
/*
 * Analog Devices Quad-AD9084 RevB (Triton)
 * https://analogdevicesinc.github.io/linux/drivers/iio-trx-rf/ad9088/
 * https://analogdevicesinc.github.io/system-level/solutions/reference-designs/ad9084_ebz/user-guide/
 *
 * hdl_project: <quad_apollo/vcu118>
 * board_revision: <Rev.B>
 *
 * 20 GSPS ADC / 20 GSPS DAC, JESD204C 20.625 Gbps, M4 L2 NP16 S1 E1
 *
 * Clock plan:
 *   J1 (external)         312.5 MHz
 *     LTC6953 /1          ADF4382 REFCLK 312.5 MHz -> 20 GHz (x64)
 *     LTC6953 /32         SYSREF (AION BSYNC, EZS SRQ, J50/J51) 9.765625 MHz
 *     LTC6953 /4          LTC6952 REF 78.125 MHz
 *     LTC6953 /20         ADF4351 REF 15.625 MHz -> 2.5 GHz (EXT_VCO_FREQ)
 *   LTC6952 (VCO 2.5 GHz)
 *     /8                  FPGA REFCLK, TX/RX core clocks 312.5 MHz
 *     /200                ADF4030 REF 12.5 MHz
 *     /256                ADF4030 BSYNC, J48/J49 9.765625 MHz
 *
 *   Link clock = 20.625 Gbps / 66 = 312.5 MHz
 *   LEMC = 312.5 MHz / 32 = 9.765625 MHz = SYSREF = 20 GHz / 2048
 *
 * Copyright (C) 2026 Analog Devices Inc.
 */

#define DEVICE_PROFILE_NAME	"204C_M4_L2_NP16_20p0_8x4.bin"

#define FREQ_J1_MHz		312500000
#define TX_CORE_CLK_MHz		312500000
#define RX_CORE_CLK_MHz		312500000
#define FPGA_REFCLK_CLK_MHz	312500000
#define SYSREF_CLK_MHz		9765625

#define ADF4382_FREQ_Hz		(20000000000)
#define EXT_VCO_FREQ		2500000000

#include "vcu118_quad_ad9084_revB.dts"

/ {
	model = "Analog Devices Quad-AD9084 Rev.B FMC @Xilinx/vcu118 204C_M4_L2_NP16_20p0_8x4";
};
