// SPDX-License-Identifier: (GPL-2.0+ OR BSD-3-Clause)
/*
 * Copyright 2017-2018 NXP
 */

#include "t1040qds.dts"

/include/ "qoriq-fman3-0-sdk.dtsi"
/include/ "qoriq-bman-portals-sdk.dtsi"
/include/ "qoriq-qman3-portals-sdk.dtsi"
/include/ "qoriq-qman3-ceetm0-8-sdk.dtsi"
