## drivers/gpu/drm/bridge/cadence/Kconfig
```kconfig
# SPDX-License-Identifier: GPL-2.0-only
config DRM_CDNS_DSI
	tristate "Cadence DPI/DSI bridge"
	select DRM_KMS_HELPER
	select DRM_MIPI_DSI
	select DRM_PANEL_BRIDGE
	select GENERIC_PHY
	select GENERIC_PHY_MIPI_DPHY
	depends on OF
	help
	  Support Cadence DPI to DSI bridge. This is an internal
	  bridge and is meant to be directly embedded in a SoC.

if DRM_CDNS_DSI

config DRM_CDNS_DSI_J721E
	bool "J721E Cadence DSI wrapper support"
	default y
	help
	  Support J721E Cadence DSI wrapper. The wrapper manages
	  the routing of the DSS DPI signal to the Cadence DSI.
endif

config DRM_CDNS_MHDP8546
	tristate "Cadence DPI/DP bridge"
	select DRM_DISPLAY_DP_HELPER
	select DRM_DISPLAY_HDCP_HELPER
	select DRM_DISPLAY_HELPER
	select DRM_KMS_HELPER
	select DRM_PANEL_BRIDGE
	depends on OF
	help
	  Support Cadence DPI to DP bridge. This is an internal
	  bridge and is meant to be directly embedded in a SoC.
	  It takes a DPI stream as input and outputs it encoded
	  in DP format.

if DRM_CDNS_MHDP8546

config DRM_CDNS_MHDP8546_J721E
	depends on ARCH_K3 || COMPILE_TEST
	bool "J721E Cadence DPI/DP wrapper support"
	default y
	help
	  Support J721E Cadence DPI/DP wrapper. This is a wrapper
	  which adds support for J721E related platform ops. It
	  initializes the J721E Display Port and sets up the
	  clock and data muxes.
endif

config DRM_CDNS_MHDP
	tristate "Cadence MHDP COMMON API driver"
	select DRM_DISPLAY_DP_HELPER
	select DRM_DISPLAY_HELPER
	select DRM_DISPLAY_HDCP_HELPER
	select DRM_DISPLAY_HDMI_HELPER
	select DRM_KMS_HELPER
	select DRM_PANEL_BRIDGE
	depends on OF
	help
	  Support Cadence MHDP API library.

config DRM_CDNS_HDMI
	tristate "Cadence HDMI DRM driver"
	depends on DRM_CDNS_MHDP

config DRM_CDNS_DP
	tristate "Cadence DP DRM driver"
	depends on DRM_CDNS_MHDP

config DRM_CDNS_AUDIO
	tristate "Cadence MHDP Audio driver"
	depends on DRM_CDNS_MHDP

config DRM_CDNS_HDCP
	tristate "Cadence HDMI/DP HDCP driver"
	depends on DRM_CDNS_MHDP
	help
	  Support HDCP for either HDMI or DisplayPort. This
	  requires that the SOC has HDCP keys programmed
	  in production.

config DRM_CDNS_HDMI_CEC
	tristate "Cadence MHDP HDMI CEC driver"
	select CEC_CORE
	select CEC_NOTIFIER
```

## drivers/gpu/drm/bridge/imx/Kconfig
```kconfig
if ARCH_MXC || COMPILE_TEST

config DRM_IMX8MP_DW_HDMI_BRIDGE
	tristate "Freescale i.MX8MP HDMI-TX bridge support"
	depends on OF
	depends on COMMON_CLK
	select DRM_DW_HDMI
	imply DRM_IMX8MP_HDMI_PVI
	imply PHY_FSL_SAMSUNG_HDMI_PHY
	help
	  Choose this to enable support for the internal HDMI encoder found
	  on the i.MX8MP SoC.

config DRM_IMX8MP_HDMI_PVI
	tristate "Freescale i.MX8MP HDMI PVI bridge support"
	depends on OF
	help
	  Choose this to enable support for the internal HDMI TX Parallel
	  Video Interface found on the Freescale i.MX8MP SoC.

config DRM_IMX_LDB_HELPER
	tristate

config DRM_IMX8QXP_PIXEL_COMBINER
	tristate "Freescale i.MX8QM/QXP pixel combiner"
	depends on OF
	depends on COMMON_CLK
	select DRM_KMS_HELPER
	help
	  Choose this to enable pixel combiner found in
	  Freescale i.MX8qm/qxp processors.

config DRM_IMX8QXP_PIXEL_LINK
	tristate "Freescale i.MX8QM/QXP display pixel link"
	depends on OF
	depends on IMX_SCU
	select DRM_KMS_HELPER
	help
	  Choose this to enable display pixel link found in
	  Freescale i.MX8qm/qxp processors.

config DRM_IMX8QXP_PIXEL_LINK_TO_DPI
	tristate "Freescale i.MX8QXP pixel link to display pixel interface"
	depends on OF
	select DRM_KMS_HELPER
	help
	  Choose this to enable pixel link to display pixel interface(PXL2DPI)
	  found in Freescale i.MX8qxp processor.

config DRM_IMX93_MIPI_DSI
	tristate "Freescale i.MX93 specific extensions for Synopsys DW MIPI DSI"
	depends on OF
	depends on COMMON_CLK
	select DRM_DW_MIPI_DSI
	select GENERIC_PHY
	select GENERIC_PHY_MIPI_DPHY
	help
	  Choose this to enable MIPI DSI controller found in Freescale i.MX93
	  processor.

config DRM_IMX95_LDB
	tristate "Freescale i.MX95 LVDS display bridge"
	depends on OF
	depends on COMMON_CLK
	select DRM_IMX_LDB_HELPER
	select DRM_KMS_HELPER
	help
	  Choose this to enable the internal LVDS Display Bridge(LDB) found in
	  Freescale i.MX95 processor.

config DRM_IMX95_MIPI_DSI
	tristate "NXP i.MX95 specific extensions for Synopsys DW MIPI DSI"
	depends on OF && MFD_SYSCON && COMMON_CLK
	select DRM_DW_MIPI_DSI
	select DRM_KMS_HELPER
	select MULTIPLEXER
	select REGMAP_MMIO
	help
	  Choose this to enable Synopsys DesignWare MIPI DSI found in NXP
	  i.MX95 processor.

config DRM_IMX95_PIXEL_INTERLEAVER
	tristate "NXP i.MX95 pixel interleaver"
	depends on OF && MFD_SYSCON && COMMON_CLK
	select DRM_KMS_HELPER
	select REGMAP_MMIO
	help
	  Choose this to enable pixel interleaver found in NXP i.MX95
	  processors.

config DRM_IMX95_PIXEL_LINK
	tristate "NXP i.MX95 display pixel link"
	depends on OF && MFD_SYSCON
	select DRM_KMS_HELPER
	select REGMAP_MMIO
	help
	  Choose this to enable display pixel link found in NXP i.MX95
	  processors.

endif # ARCH_MXC || COMPILE_TEST
```

## drivers/gpu/drm/imx/Kconfig
```kconfig
# SPDX-License-Identifier: GPL-2.0-only
config DRM_IMX
	tristate "DRM Support for Freescale i.MX"
	select DRM_KMS_HELPER
	select VIDEOMODE_HELPERS
	select DRM_GEM_DMA_HELPER
	depends on DRM && (ARCH_MXC || ARCH_MULTIPLATFORM || COMPILE_TEST)
	depends on IMX_IPUV3_CORE || IMX_DPU_CORE || IMX8MM_LCDIF_CORE
	help
	  enable i.MX graphics support

config DRM_IMX_LCDIF_MUX_DISPLAY
	tristate "Support for LCDIF mux displays"
	select DRM_PANEL_BRIDGE
	depends on DRM_IMX && OF && MFD_SYSCON

config DRM_IMX_PARALLEL_DISPLAY
	tristate "Support for parallel displays"
	select DRM_PANEL
	depends on DRM_IMX
	select VIDEOMODE_HELPERS

config DRM_IMX_TVE
	tristate "Support for TV and VGA displays"
	depends on DRM_IMX
	depends on COMMON_CLK
	select REGMAP_MMIO
	help
	  Choose this to enable the internal Television Encoder (TVe)
	  found on i.MX53 processors.

config DRM_IMX_LDB
	tristate "Support for LVDS displays"
	depends on DRM_IMX && MFD_SYSCON
	depends on COMMON_CLK
	select DRM_PANEL
	help
	  Choose this to enable the internal LVDS Display Bridge (LDB)
	  found on i.MX53 and i.MX6 processors.

config DRM_IMX8QM_LDB
	tristate "Support for i.MX8qm LVDS displays"
	depends on DRM_IMX && DRM_FSL_IMX_LVDS_BRIDGE
	depends on PHY_MIXEL_LVDS
	help
	  Choose this to enable the internal LVDS Display Bridge (LDB)
	  found on i.MX8qm processors.

config DRM_IMX8QXP_LDB
	tristate "Support for i.MX8qxp LVDS displays"
	depends on DRM_IMX && DRM_FSL_IMX_LVDS_BRIDGE
	depends on PHY_MIXEL_LVDS_COMBO
	help
	  Choose this to enable the internal LVDS Display Bridge (LDB)
	  found on i.MX8qxp processors.

config DRM_IMX8MP_LDB
	tristate "Support for i.MX8mp LVDS displays"
	depends on DRM_IMX && DRM_FSL_IMX_LVDS_BRIDGE
	depends on PHY_FSL_IMX8MP_LVDS
	help
	  Choose this to enable the internal LVDS Display Bridge (LDB)
	  found on i.MX8mp processors.

config DRM_IMX93_LDB
	tristate "Support for i.MX93 LVDS displays"
	depends on DRM_IMX && DRM_FSL_IMX_LVDS_BRIDGE
	depends on PHY_FSL_IMX8MP_LVDS
	help
	  Choose this to enable the internal LVDS Display Bridge (LDB)
	  found on i.MX93 processors.

config IMX8MP_HDMI_PAVI
	tristate "NXP i.MX8MP HDMI Audio Video (PVI/PAI)"
	help
	  Choose this if you want to use HDMI PAI/PVI on i.MX8MP.

config DRM_IMX_DW_MIPI_DSI
	tristate "Freescale i.MX DRM Synopsys DesignWare MIPI DSI"
	select DRM_DW_MIPI_DSI
	depends on DRM_IMX
	help
	  Choose this if you want to use Synopsys DesignWare MIPI DSI on i.MX93.

config DRM_IMX93_PARALLEL_DISPLAY_FORMAT
	tristate "Support for i.MX93 parallel display format"
	select DRM_PANEL_BRIDGE
	depends on DRM_IMX && OF && MFD_SYSCON
	help
	  Choose this to enable the internal parallel display format
	  configuration found on i.MX93 processors.

config DRM_IMX_HDMI
	tristate "Freescale i.MX DRM HDMI"
	select DRM_DW_HDMI
	select IMX8MP_HDMI_PAVI
	depends on DRM_IMX && OF
	help
	  Choose this if you want to use HDMI on i.MX6/i.MX8.

config DRM_IMX_SEC_DSIM
	tristate "Support for Samsung MIPI DSIM displays"
	depends on DRM_IMX
	select MFD_SYSCON
	select DRM_SEC_MIPI_DSIM
	help
	  Choose this to enable the internal SEC MIPI DSIM controller
	  found on i.MX platform.

source "drivers/gpu/drm/imx/dcnano/Kconfig"
source "drivers/gpu/drm/imx/dpu/Kconfig"
source "drivers/gpu/drm/imx/dpu95/Kconfig"
source "drivers/gpu/drm/imx/dcss/Kconfig"
source "drivers/gpu/drm/imx/mhdp/Kconfig"
source "drivers/gpu/drm/imx/ipuv3/Kconfig"
source "drivers/gpu/drm/imx/lcdif/Kconfig"
source "drivers/gpu/drm/imx/lcdifv3/Kconfig"
source "drivers/gpu/drm/imx/lcdc/Kconfig"
```

## drivers/gpu/drm/imx/dcnano/Kconfig
```kconfig
config DRM_IMX_DCNANO
	tristate "DRM support for NXP i.MX DCNANO Graphics"
	select DRM_KMS_HELPER
	select VIDEOMODE_HELPERS
	select DRM_GEM_DMA_HELPER
	select DRM_BRIDGE_CONNECTOR
	select DRM_DISPLAY_HELPER
	depends on DRM && OF && ARCH_MXC
	depends on COMMON_CLK
	help
	  enable NXP i.MX DCNANO graphics support
```

## drivers/gpu/drm/imx/dcss/Kconfig
```kconfig
config DRM_IMX_DCSS
	tristate
	depends on DRM_IMX
	depends on IMX_DCSS_CORE
	default y if DRM_IMX=y
	default m if DRM_IMX=m
```

## drivers/gpu/drm/imx/dpu/Kconfig
```kconfig
config DRM_IMX_DPU
	tristate "Freescale i.MX DPU DRM support"
	depends on DRM_IMX
	depends on IMX_DPU_CORE
	default y if DRM_IMX=y
	default m if DRM_IMX=m
```

## drivers/gpu/drm/imx/dpu95/Kconfig
```kconfig
config DRM_IMX95_DPU
	tristate "DRM support for NXP i.MX95 DPU Graphics"
	select DRM_KMS_HELPER
	select VIDEOMODE_HELPERS
	select DRM_GEM_DMA_HELPER
	depends on DRM && OF && ARCH_MXC && COMMON_CLK
	help
	  enable NXP i.MX95 DPU graphics support
```

## drivers/gpu/drm/imx/hdp/Kconfig
```kconfig
config DRM_IMX_HDP
	tristate "IMX8 HD Display Controller"
	select DRM_IMX
	select MX8_HDP_DP
	select DRM_KMS_HELPER
	select VIDEOMODE_HELPERS
	select DRM_GEM_CMA_HELPER
	select DRM_KMS_CMA_HELPER
	select DRM_PANEL
	help
	  Choose this if you want to use DP/HDMI on i.MX8.
```

## drivers/gpu/drm/imx/ipuv3/Kconfig
```kconfig
config DRM_IMX_IPUV3
	tristate
	depends on DRM_IMX
	depends on IMX_IPUV3_CORE
	default y if DRM_IMX=y
	default m if DRM_IMX=m
```

## drivers/gpu/drm/imx/lcdif/Kconfig
```kconfig
config DRM_IMX8MM_LCDIF
	tristate "i.MX8mm LCDIF controller DRM driver"
	depends on DRM_IMX
	depends on IMX8MM_LCDIF_CORE
	default y if DRM_IMX=y
	default m if DRM_IMX=m
	help
	  enable i.MX8mm LCDIF controller DRM driver under DRM_IMX.
```

## drivers/gpu/drm/imx/lcdifv3/Kconfig
```kconfig
config DRM_IMX_LCDIFV3
	tristate "i.MX LCDIFV3 controller DRM driver"
	depends on DRM_IMX
	depends on IMX_LCDIFV3_CORE
	default y if DRM_IMX=y
	default m if DRM_IMX=m
	help
	  enable i.MX LCDIFV3 controller DRM driver under DRM_IMX.
```

## drivers/gpu/drm/imx/mhdp/Kconfig
```kconfig
# SPDX-License-Identifier: GPL-2.0-only

config DRM_IMX_CDNS_MHDP
	tristate "NXP i.MX MX8 DRM HDMI/DP"
	select DRM_CDNS_MHDP
	select DRM_CDNS_DP
	select DRM_CDNS_HDMI
	select DRM_CDNS_AUDIO
	select DRM_CDNS_HDCP
	depends on DRM_IMX
	help
	  Choose this if you want to use HDMI on i.MX8.
```
