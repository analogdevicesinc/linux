## drivers/clk/eswin/Kconfig
```kconfig
# SPDX-License-Identifier: GPL-2.0

config COMMON_CLK_ESWIN
	bool

config COMMON_CLK_EIC7700
	tristate "EIC7700 Clock Driver"
	depends on ARCH_ESWIN || COMPILE_TEST
	select COMMON_CLK_ESWIN
	default ARCH_ESWIN
	help
	  This driver provides support for clock controller on ESWIN EIC7700
	  SoC. The clock controller generates and supplies clocks to various
	  peripherals within the SoC.
	  Say yes here to support the clock controller on the EIC7700 SoC.
```

## drivers/clk/s32/Kconfig
```kconfig
config ARCH_S32_CLK
	bool "Enable S32 CLK Framework"
	help
	  Support for the Clock Framework on S32 SoCs.
```

## drivers/clk/tenstorrent/Kconfig
```kconfig
# SPDX-License-Identifier: GPL-2.0-only

config TENSTORRENT_ATLANTIS_PRCM
	tristate "Support for Tenstorrent Atlantis PRCM Clock Controller"
	depends on ARCH_TENSTORRENT || COMPILE_TEST
	default ARCH_TENSTORRENT
	select REGMAP_MMIO
	select AUXILIARY_BUS
	select MFD_SYSCON
	help
	  Say yes here to support the different clock
	  controllers found in the Tenstorrent Atlantis SoC.
	  This includes the clocks from the RCPU, HSIO, MMIO
	  and PCIE domain.
```

## drivers/firmware/imx/Kconfig
```kconfig
# SPDX-License-Identifier: GPL-2.0-only
config IMX_DSP
	tristate "IMX DSP Protocol driver"
	depends on IMX_MBOX
	help
	  This enables DSP IPC protocol between host AP (Linux)
	  and the firmware running on DSP.
	  DSP exists on some i.MX8 processors (e.g i.MX8QM, i.MX8QXP).

	  It acts like a doorbell. Client might use shared memory to
	  exchange information with DSP side.

config IMX_SCU
	bool "IMX SCU Protocol driver"
	depends on IMX_MBOX
	select SOC_BUS
	help
	  The System Controller Firmware (SCFW) is a low-level system function
	  which runs on a dedicated Cortex-M core to provide power, clock, and
	  resource management. It exists on some i.MX8 processors. e.g. i.MX8QM
	  (QM, QP), and i.MX8QX (QXP, DX).

	  This driver manages the IPC interface between host CPU and the
	  SCU firmware running on M4.

config IMX_SCMI_MISC_DRV
	tristate "IMX SCMI MISC Protocol driver"
	depends on IMX_SCMI_MISC_EXT || COMPILE_TEST
	default y if ARCH_MXC
	help
	  The System Controller Management Interface firmware (SCMI FW) is
	  a low-level system function which runs on a dedicated Cortex-M
	  core that could provide misc functions such as board control.

	  This driver can also be built as a module.

config IMX_SEC_ENCLAVE
	tristate "i.MX Embedded Secure Enclave - EdgeLock Enclave Firmware driver."
	depends on IMX_MBOX && ARCH_MXC && ARM64
	select FW_LOADER
	default m if ARCH_MXC

	help
	  It is possible to use APIs exposed by the iMX Secure Enclave HW IP called:
	  - EdgeLock Enclave Firmware (for i.MX8ULP, i.MX93, i.MX95),
	  - SECO (for i.MX8DXL, i.MXQM, i.MXQXP),
	    like base, HSM, V2X & SHE using the SAB protocol via the shared Messaging
	    Unit. This driver exposes these interfaces via a set of file descriptors
	    allowing to configure shared memory, send and receive messages.

config IMX_ELE_TRNG
	tristate "i.MX ELE True Random Number Generator"
	depends on IMX_SEC_ENCLAVE
	default y
	select CRYPTO_RNG
	select HW_RANDOM

	help
	  With platforms having secure enclave as the only true source for
	  generating true random number, the config CONFIG_ELE_TRNG needs to be enabled.
	  This config helps provides kernel-side support for the Random Number generation,
          through NXP hardware IP for secure-enclave(s), called EdgeLock Enclave.
```

## drivers/fpga/Kconfig
```kconfig
#
# FPGA framework configuration
#

menu "FPGA Configuration Support"

config FPGA
	tristate "FPGA Configuration Framework"
	help
	  Say Y here if you want support for configuring FPGAs from the
	  kernel.  The FPGA framework adds a FPGA manager class and FPGA
	  manager drivers.

if FPGA

config FPGA_MGR_SOCFPGA
	tristate "Altera SOCFPGA FPGA Manager"
	depends on ARCH_SOCFPGA
	help
	  FPGA manager driver support for Altera SOCFPGA.

config FPGA_MGR_ZYNQ_FPGA
	tristate "Xilinx Zynq FPGA"
	help
	  FPGA manager driver support for Xilinx Zynq FPGAs.

endif # FPGA

config FPGA_OVERLAY
	tristate "FPGA Overlay Support"
	depends on OF_DYNAMIC && OF_OVERLAY
	select OF_EARLY_FLATTREE
	select OF_RESOLVE
	help
	  FPGA Overlay manager to load/unload overlays for FPGA fabric.


endmenu
```

## drivers/fpga/bridge/Kconfig
```kconfig
#
# FPGA Bridge Framework
#

config PZSDR_PCIE
	tristate "PicoZed SDR PCIe support"
	depends on PCI && (!X86 || X86_PAT)
	depends on FPGA_OVERLAY
	select FPGA_PCIE_AXI_BRIDGE
	select XILINX_PCIE_AXI_BRIDGE
	select IIO
	select AD7291
	select CF_AXI_ADC
	select AD9361
	select CF_AXI_DDS
	select SPI
	select SPI_XILINX
	select GPIOLIB
	select GPIO_XILINX
	select I2C
	select I2C_XILINX
	select DMADEVICES
	select AXI_DMAC
	select XILINX_AXI_INTC
	select COMMON_CLK

config FPGA_PCIE_AXI_BRDIGE
	tristate "FPGA PCIe AXI Bridge"
	depends on FPGA_OVERLAY
	depends on (!X86 || X86_PAT)
	help
	  Bridge from PCIe domain to AXI / OF Domain

if FPGA_PCIE_AXI_BRDIGE

config XILINX_PCIE_AXI_BRDIGE
	tristate "XILINX PCIe AXI Bridge"
	help
	  Xilinx FPGA bridge from PCIe domain to AXI / OF Domain	
	
	
endif #FPGA_PCIE_AXI_BRDIGE
```

## drivers/gpio/Kconfig.adi
```kconfig
# This file exists solely to be include in Kconfig.adi

config GPIO_ALL_ADI_DRIVERS
	tristate "Build all GPIO drivers for the Analog Devices kernel"
	select GPIO_MAX730X
	select GPIO_MAX7300
	select GPIO_MAX7301
```

## drivers/gpio/adi/Kconfig
```kconfig
# SPDX-License-Identifier: GPL-2.0-or-later

config GPIO_ADI_ADRV906X
	bool "Analog Devices Inc, ADRV906x SoC GPIO support"
	depends on PINCTRL_ADI_ADRV906X
	default PINCTRL_ADI_ADRV906X
	select GPIOLIB_IRQCHIP
	help
	  This option enables GPIO (General Purpose Input/Output) controller
	  support for Analog Devices ADRV906x System-on-Chip platforms. The
	  GPIO controller provides configurable I/O pins that can be used for
	  various digital signal operations including input sensing, output
	  control, and interrupt generation.

	  This driver also includes IRQ chip support for GPIO-based interrupts,
	  allowing GPIO pins to be used as interrupt sources.

	  Say Y here if you are building a kernel for ADRV906x hardware and
	  need GPIO functionality.
	  If unsure, say N.
```
