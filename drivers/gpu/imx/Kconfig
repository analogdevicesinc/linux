## drivers/iio/frequency/Kconfig
```kconfig
# SPDX-License-Identifier: GPL-2.0-only
#
# Frequency
#	Direct Digital Synthesis drivers (DDS)
#	Clock Distribution device drivers
#	Phase-Locked Loop (PLL) frequency synthesizers
#
# When adding new entries keep the list in alphabetical order

menu "Frequency Synthesizers DDS/PLL"

menu "Clock Generator/Distribution"

config AD9508
	tristate "Analog Devices AD9508 Clock Fanout Buffer"
	depends on SPI
	help
	  Say yes here to build support for Analog Devices AD9508 Clock Fanout Buffer with
	  Output Dividers and Delay Adjust. The driver provides direct access via sysfs.

	  To compile this driver as a module, choose M here: the
	  module will be called ad9508.

config AD9523
	tristate "Analog Devices AD9523 Low Jitter Clock Generator"
	depends on SPI
	depends on COMMON_CLK
	help
	  Say yes here to build support for Analog Devices AD9523 Low Jitter
	  Clock Generator. The driver provides direct access via sysfs.

	  To compile this driver as a module, choose M here: the
	  module will be called ad9523.

config AD9528
	tristate "Analog Devices AD9528 Low Jitter Clock Generator"
	depends on SPI
	depends on COMMON_CLK
	help
	  Say yes here to build support for Analog Devices AD9528 Low Jitter
	  Clock Generator. The driver provides direct access via sysfs.

	  To compile this driver as a module, choose M here: the
	  module will be called ad9528.

config AD9548
	tristate "Analog Devices AD9548 Network Clock Generator/Synchronizer"
	depends on SPI
	help
	  Say yes here to build support for Analog Devices AD9548
	  Quad/Octal Input Network Clock Generator/Synchronizer.

	  To compile this driver as a module, choose M here: the
	  module will be called ad9548.

config AD9517
	tristate "Analog Devices AD9517 12-Output Clock Generator"
	depends on SPI
	depends on COMMON_CLK
	help
	  Say yes here to build support for Analog Devices AD9517
	  12-Output Clock Generator.

	  To compile this driver as a module, choose M here: the
	  module will be called ad9517.

config HMC7044
	tristate "Analog Devices HMC7044, HMC7043 Clock Jitter Attenuator with JESD204B"
	depends on SPI
	depends on COMMON_CLK
	help
	  Say yes here to build support for Analog Devices HMC7044, HMC7043
	  Clock Jitter Attenuator with JESD204B.
	  The driver provides direct access via sysfs.

	  To compile this driver as a module, choose M here: the
	  module will be called hmc7044.

config LTC6952
	tristate "Analog Devices LTC6952 Clock Ultralow Jitter with JESD204B/C"
	depends on SPI
	depends on COMMON_CLK
	help
	  Say yes here to build support for Analog Devices LTC6952 Clock Ultralow
	  Jitter Attenuator with JESD204B/C. The driver provides direct access
	  via sysfs.

	  To compile this driver as a module, choose M here: the
	  module will be called ltc6952.

endmenu

menu "Direct Digital Synthesis"

config CF_AXI_DDS
	tristate "Analog Devices CoreFPGA AXI DDS driver"
	depends on SPI
	depends on COMMON_CLK
	select IIO_BUFFER_DMAENGINE
	help
	  Say yes here to build support for Analog Devices DDS chip
	  AD9122, provides direct access via sysfs.

config CF_AXI_DDS_AD9122
	tristate "Analog Devices AD9122 DAC"
	depends on CF_AXI_DDS
	help
	  Say yes here to build support for Analog Devices AD9122 DAC chip
	  ad9122, provides direct access via sysfs.

config CF_AXI_DDS_AD9144
	tristate "Analog Devices AD9144 DAC"
	depends on CF_AXI_DDS
	select REGMAP_SPI
	help
	  Say yes here to build support for Analog Devices AD9144 DAC chip
	  ad9144, provides direct access via sysfs.

config CF_AXI_DDS_AD9162
	tristate "Analog Devices AD9162 DAC"
	depends on CF_AXI_DDS
	help
	  Say yes here to build support for Analog Devices AD9162 DAC chip
	  ad9162, provides direct access via sysfs.

config CF_AXI_DDS_AD9172
	tristate "Analog Devices AD917x DAC"
	depends on CF_AXI_DDS
	help
	  Say yes here to build support for Analog Devices AD917x DAC chip
	  ad917x, provides direct access via sysfs.

config CF_AXI_DDS_AD9739A
	tristate "Analog Devices AD9739A DAC"
	depends on CF_AXI_DDS
	help
	  Say yes here to build support for Analog Devices AD9739A DAC chip
	  ad9739a, provides direct access via sysfs.

config CF_AXI_DDS_AD9783
	tristate "Analog Devices AD9783 DAC"
	depends on CF_AXI_DDS
	help
	  Say yes here to build support for Analog Devices AD9783 DAC family,
	  provides direct access via sysfs.

	  The AD9780/AD9781/AD9783 include pin-compatible, high
	  dynamic range, dual digital-to-analog converters (DACs) with
	  12-/14-/16-bit resolutions, and sample rates of up to 500 MSPS.

config M2K_DAC
	tristate "Analog Devices M2K DAC"
	depends on CF_AXI_DDS
	help
	  Say yes here to build support for Analog Devices M2K platform DAC buffer
	  output.
endmenu

#
# Phase-Locked Loop (PLL) frequency synthesizers
#

menu "Phase-Locked Loop (PLL) frequency synthesizers"


config ADF4159
	tristate "Analog Devices ADF4159/ADF4169 Waveform Generating Synthesizers"
	depends on SPI
	select REGMAP_SPI
	help
	  Say yes here to build support for Analog Devices ADF4159 and ADF4169
	  Direct Modulation/Fast Waveform Generating, 13 GHz,
	  Fractional-N Frequency Synthesizers.
	  The driver provides direct access via sysfs.

	  To compile this driver as a module, choose M here: the
	  module will be called adf4159.

config ADF4350
	tristate "Analog Devices ADF4350/ADF4351 Wideband Synthesizers"
	depends on SPI
	help
	  Say yes here to build support for Analog Devices  ADF4350/ADF4351
	  Wideband Synthesizers. The driver provides direct access via sysfs.

	  To compile this driver as a module, choose M here: the
	  module will be called adf4350.

config ADF4360
	tristate "Analog Devices ADF4360 Wideband Synthesizers"
	depends on SPI
	depends on COMMON_CLK
	help
	  Say yes here to build support for Analog Devices ADF4360
	  Wideband Synthesizers. The driver provides direct access via sysfs.

	  To compile this driver as a module, choose M here: the
	  module will be called adf4360.

config ADF4371
	tristate "Analog Devices ADF4371/ADF4372 Wideband Synthesizers"
	depends on SPI
	select REGMAP_SPI
	help
	  Say yes here to build support for Analog Devices ADF4371 and ADF4372
	  Wideband Synthesizers. The driver provides direct access via sysfs.

	  To compile this driver as a module, choose M here: the
	  module will be called adf4371.

config ADF4377
	tristate "Analog Devices ADF4377 Microwave Wideband Synthesizer"
	depends on SPI && COMMON_CLK
	help
	  Say yes here to build support for Analog Devices ADF4377 Microwave
	  Wideband Synthesizer.

	  To compile this driver as a module, choose M here: the
	  module will be called adf4377.

config ADF5355
	tristate "Analog Devices ADF5355/ADF4355 Wideband Synthesizers"
	depends on SPI
	depends on COMMON_CLK
	help
	  Say yes here to build support for Analog Devices ADF5355/ADF4355
	  Wideband Synthesizers. The driver provides direct access via sysfs.

	  To compile this driver as a module, choose M here: the
	  module will be called adf5355.

config ADMFM2000
	tristate "Analog Devices ADMFM2000 Dual Microwave Down Converter"
	depends on GPIOLIB
	help
	  Say yes here to build support for Analog Devices ADMFM2000 Dual
	  Microwave Down Converter.

	  To compile this driver as a module, choose M here: the
	  module will be called admfm2000.

config ADMV1013
	tristate "Analog Devices ADMV1013 Microwave Upconverter"
	depends on SPI && COMMON_CLK
	help
	  Say yes here to build support for Analog Devices ADMV1013
	  24 GHz to 44 GHz, Wideband, Microwave Upconverter.

	  To compile this driver as a module, choose M here: the
	  module will be called admv1013.

config ADMV1014
	tristate "Analog Devices ADMV1014 Microwave Downconverter"
	depends on SPI && COMMON_CLK
	help
	  Say yes here to build support for Analog Devices ADMV1014
	  24 GHz to 44 GHz, Wideband, Microwave Downconverter.

	  To compile this driver as a module, choose M here: the
	  module will be called admv1014.

config ADMV4420
       tristate "Analog Devices ADMV4420 K Band Downconverter"
       depends on SPI
       help
         Say yes here to build support for Analog Devices K Band
         Downconverter with integrated Fractional-N PLL and VCO.

         To compile this driver as a module, choose M here: the
         module will be called admv4420.

config ADRF6780
        tristate "Analog Devices ADRF6780 Microwave Upconverter"
        depends on SPI
        depends on COMMON_CLK
        help
          Say yes here to build support for Analog Devices ADRF6780
          5.9 GHz to 23.6 GHz, Wideband, Microwave Upconverter.

          To compile this driver as a module, choose M here: the
          module will be called adrf6780.

endmenu

#
# RF Front-Ends
#

menu "RF Front-Ends"
config ADL5960
	tristate "Analog Devices ADL5960 Vector Network Analyzer Front-End"
	depends on SPI
	depends on COMMON_CLK
	depends on OF
	select REGMAP_SPI
	help
	  Say yes here to build support for Analog Devices ADL5960
	  10 MHz to 20 GHz, Integrated Vector Network Analyzer Front-End.

	  To compile this driver as a module, choose M here: the
	  module will be called adl5960.

endmenu
endmenu
```

## drivers/iio/imu/smi330/Kconfig
```kconfig
# SPDX-License-Identifier: GPL-2.0
#
# SMI330 IMU driver
#

config SMI330
	tristate "Bosch Sensor SMI330 Inertial Measurement Unit"
	select IIO_BUFFER
	select IIO_TRIGGERED_BUFFER
	depends on I2C || SPI
	help
	  Enable support for the Bosch SMI330 IMU.

	  The driver supports different operation modes like polling,
	  data ready or fifo mode and advanced features like no-motion,
	  no-motion, any-motion or tilt detection.

config SMI330_I2C
	tristate "Bosch SMI330 I2C driver"
	depends on I2C
	select SMI330
	select REGMAP_I2C
	help
	  Enable support for the Bosch SMI330 6-Axis IMU connected to I2C
	  interface.

	  This driver can also be built as a module. If so, the module will be
	  called smi330_i2c.

config SMI330_SPI
	tristate "Bosch SMI330 SPI driver"
	depends on SPI
	select SMI330
	select REGMAP_SPI
	help
	  Enable support for the Bosch SMI330 6-Axis IMU connected to SPI
	  interface.

	  This driver can also be built as a module. If so, the module will be
	  called smi330_spi.
```

## drivers/iio/jesd204/Kconfig
```kconfig
if JESD204

config ALTERA_ARRIA10_JESD204_PHY
	tristate "Altera Arria10 JESD204 PHY Support"
	depends on COMMON_CLK

config AXI_ADXCVR
	tristate "Analog Devices AXI ADXCVR PHY Support"
	depends on COMMON_CLK
	select XILINX_TRANSCEIVER

config AXI_JESD204B
	tristate "Generic AXI JESD204B configuration driver"
	depends on COMMON_CLK
	select XILINX_TRANSCEIVER

config AXI_JESD204_TX
	tristate "Analog Devices AXI JESD204B TX Support"
	depends on COMMON_CLK
	select REGMAP_MMIO

config AXI_JESD204_RX
	tristate "Analog Devices AXI JESD204B RX Support"
	depends on COMMON_CLK
	select REGMAP_MMIO

config XILINX_TRANSCEIVER
	tristate

config ADI_IIO_FAKEDEV
	tristate "Analog Devices Generic IIO fake device driver"
	help
	  This driver allows to link a list of device sysfs attributes
	  from either a platform, spi or i2c device to an iio device.
	  This driver should only be used for debug or test purposes.

	  To compile this driver as a module, choose M here: the
	  module will be called adi-iio-fakedev.

endif
```

## drivers/iio/meter/Kconfig
```kconfig
# SPDX-License-Identifier: GPL-2.0
#
# IIO meter drivers configuration
#
menu "Active energy metering IC"

config ADE9078
	tristate "Analog Devices ADE9078 Poly Phase Multifunction Energy Metering IC Driver"
	depends on SPI
	select REGMAP_SPI
	select IIO_BUFFER
	help
	  Support driver for the ADE9078Poly Phase Multifunction Energy Meter,
	  select y to build the driver.

	  To compile this driver as a module, choose M here: the module
	  will be called ade9078

endmenu
```

## drivers/iio/motor/Kconfig
```kconfig
# SPDX-License-Identifier: GPL-2.0-only
#
# Motor controller drivers
#

menu "Motor controllers"

config TMC5222_CORE
	tristate
	select REGMAP

config TMC5222_I2C
	tristate "TMC5222 I2C Interface"
	depends on I2C
	select REGMAP_I2C
	select TMC5222_CORE
	help
	  Say Y here to enable support for the Trinamic TMC5222 dual stepper
	  motor controller with I2C interface.

	  The TMC5222 is a dual-axis stepper motor controller/driver IC with
	  integrated motion controller and drivers for up to 2A per coil.

	  To compile this driver as a module, choose M here: the module
	  will be called tmc5222-i2c.

config TMC5221_SPI
	tristate "TMC5221 SPI Interface"
	depends on SPI_MASTER
	select REGMAP_SPI
	select TMC5222_CORE
	help
	  Say Y here to enable support for the Trinamic TMC5221 dual stepper
	  motor controller with SPI interface.

	  The TMC5221 is a dual-axis stepper motor controller/driver IC with
	  integrated motion controller and drivers for up to 2A per coil.

	  To compile this driver as a module, choose M here: the module
	  will be called tmc5221-spi.

endmenu
```

## drivers/iio/multiplexer/Kconfig
```kconfig
# SPDX-License-Identifier: GPL-2.0-only
#
# Multiplexer drivers
#
# When adding new entries keep the list in alphabetical order

menu "Multiplexers"

config IIO_MUX
	tristate "IIO multiplexer driver"
	select MULTIPLEXER
	depends on OF || COMPILE_TEST
	help
	  Say yes here to build support for the IIO multiplexer.

	  To compile this driver as a module, choose M here: the
	  module will be called iio-mux.

config IIO_GEN_MUX
	tristate "IIO generic multiplexer driver"
	select MULTIPLEXER
	depends on OF
	help
	  Say yes here to build support for the IIO generic multiplexer.
	  This driver allows to control MUX devices via IIO device attributes.
	  Optionally this driver may also register a clock mux.

	  To compile this driver as a module, choose M here: the
	  module will be called iio-gen-mux.

endmenu
```

## drivers/iio/offload/Kconfig
```kconfig
# SPDX-License-Identifier: GPL-2.0-only
#
# SPI offload handlers for Industrial I/O
#
# When adding new entries keep the list in alphabetical order

menu "SPI offload handlers"

config IIO_PWM_TRIGGERED_DMA_BUFFER
	tristate "PWM trigger and DMA buffer connected to SPI offload"
	select AUXILIARY_BUS
	select IIO_BUFFER_DMAENGINE
	help
	  Provides a periodic hardware trigger via a PWM connected to the
	  trigger input of a SPI offload and a hardware buffer implemented
	  via DMA connected to the data output stream the a SPI offload.

	  To compile this driver as a module, choose M here: the
	  module will be called "iio-pwm-triggered-dma-buffer".

endmenu
```

## drivers/iio/regmap/Kconfig
```kconfig
#
# Industrial I/O Generic Regmap Access drivers
#
# When adding new entries keep the list in alphabetical order

menu "IIO Regmap Access Drivers"

config IIO_REGMAP
	tristate

config IIO_REGMAP_I2C
	tristate "IIO Regmap Access Driver via I2C"
	depends on REGMAP_I2C
	select IIO_REGMAP
	help
	  Say Y to build support for IIO Regmap Access Driver via I2C used
	  in order to access registers of devices connected through I2C.

	  To compile this driver as a module, say M here: the module will
	  be called iio-regmap-i2c.

config IIO_REGMAP_SPI
	tristate "IIO Regmap Access Driver via SPI"
	depends on REGMAP_SPI
	select IIO_REGMAP
	help
	  Say Y to build support for IIO Regmap Access Driver via SPI used
	  in order to access registers of devices connected through SPI.

	  To compile this driver as a module, say M here: the module will
	  be called iio-regmap-spi.
endmenu
```
