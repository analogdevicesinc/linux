## drivers/iio/temperature/p3t/Kconfig
```kconfig
# SPDX-License-Identifier: GPL-2.0-only

config IIO_P3T1085
	tristate
	depends on (I2C || I3C)

config IIO_P3T1085_I2C
	tristate "NXP P3T1085 temprature sensor I2C driver"
	select IIO_P3T1085
	select REGMAP_I2C
	help
	  Say yes here to build support for NXP P3T1085 I2C temperature
	  sensor.

	  To compile this driver as a module, choose M here: the module
	  will be called p3t1085_i2c

config IIO_P3T1085_I3C
	tristate "NXP P3T1085 temprature sensor I3C driver"
	select IIO_P3T1085
	select REGMAP_I3C
	help
	  Say yes here to build support for NXP P3T1085 I3C temperature
	  sensor.

	  To compile this driver as a module, choose M here: the module
	  will be called p3t1085_i3c
```

## drivers/input/Kconfig.adi
```kconfig
config INPUT_ALL_ADI_DRIVERS
	tristate "Build all Analog Devices Input Drivers"
	imply KEYBOARD_ADP5520
	imply KEYBOARD_ADP5588
	imply KEYBOARD_ADP5589
	imply KEYBOARD_GPIO
	imply INPUT_TOUCHSCREEN
	imply TOUCHSCREEN_ADS7846
	imply TOUCHSCREEN_AD7877
	imply TOUCHSCREEN_AD7879
	imply TOUCHSCREEN_AD7879_I2C
	imply TOUCHSCREEN_AD7879_SPI
	imply INPUT_MISC
	imply INPUT_AD714X
	imply INPUT_AD714X_I2C
	imply INPUT_AD714X_SPI
```

## drivers/input/touchscreen/synaptics_dsx/Kconfig
```kconfig
#
# Synaptics DSX touchscreen driver configuration
#
menuconfig TOUCHSCREEN_SYNAPTICS_DSX
	bool "Synaptics DSX touchscreen"
	default y
	help
	  Say Y here if you have a Synaptics DSX I2C touchscreen
	  connected to your system

	  if unsure, say N.

if TOUCHSCREEN_SYNAPTICS_DSX

config TOUCHSCREEN_SYNAPTICS_DSX_I2C
	tristate "Synaptics DSX core driver module"
	depends on I2C
	help
	  Say Y here if you have a Synaptics DSX I2C touchscreen
	  connected to your system

	  If unsure, say N.

	  To compile this driver as a module, choose M here: the
	  module will be called synaptics_dsx_i2c.

endif
```

## drivers/jesd204/Kconfig
```kconfig
# SPDX-License-Identifier: GPL-2.0+
#
# JESD204 framework configuration
#

menuconfig JESD204
	tristate "JESD204 High-Speed Serial Interface Framework"
	depends on OF
	help
	  The JESD204 is a "Serial Interface for data converters"
	  which describes a serialized interface between data converters
	  and logic devices. It contains normative information to enable
	  chip designers to implement devices that communicate with other
	  devices covered by this specification.

	  The JESD204 framework provides a unified model for supporting
	  initialization and operation of JESD204 transceivers, which aims
	  at reducing complexity when managing these types of devices.

config JESD204_TOP_DEVICE
	tristate "JESD204 Top Device"
	depends on JESD204
	help
	  Say yes here to build support for the generic jes204-top device.
	  The jesd204-top-device provides the link parameter for all other
	  link devices. Usually this is the converter device. However, in some
	  situations when using Multilink and some links are originating or
	  terminating on a separate system/FPGA entity, the converter device
	  itself might not be part of the TOPOLOGY.
	  This generic top-device can be used to provide the necessary
	  link parameters.

	  To compile this driver as a module, choose M here: the module will be
	  called jesd204_top_device.
```

## drivers/jesd204/linklayer/Kconfig
```kconfig
#
# JESD204 Link Layer Peripheral drivers
#

menu "JESD204 Link Layer Peripheral drivers"

config AXI_JESD204_TX
	tristate "Analog Devices AXI JESD204B TX Support"
	depends on COMMON_CLK
	select REGMAP_MMIO

config AXI_JESD204_RX
	tristate "Analog Devices AXI JESD204B RX Support"
	depends on COMMON_CLK
	select REGMAP_MMIO

endmenu
```
