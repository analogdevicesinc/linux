## drivers/gpu/imx/Kconfig
```kconfig
source "drivers/gpu/imx/ipu-v3/Kconfig"
source "drivers/gpu/imx/dpu/Kconfig"
source "drivers/gpu/imx/dpu-blit/Kconfig"
source "drivers/gpu/imx/lcdif/Kconfig"
source "drivers/gpu/imx/lcdifv3/Kconfig"
```

## drivers/gpu/imx/dcss/Kconfig
```kconfig
config IMX_DCSS_CORE
	tristate "i.MX DCSS core support"
	depends on ARCH_FSL_IMX8MQ
	select RESET_CONTROLLER
	select IMX_IRQSTEER
	help
	  Choose this if you have a Freescale i.MX8MQ system and want to use the
	  Display Controller Sub System. This option only enables DCSS base
	  support.
```

## drivers/gpu/imx/dpu-blit/Kconfig
```kconfig
config IMX_DPU_BLIT
	tristate
	depends on IMX_DPU_CORE
	default y if IMX_DPU_CORE=y
	default m if IMX_DPU_CORE=m
```

## drivers/gpu/imx/dpu/Kconfig
```kconfig
config IMX_DPU_CORE
	tristate "i.MX DPU core support"
	depends on ARCH_MXC
	select GENERIC_IRQ_CHIP
	help
	  Choose this if you have a Freescale i.MX8QM or i.MX8QXP system and
	  want to use the Display Processing Unit. This option only enables
	  DPU base support.
```

## drivers/gpu/imx/lcdif/Kconfig
```kconfig
config IMX8MM_LCDIF_CORE
	tristate "i.MX8mm LCDIF core support"
	depends on ARCH_MXC
	depends on DRM && OF
	select RESET_CONTROLLER
	help
	  Choose this if you have a NXP i.MX8MM platform and want to use the
	  LCDIF display controller. This option only enables LCDIF base support.
```

## drivers/gpu/imx/lcdifv3/Kconfig
```kconfig
config IMX_LCDIFV3_CORE
	tristate "i.MX LCDIFV3 core support"
	depends on ARCH_MXC
	depends on DRM && OF
	select RESET_CONTROLLER
	help
	  Choose this if you have a NXP i.MX8MP platform and want to use the
	  LCDIFV3 display controller. This option only enables LCDIFV3 base
	  support.
```

## drivers/hwmon/Kconfig.adi
```kconfig
# This file exists solely to be include in Kconfig.adi

config HWMON_ALL_ADI_DRIVERS
	tristate "Build all Analog Devices HWMON Drivers"
	imply CRC8
	imply PMBUS
	imply SENSORS_PMBUS
	imply SENSORS_AD7314
	imply SENSORS_AD7414
	imply SENSORS_AXI_FAN_CONTROL
	imply SENSORS_AD7418
	imply SENSORS_ADM1021
	imply SENSORS_ADM1025
	imply SENSORS_ADM1026
	imply SENSORS_ADM1029
	imply SENSORS_ADM1031
	imply SENSORS_ADM1177
	imply SENSORS_ADM1266
	imply SENSORS_ADM1275
	imply SENSORS_ADM9240
	imply SENSORS_ADT7310
	imply SENSORS_ADT7410
	imply SENSORS_ADT7411
	imply SENSORS_ADT7462
	imply SENSORS_ADT7470
	imply SENSORS_ADT7475
	imply SENSORS_LTC2945
	imply SENSORS_LTC2947_I2C
	imply SENSORS_LTC2947_SPI
	imply SENSORS_LTC2978
	imply SENSORS_LTC2978_REGULATOR
	imply SENSORS_LTC2990
	imply SENSORS_LTC2992
	imply SENSORS_LTC3815
	imply SENSORS_LTC4151
	imply SENSORS_LTC4215
	imply SENSORS_LTC4222
	imply SENSORS_LTC4245
	imply SENSORS_LTC4260
	imply SENSORS_LTC4261
	imply MAX31827
```

## drivers/i3c/master/Kconfig
```kconfig
# SPDX-License-Identifier: GPL-2.0-only
config ADI_I3C_MASTER
	tristate "Analog Devices I3C master driver"
	depends on I3C
	depends on HAS_IOMEM
	depends on !(ALPHA || PARISC)
	help
	  Support for Analog Devices I3C Controller IP, an AXI-interfaced IP
	  core that supports I3C and I2C devices, multiple speed-grades and
	  I3C IBIs.

	  This driver can also be built as a module.  If so, the module
	  will be called adi-i3c-master.

config CDNS_I3C_MASTER
	tristate "Cadence I3C master driver"
	depends on I3C
	depends on HAS_IOMEM
	depends on !(ALPHA || PARISC)
	help
	  Enable this driver if you want to support Cadence I3C master block.

config DW_I3C_MASTER
	tristate "Synospsys DesignWare I3C master driver"
	depends on I3C
	depends on HAS_IOMEM
	depends on !(ALPHA || PARISC)
	# ALPHA and PARISC needs {read,write}sl()
	help
	  Support for Synopsys DesignWare MIPI I3C Controller.

	  For details please see
	  https://www.synopsys.com/dw/ipdir.php?ds=mipi_i3c

	  This driver can also be built as a module.  If so, the module
	  will be called dw-i3c-master.

config SVC_I3C_MASTER
	tristate "Silvaco I3C Dual-Role Master driver"
	depends on I3C
	depends on HAS_IOMEM
	depends on !(ALPHA || PARISC)
	help
	  Support for Silvaco I3C Dual-Role Master Controller.

config MIPI_I3C_HCI
	tristate "MIPI I3C Host Controller Interface driver (EXPERIMENTAL)"
	depends on I3C
	depends on HAS_IOMEM
	help
	  Support for hardware following the MIPI Aliance's I3C Host Controller
	  Interface specification.

	  For details please see:
	  https://www.mipi.org/specifications/i3c-hci

	  This driver can also be built as a module.  If so, the module will be
	  called mipi-i3c-hci.
```

## drivers/iio/Kconfig.adi
```kconfig
# This file exists solely to be include in Kconfig.adi
# It's a bit of hurry-ed-up job; many symbols need to be depended
# on I2C or SPI, but that can be done later; the ADI image has
# these symbols enabled anyway

config IIO_ALL_ADI_DRIVERS
	tristate "Build all Analog Devices IIO Drivers"
	imply IIO_BUFFER
	imply IIO_SW_DEVICE
	imply IIO_SW_TRIGGER
	imply IIO_TRIGGERED_EVENT
	imply IIO_HRTIMER_TRIGGER
	imply IIO_INTERRUPT_TRIGGER
	imply IIO_SYSFS_TRIGGER
	imply IIO_TIGHTLOOP_TRIGGER
	imply IIO_BUFFER_CB
	imply IIO_BUFFER_DMA
	imply IIO_BUFFER_DMAENGINE
	imply IIO_BUFFER_HW_CONSUMER
	imply IIO_KFIFO_BUF
	imply IIO_TRIGGERED_BUFFER
	imply ALTERA_ARRIA10_JESD204_PHY if ARCH_INTEL_SOCFPGA
	imply AD_PULSAR
	imply ADIS16201
	imply ADIS16209
	imply ADXL313_I2C if I2C
	imply ADXL313_SPI if SPI
	imply ADXL345_I2C if I2C
	imply ADXL345_SPI if SPI
	imply ADXL355_I2C if I2C
	imply ADXL355_SPI if SPI
	imply ADXL367_I2C if I2C
	imply ADXL367_SPI if SPI
	imply ADXL372_I2C if I2C
	imply ADXL372_SPI if SPI
	imply AD400X
	imply AD4630
	imply AD4130
	imply AD4134
	imply AD6676
	imply AD7091R5
	imply AD7124
	imply AD7173
	imply AD7266
	imply AD7291
	imply AD7293
	imply AD7298
	imply AD738X
	imply AD7923
	imply AD7949
	imply AD7476
	imply AD7606_IFACE_PARALLEL
	imply AD7606_IFACE_SPI
	imply AD7766
	imply AD7768
	imply AD7768_1
	imply AD7791
	imply AD7793
	imply AD7887
	imply AD799X
	imply AD9963
	imply CF_AXI_ADC
	imply AD9208
	imply AD9081
	imply AD9083
	imply AD9361
	imply AD9361_EXT_BAND_CONTROL
	imply AD9371
	imply ADAQ8092
	imply ADAR1000
	imply ADAR3000
	imply ADRV9009
	imply ADRV9001
	imply AD9467
	imply AD9680
	imply ADMC
	imply CF_AXI_TDD
	imply AXI_PULSE_CAPTURE
	imply AXI_FMCADC5_SYNC
	imply XILINX_XADC if (ARCH_ZYNQ || ARCH_ZYNQMP || MICROBLAZE)
	imply LTC2497
	imply LTC2308
	imply LTC2358
	imply LTC2387
	imply AD8366
	imply ADA4250
	imply HMC425
	imply AD5270
	imply AD5360
	imply AD5380
	imply AD5421
	imply AD5624R_SPI if SPI
	imply AD3552R
	imply AD5064
	imply AD5504
	imply AD5446
	imply AD5449
	imply AD5592R_BASE
	imply AD5592R
	imply AD5593R
	imply AD5755
	imply AD5758
	imply AD5761
	imply AD5764
	imply AD5766
	imply AD5770R
	imply AD5791
	imply AD5686
	imply AD5686_SPI if SPI
	imply AD5696_I2C if I2C
	imply AD7303
	imply AD8801
	imply AD9508
	imply AD9517
	imply AD9523
	imply AD9528
	imply AD9548
	imply ADF4159
	imply ADF4350
	imply ADF4360
	imply ADF4371
	imply ADF4377
	imply ADF5355
	imply ADL5960
	imply ADMFM2000
	imply ADMV1013
	imply ADMV1014
	imply ADMV4420
	imply ADMV8818
	imply ADRF6780
	imply CF_AXI_DDS
	imply CF_AXI_DDS_AD9122
	imply CF_AXI_DDS_AD9144
	imply CF_AXI_DDS_AD9739A
	imply CF_AXI_DDS_AD9783
	imply HMC7044
	imply CF_AXI_DDS_AD9162
	imply CF_AXI_DDS_AD9172
	imply AD916X_AMP
	imply M2K_DAC
	imply ADIS16080
	imply ADIS16130
	imply ADIS16136
	imply ADIS16260
	imply ADIS16400
	imply ADIS16460
	imply ADIS16475
	imply ADIS16480
	imply M2K_LOGIC_ANALYZER
	imply AD5272
	imply IIO_REGMAP_I2C
	imply IIO_REGMAP_SPI
	imply AD2S1200
	imply LTC1660
	imply LTC2983
	imply ADIS16203
	imply ADIS16240
	imply AD7780
	imply AD7816
	imply AD7192
	imply AD7280
	imply AD7292
	imply ADT7316
	imply ADT7316_SPI if SPI
	imply ADT7316_I2C if I2C
	imply AD7150
	imply AD7152
	imply AD7746
	imply AD9832
	imply AD9834
	imply AD5933
	imply ADE7854
	imply ADE7854_I2C if I2C
	imply ADE7854_SPI if SPI
	imply AD2S90
	imply AD2S1210
	imply LTC6952
	imply LTC2471
	imply LTC2496
	imply LTC2632
	imply LTC2485
	imply ADXRS290
	imply ADXRS450
	imply AXI_JESD204_TX
	imply AXI_JESD204_RX
	imply AXI_ADXCVR
	imply ONE_BIT_ADC_DAC
	imply ADUX1020
	imply IIO_GEN_MUX
	imply AD74115
	imply AD74413R
	imply ADI_IIO_FAKEDEV
	imply LTC2688
	imply MAX11410
	imply AD5110
	imply MAX31865
	imply MAX11205
	imply ADRV9025
```

## drivers/iio/adc/Kconfig
```kconfig
#
# ADC drivers
#
menu "Analog to digital converters"

config AD7266
	tristate "Analog Devices AD7265/AD7266 ADC driver"
	depends on SPI_MASTER
	select IIO_BUFFER
	select IIO_TRIGGER
	select IIO_TRIGGERED_BUFFER
	help
	  Say yes here to build support for Analog Devices AD7265 and AD7266
	  ADCs.

config AT91_ADC
	tristate "Atmel AT91 ADC"
	depends on ARCH_AT91
	select IIO_BUFFER
	select IIO_TRIGGERED_BUFFER
	select SYSFS
	help
	  Say yes here to build support for Atmel AT91 ADC.

config CF_AXI_ADC
	tristate "Analog Devices AD9467 AD9643 High-Speed AXI ADC driver"
	select IIO_BUFFER
	help
	  Say yes here to build support for Analog Devices AD9467 and AD9643,
	  High-Speed LVDS analog to digital converters (ADC).
	  FPGA interface HDL is available here:
	  http://wiki.analog.com/resources/fpga/xilinx/fmc/ad9467
	  If unsure, say N (but it's safe to say "Y").

	  To compile this driver as a module, choose M here: the
	  module will be called cf_axi_adc.

config CF_AXI_FFT
	tristate "Generic FFT driver"

config AXI_JESD204B
	tristate "Generic AXI JESD204B configuration driver"


endmenu
```

## drivers/iio/addac/Kconfig
```kconfig
#
# ADC DAC drivers
#
# When adding new entries keep the list in alphabetical order

menu "Analog to digital and digital to analog converters"

config AD74413R
	tristate "Analog Devices AD74412R/AD74413R driver"
	depends on GPIOLIB && SPI
	select REGMAP_SPI
	select CRC8
	help
	  Say yes here to build support for Analog Devices AD74412R/AD74413R
	  quad-channel software configurable input/output solution.

	  To compile this driver as a module, choose M here: the
	  module will be called ad74413r.

config ONE_BIT_ADC_DAC
	tristate "Analog Devices ONE_BIT_ADC_DAC driver"
	help
	  Say yes here to build support for Analog Devices ONE_BIT_ADC_DAC
	  driver.

 	  To compile this driver as a module, choose M here: the
	  module will be called one-bit-adc-dac.

endmenu
```

## drivers/iio/amplifiers/Kconfig
```kconfig
# SPDX-License-Identifier: GPL-2.0
#
# Gain Amplifiers, etc.
#
# When adding new entries keep the list in alphabetical order

menu "Amplifiers"

config AD8366
	tristate "Analog Devices AD8366 and similar Gain Amplifiers"
	depends on SPI
	depends on GPIOLIB
	select BITREVERSE
	help
	  Say yes here to build support for Analog Devices AD8366 and similar
	  gain amplifiers. This driver supports the following gain amplifiers
	  from Analog Devices:
	    AD8366 Dual-Digital Variable Gain Amplifier (VGA)
	    ADA4961 BiCMOS RF Digital Gain Amplifier (DGA)
	    ADL5240 Digitally controlled variable gain amplifier (VGA)
	    HMC271 1 dB LSB GaAs MMIC 5-BIT Control Digital Attenuator
	    HMC1119 0.25 dB LSB, 7-Bit, Silicon Digital Attenuator

	  To compile this driver as a module, choose M here: the
	  module will be called ad8366.

config AD916X_AMP
	tristate "Analog Devices AD916x Amplifiers"
	depends on SPI
	help
	  Say yes here to build support for Analog Devices AD916x
	  SPI Amplifier's support. This devices act as output buffer's
	  in the AD916x DAC families.

	  To compile this driver as a module, choose M here: the
	  module will be called ad916x_amp.

config ADA4250
	tristate "Analog Devices ADA4250 Instrumentation Amplifier"
	depends on SPI
	help
	  Say yes here to build support for Analog Devices ADA4250
	  SPI Amplifier's support. The driver provides direct access via
          sysfs.

	  To compile this driver as a module, choose M here: the
	  module will be called ada4250.

config HMC425
	tristate "Analog Devices HMC425A and similar GPIO Gain Amplifiers"
	depends on GPIOLIB
	help
	  Say yes here to build support for Analog Devices HMC425A and similar
	  gain amplifiers or step attenuators.

	  To compile this driver as a module, choose M here: the
	  module will be called hmc425a.

endmenu
```
