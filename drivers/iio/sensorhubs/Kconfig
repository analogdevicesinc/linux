## scripts/kconfig/tests/err_num_reverse_range/Kconfig
```kconfig
# SPDX-License-Identifier: GPL-2.0
# Check constant range bounds.

config INT_ORDERED
	int
	range -10 10

config INT_EQUAL
	int
	range 5 5

config HEX_ORDERED
	hex
	range 0x7fffffffffffffff 0xffffffffffffffff

config HEX_EQUAL
	hex
	range 0xffffffffffffffff 0xffffffffffffffff

# Skip ranges with symbolic bounds.

config INT_LOWER
	int

config INT_UPPER
	int

config INT_SYMBOL_LOWER
	int
	range INT_LOWER 0

config INT_SYMBOL_UPPER
	int
	range 0 INT_UPPER

config INT_SYMBOL_BOTH
	int
	range INT_LOWER INT_UPPER

config HEX_LOWER
	hex

config HEX_UPPER
	hex

config HEX_SYMBOL_LOWER
	hex
	range HEX_LOWER 0x0

config HEX_SYMBOL_UPPER
	hex
	range 0x0 HEX_UPPER

config HEX_SYMBOL_BOTH
	hex
	range HEX_LOWER HEX_UPPER

# Reject reversed constant bounds.

config INT_REVERSED
	int
	range 10 2

config INT_REVERSED_NEGATIVE
	int
	range -1 -10

config INT_REVERSED_SIGNED
	int
	range 1 -1

config INT_REVERSED_QUOTED
	int
	range "8" "2"

config HEX_REVERSED
	hex
	range 0x10 0xf

config HEX_REVERSED_HIGH
	hex
	range 0xffffffffffffffff 0x8000000000000000

config HEX_REVERSED_UNPREFIXED
	hex
	range f a

# Check each conditional range independently.

config RANGE_CONDITION
	bool

config INT_REVERSED_FIRST
	int
	range 10 2 if RANGE_CONDITION
	range -10 10 if !RANGE_CONDITION

config INT_REVERSED_SECOND
	int
	range -10 10 if RANGE_CONDITION
	range 10 2 if !RANGE_CONDITION

config HEX_REVERSED_FIRST
	hex
	range 0x10 0xf if RANGE_CONDITION
	range 0x0 0x10 if !RANGE_CONDITION

config HEX_REVERSED_SECOND
	hex
	range 0x0 0x10 if RANGE_CONDITION
	range 0x10 0xf if !RANGE_CONDITION
```

## sound/soc/adi/Kconfig
```kconfig
# SPDX-License-Identifier: GPL-2.0-only
menu "Analog Devices"

config SND_SOC_ADI_AXI_I2S
	tristate "AXI-I2S support"
	select SND_SOC_GENERIC_DMAENGINE_PCM
	select REGMAP_MMIO
	help
	  ASoC driver for the Analog Devices AXI-I2S softcore peripheral.

config SND_SOC_ADI_AXI_SPDIF
	tristate "AXI-SPDIF support"
	select SND_SOC_GENERIC_DMAENGINE_PCM
	select REGMAP_MMIO
	help
	  ASoC driver for the Analog Devices AXI-SPDIF softcore peripheral.

config SND_SOC_ADI_ADSP_SPORT
	tristate "ADSP SPORT driver"
	select SND_DMAENGINE_PCM
	help
	  ASoC driver for the Serial Port (SPORT) interface found on Analog
	  Devices ADSP SoCs.

	  If built as a module, it will be called snd-soc-adi-adsp-sport.

source "sound/soc/adi/legacy/Kconfig"

endmenu
```

## sound/soc/cdns/Kconfig
```kconfig
# SPDX-License-Identifier: GPL-2.0

config SND_SOC_CDNS_I2S_SC
	tristate "Cadence I2S-SC controller support"
	depends on ARCH_CIX || COMPILE_TEST
	select SND_SOC_GENERIC_DMAENGINE_PCM
	select REGMAP_MMIO
	help
	  Say Y or M if you want to add support for the Cadence I2S-SC
	  controller found in the CIX SKY1 audio subsystem. It provides
	  full-duplex stereo playback and capture in standard I2S and
	  TDM modes with up to 16 slots.

config SND_SOC_CDNS_I2S_MC
	tristate "Cadence I2S-MC controller support"
	depends on ARCH_CIX || COMPILE_TEST
	select SND_SOC_GENERIC_DMAENGINE_PCM
	select REGMAP_MMIO
	help
	  Say Y or M if you want to add support for the Cadence I2S-MC
	  multi-channel controller found in the CIX SKY1 audio subsystem.
	  It provides multi-channel playback and capture through a
	  configurable number of I2S data pins.
```
