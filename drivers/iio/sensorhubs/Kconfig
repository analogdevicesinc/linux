## drivers/iio/sensorhubs/Kconfig
```kconfig
# SPDX-License-Identifier: GPL-2.0-only

menu "Sensor hubs"

source "drivers/iio/sensorhubs/osf/Kconfig"

endmenu
```

## drivers/iio/sensorhubs/osf/Kconfig
```kconfig
# SPDX-License-Identifier: GPL-2.0-only

config OPEN_SENSOR_FUSION
	tristate "Open Sensor Fusion UART IIO driver"
	depends on SERIAL_DEV_BUS
	select CRC32
	select IIO_BUFFER
	select IIO_KFIFO_BUF
	help
	  Build the Open Sensor Fusion UART IIO driver.

	  The driver receives OSF protocol frames over a serdev UART and
	  registers IIO devices for supported capability entries. It exposes
	  accelerometer, gyroscope, magnetometer, and temperature samples
	  through IIO direct reads and software buffers.
```

## drivers/iio/trx-rf/Kconfig
```kconfig
# SPDX-License-Identifier: GPL-2.0-only
#
# RF Transceivers and Advanced Mixed Signal Frontends drivers
#
menu "RF Transceivers and Advanced Mixed Signal Frontends"

config AD9088
	tristate "Analog Devices AD9088 and similar Mixed Signal Front End (MxFE)"
	depends on SPI
	select CF_AXI_ADC
	select ADI_AXI_HSCI
	help
	  Say yes here to build support for Analog Devices:
	  AD9088, AD9084 mixed signal front end (MxFE).
	  Provides direct access via sysfs.

config ADRV903X
	tristate "Analog Devices ADRV903X/ADRV9030 RF Transceiver driver"
	depends on SPI
	select CF_AXI_ADC
	help
	  Say yes here to build support for Analog Devices:
	  ADRV903X/ADRV9030 RF Transceivers. Provides direct access
	  via sysfs.

	  To compile this driver as a module, choose M here: the module will be
	  called adrv903x_drv.

config ADRV9104
	tristate "Analog Devices ADRV9104 RF Transceiver driver"
	depends on SPI
	select IIO_BACKEND
	select FW_LOADER
	select FW_UPLOAD
	help
	  Say yes to build support for the Analog Devices ADRV9102 integrated
	  RF transceiver and similar devices.

	  To compile this driver as a module, choose M here: the module will be
	  called adrv9104_drv

config ADRV9104_COMMON_VERBOSE
	bool "Enables verbose error reports"
	depends on ADRV9104
	default y

config ADRV9104_ARM_VERBOSE
	bool "Enables ARM verbose error messages"
	depends on ADRV9104
	default y

config ADRV9104_VALIDATE_PARAMS
	bool "Causes the API to validate all the input parameters"
	depends on ADRV9104
	default y

config ADRV9104_KUNIT_TEST
	tristate "KUnit tests for the ADRV9104 device profile parser" if !KUNIT_ALL_TESTS
	depends on ADRV9104 && KUNIT
	default KUNIT_ALL_TESTS
	help
	  Build KUnit tests that load a device profile via request_firmware(),
	  parse it and serialise it back, validating the JSON parser/serialiser.
	  Useful to check whether the parser needs updating after an SDK bump.

	  If unsure, say N.
endmenu
```

## drivers/mfd/maxim/max2035x/Kconfig
```kconfig
config MFD_MAX2035X
	tristate "Analog Devices MAX20355/MAX20357 PMIC Support"
	depends on I2C
	help
	  Say yes here to support for Analog Devices MAX20355 and MAX20357.
	  These devices provide PLC-based power management and monitoring
	  functions for system power control.
	  This driver provides common support for accessing the device;
	  additional drivers must be enabled to use specific functions
	  such as fuelgauge or charger control.
```

## drivers/misc/adi/Kconfig
```kconfig
# SPDX-License-Identifier: (GPL-2.0-only OR BSD-2-Clause)-or-later

config ADI_SRAM_MMAP
	bool "Aarch64 MMAP driver for sc5xx onchip SRAM"
	depends on ARCH_SC59X_64 || COMPILE_TEST
	depends on SRAM
	default n
	help
	  Enable the mmap driver for sc5xx on chip SRAM.

config ADI_SRAM_MMAP_V7
	bool "Legacy (armv7) mmap driver for sc5xx onchip SRAM"
	depends on ARCH_SC59X || ARCH_SC58X || ARCH_SC57X || COMPILE_TEST
	depends on SRAM
	default n
	help
	  Enable the mmap driver for sc5xx on chip SRAM.

config ADI_SMPU_EXMON
	tristate "SC84x SMPU exclusive-monitor test module"
	depends on ARCH_SC84X || COMPILE_TEST
	depends on m
	default n
	help
	  Debug/test module. Checks whether Cortex-A55 exclusive accesses
	  (LDAXR/STXR) arm the ADSP-SC84x SMPU exclusive monitors (SMPU2/4/9
	  EXACADD/EXACSTAT) for cacheable and non-cacheable mappings of L2
	  SRAM and DDR, and whether STXR succeeds. All work is done at load
	  time and reported in the kernel log.

	  An exclusive to memory without a monitor makes the A55 abort, which
	  oopses the kernel. Not for production kernels. See
	  drivers/misc/adi/smpu_exmon-HANDOVER.md.

	  If unsure, say N.

config ADI_SRAM_CONTROLLER
	bool "/proc/sraminfo support for sc5xx onchip SRAM"
	depends on ARCH_SC59X_64 || ARCH_SC59X || ARCH_SC58X || ARCH_SC57X || COMPILE_TEST
	depends on SRAM
	default n
	help
	  Exports total/used/avail information for sc5xx onchip SRAM.
```

## drivers/net/dsa/motorcomm/Kconfig
```kconfig
# SPDX-License-Identifier: GPL-2.0-only
config NET_DSA_YT921X
	tristate "Motorcomm YT9215 ethernet switch chip support"
	select NET_DSA_TAG_YT921X
	select NET_IEEE8021Q_HELPERS if DCB
	help
	  This enables support for the Motorcomm YT9215 ethernet switch
	  chip.
```

## drivers/net/ethernet/adi/Kconfig
```kconfig
# SPDX-License-Identifier: GPL-2.0 OR BSD-2-Clause
#
# Analog Devices device configuration
#

config NET_VENDOR_ADI
	bool "Analog Devices devices"
	default y
	depends on SPI || DMADEVICES
	help
	  If you have a network (Ethernet) card belonging to this class, say Y.

	  Note that the answer to this question doesn't directly affect the
	  kernel: saying N will just cause the configurator to skip all
	  the questions about ADI devices. If you say Y, you will be asked
	  for your specific card in the following questions.

if NET_VENDOR_ADI

config ADIN1110
	tristate "Analog Devices ADIN1110 MAC-PHY"
	depends on SPI && NET_SWITCHDEV
	select CRC8
	select PHYLIB
	help
	  Say yes here to build support for Analog Devices ADIN1110
	  Low Power 10BASE-T1L Ethernet MAC-PHY.

config ADI_AXIS_NET
	tristate "Analog Devices AXI-Stream point-to-point Ethernet"
	depends on DMADEVICES
	depends on OF
	help
	  Say yes here to build support for a point-to-point Ethernet link
	  carried over a pair of AXI-Stream DMA channels, as provided by the
	  ADI AXI-DMAC IP in stream mode.

	  This is used to connect two processors joined by FPGA fabric -- for
	  example an x86 host and a Zynq PS across a PCIe endpoint. The same
	  driver runs unmodified on both ends of the link.

	  To compile this driver as a module, choose M here. The module will be
	  called adi_axis_net.

endif # NET_VENDOR_ADI
```

## drivers/pinctrl/adi/Kconfig
```kconfig
# SPDX-License-Identifier: (GPL-2.0-only OR BSD-2-Clause)-only

config SRUCTRL_ADSP
	bool
	depends on OF
	select PINMUX
	select GENERIC_PINCONF

config PINCTRL_ADSP
	tristate "Analog Devices ADSP pinctrl and GPIO driver"
	depends on OF
	select PINMUX
	select PINCONF
	select GENERIC_PINCONF
	select GENERIC_PINCTRL_GROUPS
	select GENERIC_PINMUX_FUNCTIONS
	select GPIOLIB
	select GPIOLIB_IRQCHIP
	select IRQ_DOMAIN_HIERARCHY
	select MFD_SYSCON
	imply ADI_ADSP_PINT
	help
	  This pinctrl driver provides an interface that allows configuring the
	  PORT pins on ADSP SC5xx series SoCs. The pins can be muxed to another
	  peripheral, or function as GPIO.

	  The driver can also be built as a module. If so, the module will be
	  called pinctrl-adsp.

config SRUCTRL_ADSP_SC5XX
	bool "ADSP-SC5XX SRU control driver"
	depends on (ARCH_SC59X_64 || ARCH_SC59X || ARCH_SC58X || ARCH_SC57X || COMPILE_TEST)
	select SRUCTRL_ADSP
	help
	  Say Y here to enable the ADSP-SC5XX SRU control driver. This is required for
	  SRU muxing functionaility on the SoC.
```

## drivers/platform/Kconfig
```kconfig
# SPDX-License-Identifier: GPL-2.0-only
config PLATFORM_PROFILE
	tristate "Platform profile support"
	help
	  Provide a common sysfs interface for selecting platform power,
	  performance and cooling profiles. Platform-specific provider drivers
	  map their operating modes onto standard profile names, independently
	  of the firmware interface they use.

	  The core exposes per-provider controls under /sys/class/platform-profile/.
	  A provider driver must register before profile attributes become
	  available. ACPI is not required. The legacy system-wide interface under
	  /sys/firmware/acpi/ can be enabled separately for existing userspace.

	  To compile this as a module, choose M here: the module will be called
	  platform_profile.

config PLATFORM_PROFILE_LEGACY
	bool "Legacy ACPI platform profile sysfs interface (DEPRECATED)"
	depends on PLATFORM_PROFILE && ACPI
	default y
	help
	  Expose platform_profile and platform_profile_choices under
	  /sys/firmware/acpi/ for compatibility with existing userspace. These
	  attributes aggregate the profiles of all registered providers.

	  This interface is deprecated and is intended for removal after the
	  2028 LTS kernel, once userspace has migrated to the class interface.
	  It remains enabled by default until replacement userspace releases
	  are available and have had time to reach users.

	  New userspace should use the individual devices under
	  /sys/class/platform-profile/ instead. Disabling this option removes
	  the legacy sysfs interface but retains class devices and kernel
	  profile cycling. If unsure, say Y to preserve compatibility.

source "drivers/platform/mips/Kconfig"

source "drivers/platform/loongarch/Kconfig"

source "drivers/platform/goldfish/Kconfig"

source "drivers/platform/chrome/Kconfig"

source "drivers/platform/cznic/Kconfig"

source "drivers/platform/mellanox/Kconfig"

source "drivers/platform/olpc/Kconfig"

source "drivers/platform/surface/Kconfig"

source "drivers/platform/x86/Kconfig"

source "drivers/platform/arm64/Kconfig"

source "drivers/platform/raspberrypi/Kconfig"

source "drivers/platform/wmi/Kconfig"
```

## drivers/soc/adi/Kconfig
```kconfig
# SPDX-License-Identifier: GPL-2.0-only

config ADI_MACH_SC5XX
	bool "ADI SC5XX machine support" if COMPILE_TEST
	default ARCH_SC84X || ARCH_SC59X_64 || ARCH_SC59X || ARCH_SC58X || ARCH_SC57X
	select MAILBOX
	help
	  This enables machine-level support for Analog Devices SC5XX SoCs,
	  including the Reset Control Unit, System Event Controller, and
	  Inter-Core Communications drivers.

config ADI_MACH_SC59X
	bool "ADI SC59X machine support" if COMPILE_TEST
	default ARCH_SC59X_64
	help
	  This enables machine-level support specific to the Analog Devices
	  SC59X (64-bit) SoC family.
```

## drivers/usb/typec/maxim/Kconfig
```kconfig
#
# CCIC devices
#

comment "CCIC configs"

config MAX77978
	tristate "Analog Devices MAX77978 USBC/PD Support"
	depends on I2C
	help
	  Say yes here to add support for Analog Devices MAX77978.
	  This is a USB Type-C CC detection and PD protocol controller.
	  This driver provides I2C communication, IRQ handling, and
	  firmware update support for the device.

config MAX77978_DEBUG
	tristate "Analog Devices MAX77978 Debug Interface"
	depends on MAX77978
	help
	  Say yes here to add support for Analog Devices MAX77978 Debug.
	  This shows debug message for USB Type-C CC detection and
	  PD protocol implementation. It also enables additional I2C
	  bulk transfer logging for debugging communication issues.
```

## kernel/api/Kconfig
```kconfig
# SPDX-License-Identifier: GPL-2.0-only
#
# Kernel API Specification Framework Configuration
#

config KAPI_SPEC
	bool "Kernel API Specification Framework"
	help
	  This option enables the kernel API specification framework,
	  which provides formal documentation of kernel APIs in both
	  human and machine-readable formats.

	  The framework allows developers to document APIs inline with
	  their implementation, including parameter specifications,
	  return values, error conditions, locking requirements, and
	  execution context constraints.

	  When enabled, API specifications can be queried at runtime
	  and exported in JSON format through debugfs.

	  If unsure, say N.

config KAPI_RUNTIME_CHECKS
	bool "Runtime API specification checks"
	depends on KAPI_SPEC
	depends on DEBUG_KERNEL
	# The hook is only in the generic and the x86 __SYSCALL_DEFINEx()
	depends on X86 || !ARCH_HAS_SYSCALL_WRAPPER
	help
	  Validate the arguments and the return value of system calls that
	  have an API specification, in their SYSCALL_DEFINEx() wrapper.
	  Violations are reported with pr_warn_ratelimited(). This adds
	  overhead to every system call.

	  DEBUG-ONLY: Enabling this changes the errno seen by userspace for
	  syscalls that violate their parameter specification. On violation
	  the validator short-circuits the syscall and returns -EINVAL
	  before the real handler runs, masking whatever errno the handler
	  would otherwise have produced. Do not enable on production
	  kernels.

	  If unsure, say N.

config KAPI_SPEC_DEBUGFS
	bool "Export kernel API specifications via debugfs"
	depends on KAPI_SPEC
	depends on DEBUG_FS
	help
	  This option enables exporting kernel API specifications through
	  the debugfs filesystem. When enabled, specifications can be
	  accessed at /sys/kernel/debug/kapi/.

	  The debugfs interface provides:
	  - A list of all available API specifications
	  - Detailed information for each API including parameters,
	    return values, errors, locking requirements, and constraints
	  - Complete machine-readable representation of the specs

	  This is useful for documentation tools, static analyzers, and
	  runtime introspection of kernel APIs.

	  If unsure, say N.

config KAPI_KUNIT_TEST
	tristate "KUnit tests for KAPI framework" if !KUNIT_ALL_TESTS
	depends on KAPI_SPEC
	depends on KUNIT
	default KUNIT_ALL_TESTS
	help
	  KUnit tests for the Kernel API Specification Framework.
	  Tests registration, lookup, validation constraints, and
	  JSON export functionality.

	  If unsure, say N.
```

## lib/vdso/Kconfig
```kconfig
# SPDX-License-Identifier: GPL-2.0

config VDSO_DATASTORE
	bool

config GENERIC_GETTIMEOFDAY
	bool
	select VDSO_DATASTORE
	help
	  This is a generic implementation of gettimeofday vdso.
	  Each architecture that enables this feature has to
	  provide the fallback implementation.

config GENERIC_VDSO_OVERFLOW_PROTECT
	bool
	help
	  Select to add multiplication overflow protection to the VDSO
	  time getter functions for the price of an extra conditional
	  in the hotpath.

config VDSO_GETRANDOM
	bool
	select VDSO_DATASTORE
	help
	  Selected by architectures that support vDSO getrandom().

config VDSO_UNALIGNED_PACKED
	bool
	default !HAVE_EFFICIENT_UNALIGNED_ACCESS
	help
	  Use packed structs rather than memcpy() in include/vdso/unaligned.h
	  for unaligned memory accesses. Enabled by default when the
	  architecture does not have efficient unaligned accesses, as GCC may
	  emit stack spills or out-of-line memcpy() calls instead of inlining
	  byte shifts.
```
