## drivers/jesd204/transceiver/Kconfig
```kconfig
#
# JESD204 Transceiver drivers
#

menu "JESD204 Transceiver drivers"

config ALTERA_ARRIA10_JESD204_PHY
	tristate "Altera Arria10 JESD204 PHY Support"
	depends on COMMON_CLK

config AXI_ADXCVR
	tristate "Analog Devices AXI ADXCVR PHY Support"
	depends on COMMON_CLK
	select XILINX_TRANSCEIVER

config XILINX_TRANSCEIVER
	tristate

endmenu
```

## drivers/media/Kconfig.adi
```kconfig
# This file exists solely to be include in Kconfig.adi

config MEDIA_ALL_ADI_DRIVERS
	tristate "Build all Analog Devices Media Drivers"
	imply VIDEO_ADV_DEBUG
	imply VIDEO_ADV7170
	imply VIDEO_ADV7175
	imply VIDEO_ADV7343
	imply VIDEO_ADV7393
	imply VIDEO_AD9389B
	imply VIDEO_ADDI9036
	imply VIDEO_ADV7180
	imply VIDEO_ADV7183
	imply VIDEO_ADV748X
	imply VIDEO_ADV7604
	imply VIDEO_ADV7604_CEC
	imply VIDEO_ADV7842
	imply VIDEO_ADV7842_CEC
	imply VIDEO_AXI_HDMI_RX
	imply ADI_AXI_VIDEO_FRAME_BUFFER
	imply VIDEO_ADP1653
	imply USB_VIDEO_CLASS
```

## drivers/media/i2c/maxim-serdes/Kconfig
```kconfig
# SPDX-License-Identifier: GPL-2.0

config VIDEO_MAXIM_SERDES
	tristate "Maxim GMSL2/3 Serializer and Deserializer support"
	depends on VIDEO_DEV
	depends on I2C
	select I2C_ATR
	select I2C_MUX
	select MEDIA_CONTROLLER
	select V4L2_FWNODE
	select VIDEO_V4L2_SUBDEV_API
	help
	  This driver supports the Maxim GMSL2/3 common Serializer and
	  Deserializer framework.

	  To compile this driver as a module, choose M here: the module
	  will be called max_serdes.

config VIDEO_MAX96717
	tristate "Maxim MAX96717 Serializer support"
	depends on COMMON_CLK
	depends on I2C
	depends on PINCTRL
	select VIDEO_MAXIM_SERDES
	select GENERIC_PINCONF
	select GENERIC_PINCTRL_GROUPS
	select GENERIC_PINMUX_FUNCTIONS
	select GPIOLIB
	help
	  This driver supports the Maxim MAX9295A, MAX96717, MAX96717F,
	  MAX96793 Serializers, which receive video on a MIPI CSI-2
	  interface and output it on a GMSL2/3 link.

	  To compile this driver as a module, choose M here: the module
	  will be called max96717.
```

## drivers/media/i2c/ox05b1s/Kconfig
```kconfig
config VIDEO_OX05B1S
	tristate "OmniVision raw sensor support OX05B1S"
	depends on OF
	depends on GPIOLIB && VIDEO_V4L2_I2C && VIDEO_V4L2_SUBDEV_API
	depends on MEDIA_CAMERA_SUPPORT
	select V4L2_FWNODE
	help
	  This is a Video4Linux2 sensor driver for the Omnivision OX05B1S RGB-IR sensor.
	  This is a 1/2.5-Inch CMOS image sensor with an active array size of 2592 x 1944.
	  It is programmable through I2C interface.
	  The output is on MIPI CSI-2 interface.
```

## drivers/media/platform/adi/Kconfig
```kconfig
# SPDX-License-Identifier: GPL-2.0

 comment "Analog Devices media platform drivers"

config VIDEO_AXI_HDMI_RX
	tristate "AXI-HDMI-RX support"
	depends on MEDIA_SUPPORT && VIDEO_DEV && I2C
	depends on GPIOLIB || COMPILE_TEST
	select I2C_ALGOBIT
	select VIDEO_ADV7604
	select VIDEOBUF2_DMA_CONTIG
	help
	  To compile this driver as a module, choose M here: the
	  module will be called axi-hdmi-rx.

config VIDEO_IMAGEON_BRIDGE
	tristate "IMAGEON-BRIDGE support"
	depends on MEDIA_SUPPORT && VIDEO_DEV && I2C
	depends on GPIOLIB || COMPILE_TEST
	select I2C_ALGOBIT
	select VIDEO_ADV7511
	select VIDEO_ADV7604
	help
	  To compile this driver as a module, choose M here: the
	  module will be called imageon-bridge.

config ADI_AXI_VIDEO_FRAME_BUFFER
	tristate "ADI AXI frame buffer"
	depends on MEDIA_SUPPORT
	help
	  To compile this driver as a module, choose M here: the
	  module will be called adi-axi-fb.
```

## drivers/media/platform/imx8/Kconfig
```kconfig
if VIDEO_MX8_CAPTURE
menu "IMX8 Camera ISI/MIPI Features support"

config IMX8_MEDIA_DEVICE
	tristate "IMX8 Media Device Driver"
	select V4L2_FWNODE
	default y

config IMX8_CAPTURE_DRIVER
	tristate "IMX8 Camera Controller"
	depends on VIDEO_V4L2 && VIDEO_V4L2_SUBDEV_API
	select V4L2_MEM2MEM_DEV
	select VIDEOBUF2_DMA_CONTIG
	default y

config IMX8_MIPI_CSI2
	tristate "IMX8 MIPI CSI2 Controller"
	default y

config IMX8_PARALLEL_CSI
	tristate "IMX8 PARALLEL CSI Controller"
	default y

config IMX8_MIPI_CSI2_YAV
	tristate "IMX8 MIPI CSI2 Controller Yet Another Version"
	default y

config GMSL_MAX9286
        tristate "Maxim max9286 GMSL Deserializer Input support"
	select SENSOR_OV10635
        depends on I2C
        ---help---
          If you plan to use the max9286 GMSL Deserializer with your capture system, say Y here.

config IMX8_JPEG
	tristate "IMX8 JPEG Encoder/Decoder"
	depends on VIDEO_V4L2 && VIDEO_V4L2_SUBDEV_API
	select V4L2_MEM2MEM_DEV
	select VIDEOBUF2_DMA_CONTIG
	default y

endmenu
endif #VIDEO_MX8_CAPTURE
```

## drivers/media/platform/imx8/hdmi/Kconfig
```kconfig
config IMX8_HDMI_RX
	tristate "IMX8 HDMI RX Controller"
	select MX8_HDP_RX
	default y
```

## drivers/media/platform/mxc/output/Kconfig
```kconfig
config VIDEO_MXC_IPU_OUTPUT
	tristate "IPU v4l2 output support"
	depends on VIDEO_MXC_OUTPUT && MXC_IPU
	help
	This is the video4linux2 driver for IPU post processing video output.
```

## drivers/media/platform/nxp/neoisp/Kconfig
```kconfig
# SPDX-License-Identifier: GPL-2.0-only

config VIDEO_NXP_NEOISP
	tristate "NXP NEO ISP v4l2 hardware driver"
	depends on V4L_MEM2MEM_DRIVERS
	depends on VIDEO_DEV
	select MEDIA_CONTROLLER
	select V4L2_MEM2MEM_DEV
	select VIDEOBUF2_DMA_CONTIG
	help
	  Enable this to support the NEO Image Signal Processing (ISP) module.

	  To compile this driver as a module, choose M here: the module
	  will be called neoisp.
```

## drivers/misc/mathworks/Kconfig
```kconfig
#
# mwgeneric driver configuration
#

menu "Mathworks IP Drivers"



config MATHWORKS_IP_CORE
	tristate "Mathworks IP Drivers"
	depends on (OF) || PCI
	default m
	help
		Say Y here if you want to add support for the MathWorks IP
		drivers

		If unsure, say N.

		To compile this driver as a module, choose M here:
		the module will be called mathworks_ip_common

if MATHWORKS_IP_CORE

config MWIPCORE
	tristate "Mathwork IP Core Driver"
	default m
	help
		Say Y here if you want to add support for the MathWorks IP
		core driver

		If unsure, say N.

		To compile this driver as a module, choose M here:
		the module will be called mwipcore
if MWIPCORE

config MWIPCORE_DMA_STREAMING
	tristate "Mathworks DMA Streaming Driver"
	depends on DMADEVICES
	default m
	help
		Enable support for MathWorks raw DMA-based implementation
		of streaming DMA

		If unsure, say N.

		To compile this driver as a module, choose M here:
		the module will be called mwipcore_dma_streaming

config MWIPCORE_IIO_STREAMING
	tristate "Mathworks IIO Streaming Driver"
	depends on DMADEVICES
	select IIO
	select IIO_BUFFER_DMAENGINE
	select IIO_BUFFER_DMA
	select IIO_BUFFER
	default m
	help
		Enable support for MathWorks IIO-based implementation of
		streaming DMA

		To compile this driver as a module, choose M here:
		the module will be called mwipcore_iio_streaming

endif #if MWIPCORE

config MATHWORKS_GENERIC_OF
	tristate "Mathworks Generic OF Driver"
	depends on OF_ADDRESS && OF_IRQ
	default m
	help
		Say Y here if you want to add support for the MathWorks
		Generic OF driver

		If unsure, say N.

		To compile this driver as a module, choose M here:
		the module will be called mathworks_generic_of

config MATHWORKS_GENERIC_PCI
	tristate "Mathworks Generic PCI Driver"
	depends on PCI
	default m
	help
		Say Y here if you want to add support for the MathWorks
		Generic PCI driver

		If unsure, say N.

		To compile this driver as a module, choose M here:
		the module will be called mathworks_generic_pci
				
endif #if MWGENERIC
endmenu
```

## drivers/mxc/Kconfig
```kconfig
# drivers/mxc/Kconfig

if ARCH_MXC

menu "MXC support drivers"

config MXC_SIM
	tristate "MXC SIM support"
	default n
	help
	Say Y to get MXC SIM support.

config MXC_IPU
	bool "Image Processing Unit Driver"
	select MXC_IPU_V3
	help
	  If you plan to use the Image Processing unit, say
	  Y here. IPU is needed by Framebuffer and V4L2 drivers.

source "drivers/mxc/gpu-viv/Kconfig"
source "drivers/mxc/sim/Kconfig"
source "drivers/mxc/mlb/Kconfig"
source "drivers/mxc/ipu3/Kconfig"
source "drivers/mxc/hdmi-cec/Kconfig"
source "drivers/mxc/mipi/Kconfig"

# drivers common to MXC and MX8 go here:

if ARM64
source "drivers/mxc/hantro/Kconfig"
source "drivers/mxc/hantro_845/Kconfig"
source "drivers/mxc/hantro_845_h1/Kconfig"
source "drivers/mxc/hantro_vc8000e/Kconfig"
source "drivers/mxc/hantro_v4l2/Kconfig"
endif

source "drivers/mxc/vpu/Kconfig"

endmenu

endif
```

## drivers/mxc/gpu-viv/Kconfig
```kconfig
menu "MXC Vivante GPU support"

config MXC_GPU_VIV
	tristate "MXC Vivante GPU support"
	depends on DRM
	default n

	help
         Say Y to get the GPU driver support.

endmenu
```

## drivers/mxc/hantro/Kconfig
```kconfig
#
# Codec configuration
#

menu "MXC HANTRO(Video Processing Unit) support"
	depends on ARCH_MXC

config MXC_HANTRO
	tristate "Support for MXC HANTRO(Video Processing Unit)"
	default y
	help
	  VPU codec device.

endmenu
```

## drivers/mxc/hantro_845/Kconfig
```kconfig
#
# Codec configuration
#

menu "MXC HANTRO(Video Processing Unit) 845 support"
	depends on ARCH_MXC

config MXC_HANTRO_845
	tristate "Support for MXC HANTRO(Video Processing Unit) 845"
	default y
	---help---
	  VPU codec device.

endmenu
```

## drivers/mxc/hantro_845_h1/Kconfig
```kconfig
#
# Codec configuration
#

menu "MXC HANTRO(Video Processing Unit) encoder support"
	depends on ARCH_MXC

config MXC_HANTRO_845_H1
	tristate "Support for MXC HANTRO(Video Processing Unit) encoder"
	default y
	help
	  VPU codec device.

endmenu
```

## drivers/mxc/hantro_v4l2/Kconfig
```kconfig
#
# Codec configuration
#

menu "MXC HANTRO(Video Processing Unit) V4L2 support"
#	depends on ARCH_FSL_IMX8MP
	depends on ARCH_MXC

config MXC_HANTRO_V4L2
	tristate "Support for MXC HANTRO(Video Processing Unit) V4L2 driver"
	depends on VIDEO_DEV
	depends on VIDEOBUF2_V4L2 || VIDEOBUF2_V4L2=n
	default y
	help
		VPU hantro v4l2 device.

endmenu
```

## drivers/mxc/hantro_vc8000e/Kconfig
```kconfig
#
# Codec configuration
#

menu "MXC HANTRO(Video Processing Unit) VC8000E encoder support"
#	depends on ARCH_FSL_IMX8MP
	depends on ARCH_MXC

config MXC_HANTRO_VC8000E
	tristate "Support for MXC HANTRO(Video Processing Unit) VC8000E encoder"
	default y
	help
	  VPU codec device.

endmenu
```

## drivers/mxc/hdp-cec/Kconfig
```kconfig
config IMX_HDP_CEC
	bool "Enable IMX HDP CEC support"
	depends on MEDIA_CEC
	---help---
	When selected the imx hdmi will support the optional HDMI CEC feature.
```

## drivers/mxc/hdp/Kconfig
```kconfig
config MX8_HDP
	tristate "IMX8 HDP API "

config MX8_HDP_RX
	tristate "IMX8 HDP RX API "
```

## drivers/mxc/mlb/Kconfig
```kconfig
#
# MLB150 configuration
#

menu "MXC Media Local Bus Driver"

config MXC_MLB
	bool

config MXC_MLB150
	tristate "MLB150 support"
	depends on ARCH_MXC || COMPILE_TEST
	select MXC_MLB
	help
	Say Y to get the MLB150 support.

endmenu
```

## drivers/mxc/sim/Kconfig
```kconfig
#
# SIM configuration
#

menu "MXC SIM Support"

config MXC_SIMv2
	tristate "MXC SIMv2 support"
	depends on ARCH_MXC && MXC_SIM
	default n
	help
	Say Y if you want to use the SIMv2 on NXP i.MX6/7 processors.

	This driver can also be built as a module. If so, the module
	will be called imx_sim.

endmenu
```

## drivers/mxc/vpu-decoder-b0/Kconfig
```kconfig
#
# Codec configuration
#

menu "MXC VPU(Video Processing Unit) B0 DECODER support"

config MXC_VPU_DECODER
	  tristate "Support for MXC VPU(Video Processing Unit) DECODER"
	  default y
	---help---
	  The VPU codec device provides codec function for H.265 H.264 MPEG2 MPEG4 etc.

config MXC_VPU_DECODER_DEBUG
	bool "MXC VPU DECODER debugging"
	depends on MXC_VPU_DECODER != n
	help
	  This is an option for the developers; most people should
	  say N here.  This enables MXC VPU driver debugging.

endmenu
```

## drivers/mxc/vpu-encoder-b0/Kconfig
```kconfig
#
# Codec configuration
#

menu "MXC VPU(Video Processing Unit) B0 ENCODER support"

config MXC_VPU_ENCODER
	  tristate "Support for MXC VPU(Video Processing Unit) ENCODER"
	  select VIDEO_DEV
	  select VIDEO_V4L2
	  select VIDEOBUF2_DMA_CONTIG
	  select VIDEOBUF2_VMALLOC
	  default y
	---help---
	  The VPU codec device provides codec function for H.264 etc.

config MXC_VPU_ENCODER_DEBUG
	bool "MXC VPU ENCODER debugging"
	depends on MXC_VPU_ENCODER != n
	help
	  This is an option for the developers; most people should
	  say N here.  This enables MXC VPU driver debugging.

endmenu
```

## drivers/mxc/vpu-malone/Kconfig
```kconfig
#
# Codec configuration
#

menu "MXC VPU(Video Processing Unit) MALONE support"

config MXC_VPU_MALONE
	  tristate "Support for MXC VPU(Video Processing Unit) MALONE"
	  default y
	---help---
	  The VPU codec device provides codec function for H.265/H.264/MPEG4/H.263 etc.

config MXC_VPU_MALONE_DEBUG
	bool "MXC VPU MALONE debugging"
	depends on MXC_VPU_MALONE != n
	help
	  This is an option for the developers; most people should
	  say N here.  This enables MXC VPU driver debugging.

endmenu
```

## drivers/mxc/vpu/wave6/Kconfig
```kconfig
# SPDX-License-Identifier: GPL-2.0-only

comment "Wave6 drivers"

config MXC_VIDEO_WAVE6_CTRL
	tristate "WAVE6 VPU Ctrl"
	help
	  Wave6 VPU Ctrl is to handle the global region.
	  It help load the firmware and boot the vcpu,
	  It also help manage the vpu power domain and clock,
	  To compile this driver as a module choose m here.

config MXC_VIDEO_WAVE6
	tristate "WAVE6 VPU (Video Processing Unit) Codec IP"
	depends on V4L_MEM2MEM_DRIVERS
	depends on ARCH_MXC || COMPILE_TEST
	depends on MEDIA_SUPPORT
	depends on VIDEO_DEV
	select MEDIA_CONTROLLER
	select V4L2_MEM2MEM_DEV
	select VIDEOBUF2_DMA_CONTIG
	select MXC_VIDEO_WAVE6_CTRL
	help
	  Wave6 VPU Codec IP contains decoders and encoders.
	  To compile this driver as a module choose m here.
```
