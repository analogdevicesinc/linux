## drivers/staging/neutron/Kconfig
```kconfig
# SPDX-License-Identifier: GPL-2.0+
# Copyright 2023 NXP
#

config NEUTRON
	tristate "NXP Neutron NPU support"
	depends on ARCH_MXC
	depends on IMX_NEUTRON_REMOTEPROC
	help
	  Say Y here if you want to support NXP Neutron NPU.

	  The Neutron Neural Processing Unit (NPU) is a highly scalable accelerator core architecture
	  providing machine learning (ML) acceleration.

	  If unsure, say N.
```

## drivers/tee/crypto/Kconfig
```kconfig
# SPDX-License-Identifier: GPL-2.0
# TEE CRYPTO Configuration
config TEE_CRYPTO
	tristate "Crypto Operations offloaded to TEE."
	depends on OPTEE
	default m
	help
	 Enables the kernel module TEE_CRYPTO, where Cryptographic operation
         are offloaded to trusted execution environment. This driver has been
         by default compiled as Module only. Module will be called tee_crypto.
```

## drivers/usb/Kconfig.adi
```kconfig
# This file exists solely to be include in Kconfig.adi

config USB_ALL_ADI_DRIVERS
	tristate "Build all USB drivers for the Analog Devices kernel"
	imply USB
	imply USB_SUPPORT
	imply USB_SERIAL
	imply USB_HIDDEV
	imply USB_ANNOUNCE_NEW_DEVICES
	imply USB_OTG
	imply USB_UAS
	imply USB_EHCI_HCD
	imply USB_STORAGE
	imply USB_CHIPIDEA
	imply USB_CHIPIDEA_UDC
	imply USB_CHIPIDEA_HOST
	imply USB_SERIAL_GENERIC
	imply USB_SERIAL_FTDI_SIO
	imply USB_ULPI
	imply USB_GADGET
	imply USB_GADGET_XILINX
	imply USB_CONFIGFS
	imply USB_CONFIGFS_SERIAL
	imply USB_CONFIGFS_ACM
	imply USB_CONFIGFS_NCM
	imply USB_CONFIGFS_ECM
	imply USB_CONFIGFS_ECM_SUBSET
	imply USB_CONFIGFS_RNDIS
	imply USB_CONFIGFS_EEM
	imply USB_CONFIGFS_MASS_STORAGE
	imply USB_CONFIGFS_F_FS
	imply USB_F_RNDIS
	imply USB_SERIAL_UPD78F0730
	imply USB_DWC2
	imply USB_DWC3
	imply USB_XHCI_HCD
	imply NOP_USB_XCEIV
	imply USB_USBNET
	imply USB_DEFAULT_PERSIST
	imply TYPEC
```

## drivers/usb/cdns3/Kconfig
```kconfig
config USB_CDNS3
	tristate "Cadence USB3 Dual-Role Controller"
	depends on ((USB_XHCI_HCD && USB_GADGET) || (USB_XHCI_HCD && !USB_GADGET) || (!USB_XHCI_HCD && USB_GADGET)) && HAS_DMA
	select EXTCON
	help
	  Say Y here if your system has a cadence USB3 dual-role controller.
	  It supports: dual-role switch Host-only, and Peripheral-only.

	  When compiled dynamically, the module will be called cdns3.ko.

if USB_CDNS3

config USB_CDNS3_GADGET
	bool "Cadence USB3 device controller"
	depends on USB_GADGET
	help
	  Say Y here to enable device controller functionality of the
	  cadence usb3 driver.

config USB_CDNS3_HOST
	bool "Cadence USB3 host controller"
	depends on USB_XHCI_HCD
	help
	  Say Y here to enable host controller functionality of the
	  cadence usb3 driver.
endif
```
