## drivers/net/ethernet/freescale/sdk_fman/Kconfig
```kconfig
menu "Frame Manager support"

menuconfig FSL_SDK_FMAN
	bool "Freescale Frame Manager (datapath) support - SDK driver"
	depends on (FSL_SOC || ARM64 || ARM) && FSL_SDK_BMAN && FSL_SDK_QMAN && !FSL_FMAN
	default y
	help
		If unsure, say Y.

if FSL_SDK_FMAN

config FSL_SDK_FMAN_TEST
	bool "FMan test module"
	default n
	select FSL_DPAA_HOOKS
	help
		This option compiles test code for FMan.

config FSL_SDK_FMAN_RTC_API
	bool "FMan RTC (1588 timer) APIs"
	default n
	help
		This option enables RTC (1588 timer) initialization and
		APIs support. The ptp_qoriq driver is not available if
		it is selected for RTC (1588 timer). Neither of them
		were not able to be used together.

config FSL_FM_MAX_FRAME_SIZE
	int "Maximum L2 frame size"
	range 64 9600
	default "1522"
	help
		Configure this in relation to the maximum possible MTU of your
		network configuration. In particular, one would need to
		increase this value in order to use jumbo frames.
		FSL_FM_MAX_FRAME_SIZE must accommodate the Ethernet FCS (4 bytes)
		and one ETH+VLAN header (18 bytes), to a total of 22 bytes in
		excess of the desired L3 MTU.

		Note that having too large a FSL_FM_MAX_FRAME_SIZE (much larger
		than the actual MTU) may lead to buffer exhaustion, especially
		in the case of badly fragmented datagrams on the Rx path.
		Conversely, having a FSL_FM_MAX_FRAME_SIZE smaller than the actual
		MTU will lead to frames being dropped.

		This can be overridden by specifying "fsl_fm_max_frm" in
		the kernel bootargs:
		 * in Hypervisor-based scenarios, by adding a "chosen" node
		with the "bootargs" property specifying
		"fsl_fm_max_frm=<YourValue>";
		 * in non-Hypervisor-based scenarios, via u-boot's env, by
		modifying the "bootargs" env variable.

config FSL_FM_RX_EXTRA_HEADROOM
	int "Add extra headroom at beginning of data buffers"
	range 16 384
	default "64"
	help
		Configure this to tell the Frame Manager to reserve some extra
		space at the beginning of a data buffer on the receive path,
		before Internal Context fields are copied. This is in addition
		to the private data area already reserved for driver internal
		use. The provided value must be a multiple of 16.

		This setting can be overridden by specifying
		"fsl_fm_rx_extra_headroom" in the kernel bootargs:
		 * in Hypervisor-based scenarios, by adding a "chosen" node
		with the "bootargs" property specifying
		"fsl_fm_rx_extra_headroom=<YourValue>";
		 * in non-Hypervisor-based scenarios, via u-boot's env, by
		modifying the "bootargs" env variable.

config FMAN_PFC
	bool "FMan PFC support (EXPERIMENTAL)"
	default n
	help
		This option enables PFC support on FMan v3 ports.
		Data Center Bridging defines Classes of Service that are
		flow-controlled using PFC pause frames.

if FMAN_PFC
config FMAN_PFC_COS_COUNT
	int "Number of PFC Classes of Service"
	depends on FMAN_PFC
	range 1 4
	default "3"
	help
		The number of Classes of Service controlled by PFC.

config FMAN_PFC_QUANTA_0
	int "The pause quanta for PFC CoS 0"
	depends on FMAN_PFC
	range 0 65535
	default "65535"

config FMAN_PFC_QUANTA_1
	int "The pause quanta for PFC CoS 1"
	depends on FMAN_PFC
	range 0 65535
	default "65535"

config FMAN_PFC_QUANTA_2
	int "The pause quanta for PFC CoS 2"
	depends on FMAN_PFC
	range 0 65535
	default "65535"

config FMAN_PFC_QUANTA_3
	int "The pause quanta for PFC CoS 3"
	depends on FMAN_PFC
	range 0 65535
	default "65535"
endif

endif # FSL_SDK_FMAN

endmenu
```

## drivers/net/mqnic/Kconfig
```kconfig
# SPDX-License-Identifier: BSD-2-Clause-Views
# Copyright (c) 2019-2023 The Regents of the University of California

menuconfig CORUNDUM_MQNIC
	tristate "Corundum MQNIC support"
	select NET_DEVLINK
	select I2C_ALGOBIT
	depends on RTC_CLASS
	help
	  Corundum is an open-source, FPGA-based Network Interface Card (NIC)
	  and platform designed for high-performance networking and in-network
	  compute applications.

	  Say yes here to build support for Corundum network interface card.

if CORUNDUM_MQNIC

config CORUNDUM_MQNIC_PCI
	bool "Enable PCI support for Corundum MQNIC"
	depends on CORUNDUM_MQNIC && PCI
	help
	  Enable support for Corundum MQNIC devices connected via the PCI bus.
	  Corundum supports both PCI and AXI interfaces, so enabling this
	  option allows the driver to work with PCIe-based hardware. If you are
	  targeting FPGA boards or systems that use PCIe for host communication,
	  select this option.

endif # CORUNDUM_MQNIC
```

## drivers/net/pcs/Kconfig
```kconfig
# SPDX-License-Identifier: GPL-2.0-only
#
# PCS Layer Configuration
#

menu "PCS device drivers"

config MTIP_BACKPLANE_PHY
	tristate "MoreThanIP copper backplane PHYs"
	select PHYLINK
	select MII
	help
	  Enable support for the MoreThanIP copper backplane Auto-Negotiation
	  and Link Training blocks, as implemented on the QorIQ and Layerscape
	  SoCs.

config PCS_XPCS
	tristate "Synopsys DesignWare Ethernet XPCS"
	select PHYLINK
	help
	  This module provides a driver and helper functions for Synopsys
	  DesignWare XPCS controllers.

config PCS_LYNX
	depends on MTIP_BACKPLANE_PHY || MTIP_BACKPLANE_PHY=n
	tristate
	help
	  This module provides helpers to phylink for managing the Lynx PCS
	  which is part of the Layerscape and QorIQ Ethernet SERDES.

config PCS_MTK_LYNXI
	tristate
	select REGMAP
	help
	  This module provides helpers to phylink for managing the LynxI PCS
	  which is part of MediaTek's SoC and Ethernet switch ICs.

config PCS_RZN1_MIIC
	tristate "Renesas RZ/N1 MII converter"
	depends on OF && (ARCH_RZN1 || COMPILE_TEST)
	help
	  This module provides a driver for the MII converter that is available
	  on RZ/N1 SoCs. This PCS converts MII to RMII/RGMII or can be set in
	  pass-through mode for MII.

endmenu
```

## drivers/phy/adi/Kconfig
```kconfig
# SPDX-License-Identifier: GPL-2.0-only

#
# PHY drivers for ADI platforms
#

config PHY_ADI_SDHCI
	tristate "ADI ADRV906x SDHCI PHY driver"
	depends on OF
	depends on ARCH_ADRV906X || COMPILE_TEST
	select GENERIC_PHY
	help
	  Enable this to support the SDHCI PHY on ADI ADRV906x.
```

## drivers/phy/freescale/Kconfig
```kconfig
# SPDX-License-Identifier: GPL-2.0-only

if (ARCH_MXC && ARM64) || COMPILE_TEST

config PHY_FSL_IMX8MP_LVDS
	tristate "Freescale i.MX8MP LVDS PHY"
	depends on OF && HAS_IOMEM
	select GENERIC_PHY
	select REGMAP
	help
	  Enable this to add support for the LVDS PHY as found
	  on NXP's i.MX8MP SoC.

config PHY_FSL_IMX8MQ_USB
	tristate "Freescale i.MX8M USB3 PHY"
	depends on OF && HAS_IOMEM
	select GENERIC_PHY
	default ARCH_MXC && ARM64

config PHY_FSL_IMX9_DPHY_RX
       tristate "Freescale i.MX9 DPHY Rx"
       depends on OF && HAS_IOMEM
       select GENERIC_PHY
       select GENERIC_PHY_MIPI_DPHY
       select REGMAP_MMIO
       help
         Enable this to add support for the Synopsys DW DPHY Rx as found
         on NXP's i.MX9 family.

config PHY_FSL_IMX93_MIPI_DPHY
	tristate "Freescale i.MX93 MIPI DPHY"
	depends on OF && HAS_IOMEM
	select GENERIC_PHY
	select GENERIC_PHY_MIPI_DPHY
	select REGMAP_MMIO
	help
	  Enable this to add support for the Synopsys DW MIPI DPHY as found
	  on NXP's i.MX93 SoC.

config PHY_MIXEL_LVDS_PHY
	tristate "Mixel LVDS PHY support"
	depends on OF
	select GENERIC_PHY
	select REGMAP_MMIO
	help
	  Enable this to add support for the Mixel LVDS PHY as found
	  on NXP's i.MX8qm SoC.

config PHY_MIXEL_MIPI_DPHY
	tristate "Mixel MIPI DSI PHY support"
	depends on OF && HAS_IOMEM
	select GENERIC_PHY
	select GENERIC_PHY_MIPI_DPHY
	select REGMAP_MMIO
	help
	  Enable this to add support for the Mixel DSI PHY as found
	  on NXP's i.MX8 family of SOCs.

config PHY_FSL_IMX8M_PCIE
	tristate "Freescale i.MX8M PCIE PHY"
	depends on OF && HAS_IOMEM
	select GENERIC_PHY
	help
	  Enable this to add support for the PCIE PHY as found on
	  i.MX8M family of SOCs.

config PHY_FSL_IMX8QM_HSIO
	tristate "Freescale i.MX8QM HSIO PHY"
	depends on OF && HAS_IOMEM
	select GENERIC_PHY
	help
	  Enable this to add support for the HSIO PHY as found on
	  i.MX8QM family of SOCs.

config PHY_FSL_SAMSUNG_HDMI_PHY
	tristate "Samsung HDMI PHY support"
	depends on OF && HAS_IOMEM && COMMON_CLK
	help
	  Enable this to add support for the Samsung HDMI PHY in i.MX8MP.
endif

config PHY_FSL_LYNX_XGKR_ALGORITHM
	tristate
	help
	  Link training algorithm for copper backplane Ethernet (10GBase-KR,
	  25GBase-KR, 40GBase-KR4) on the Lynx SerDes PHY.

config PHY_FSL_LYNX_10G
	tristate "Freescale Layerscape Lynx 10G SerDes PHY support"
	depends on OF
	depends on ARCH_LAYERSCAPE || COMPILE_TEST
	select PHY_FSL_LYNX_XGKR_ALGORITHM
	select GENERIC_PHY
	select FSL_GUTS
	help
	  Enable this to add support for the Lynx 10G SerDes PHY as found on
	  NXP's Layerscape platform such as LS1088A or LS1028A.

config PHY_FSL_LYNX_28G
	tristate "Freescale Layerscape Lynx 28G SerDes PHY support"
	depends on OF
	depends on ARCH_LAYERSCAPE || COMPILE_TEST
	select PHY_FSL_LYNX_XGKR_ALGORITHM
	select GENERIC_PHY
	help
	  Enable this to add support for the Lynx SerDes 28G PHY as
	  found on NXP's Layerscape platforms such as LX2160A.
	  Used to change the protocol running on SerDes lanes at runtime.
	  Only useful for a restricted set of Ethernet protocols.
```

## drivers/phy/inphi/Kconfig
```kconfig
config PHY_INPHI_IN112525_RETIMER
	bool "Inphi IN112525 Retimer PHY support"
	depends on OF
	select GENERIC_PHY
	help
	  Enable this to add support for configuration and runtime management
	  of Inphi IN112525 S03 Retimer PHY. The retimer is modeled as a
	  Generic PHY and supports both 10G and 25G link speeds.
	  The driver will configure the retimer at probe time to function in
	  25Gbps but another configuration can be requested dynamically.
```

## drivers/pinctrl/tegra/Kconfig
```kconfig
# SPDX-License-Identifier: GPL-2.0-only
config PINCTRL_TEGRA
	bool "NVIDIA Tegra pin controllers common" if COMPILE_TEST && !ARCH_TEGRA
	select PINMUX
	select PINCONF

config PINCTRL_TEGRA20
	bool "NVIDIA Tegra20 pin controller" if COMPILE_TEST && !ARCH_TEGRA
	select PINCTRL_TEGRA
	depends on COMMON_CLK

config PINCTRL_TEGRA30
	bool "NVIDIA Tegra30 pin controller" if COMPILE_TEST && !ARCH_TEGRA
	select PINCTRL_TEGRA

config PINCTRL_TEGRA114
	bool "NVIDIA Tegra114 pin controller" if COMPILE_TEST && !ARCH_TEGRA
	select PINCTRL_TEGRA

config PINCTRL_TEGRA124
	bool "NVIDIA Tegra124 pin controller" if COMPILE_TEST && !ARCH_TEGRA
	select PINCTRL_TEGRA

config PINCTRL_TEGRA210
	bool "NVIDIA Tegra210 pin controller" if COMPILE_TEST && !ARCH_TEGRA
	select PINCTRL_TEGRA

config PINCTRL_TEGRA186
	bool "NVIDIA Tegra186 pin controller" if COMPILE_TEST && !ARCH_TEGRA
	select PINCTRL_TEGRA

config PINCTRL_TEGRA194
	bool "NVIDIA Tegra194 pin controller" if COMPILE_TEST && !ARCH_TEGRA
	select PINCTRL_TEGRA

config PINCTRL_TEGRA234
	bool "NVIDIA Tegra234 pin controller" if COMPILE_TEST && !ARCH_TEGRA
	select PINCTRL_TEGRA

config PINCTRL_TEGRA_XUSB
	bool "NVIDIA Tegra XUSB pin controller" if COMPILE_TEST && !ARCH_TEGRA
	default y if ARCH_TEGRA
	select GENERIC_PHY
	select PINCONF
	select PINMUX
```

## drivers/rpmsg/Kconfig
```kconfig
# SPDX-License-Identifier: GPL-2.0

menu "Rpmsg drivers"

# RPMSG always gets selected by whoever wants it
config RPMSG
	tristate

config RPMSG_CHAR
	tristate "RPMSG device interface"
	depends on RPMSG
	depends on NET
	help
	  Say Y here to export rpmsg endpoints as device files, usually found
	  in /dev. They make it possible for user-space programs to send and
	  receive rpmsg packets.

config RPMSG_CTRL
	tristate "RPMSG control interface"
	depends on RPMSG && ( RPMSG_CHAR || RPMSG_CHAR=n )
	help
	  Say Y here to enable the support of the /dev/rpmsg_ctrlX API. This API
	  allows user-space programs to create endpoints with specific service name,
	  source and destination addresses.

config RPMSG_NS
	tristate "RPMSG name service announcement"
	depends on RPMSG
	help
	  Say Y here to enable the support of the name service announcement
	  channel that probes the associated RPMsg device on remote endpoint
	  service announcement.

config RPMSG_MTK_SCP
	tristate "MediaTek SCP"
	depends on MTK_SCP
	select RPMSG
	help
	  Say y here to enable support providing communication channels to
	  remote processors in MediaTek platforms.
	  This use IPI and IPC to communicate with remote processors.

config RPMSG_QCOM_GLINK
	tristate
	select RPMSG

config RPMSG_QCOM_GLINK_RPM
	tristate "Qualcomm RPM Glink driver"
	select RPMSG_QCOM_GLINK
	depends on HAS_IOMEM
	depends on MAILBOX
	help
	  Say y here to enable support for the GLINK RPM communication driver,
	  which serves as a channel for communication with the RPM in GLINK
	  enabled systems.

config RPMSG_QCOM_GLINK_SMEM
	tristate "Qualcomm SMEM Glink driver"
	select RPMSG_QCOM_GLINK
	depends on MAILBOX
	depends on QCOM_SMEM
	help
	  Say y here to enable support for the GLINK SMEM communication driver,
	  which provides support for using the GLINK communication protocol
	  over SMEM.

config RPMSG_QCOM_SMD
	tristate "Qualcomm Shared Memory Driver (SMD)"
	depends on MAILBOX
	depends on QCOM_SMEM
	select RPMSG
	help
	  Say y here to enable support for the Qualcomm Shared Memory Driver
	  providing communication channels to remote processors in Qualcomm
	  platforms.

config RPMSG_VIRTIO
	tristate "Virtio RPMSG bus driver"
	depends on HAS_DMA
	select RPMSG
	select RPMSG_NS
	select VIRTIO

config HAVE_IMX_RPMSG
	bool "IMX RPMSG driver on the AMP SOCs"
	default y
	depends on IMX_MBOX
	select RPMSG_VIRTIO
	help
	  Say y here to enable support for the iMX Rpmsg Driver	providing
	  communication channels to remote processors in iMX asymmetric
	  multiprocessing (AMP) platforms.

	  Especially, it is mandatory required when the partition reset is
	  required on some iMX AMP platforms.

config IMX_RPMSG_PINGPONG
	tristate "IMX RPMSG pingpong driver -- loadable modules only"
	default m
	depends on HAVE_IMX_RPMSG && m
	help
	  One 32bit unsigned int data transactions demoe between the A core
	  and the remote M core on the iMX AMP platforms.

	  Only the module mode is supported here, the demo would be kicked off
	  immediately when this module is insmoded.

config IMX_RPMSG_TTY
	tristate "IMX RPMSG tty driver -- loadable modules only"
	default m
	depends on HAVE_IMX_RPMSG && m
	help
	  Demostrate the string transmission from A core to the remote M core
	  on the iMX AMP platforms.

	  Only the module mode is supported here. The according device node
	  would be created after this module is insmoded. the demo would be
	  executed by the command "echo <string> > <accordingly node>", thus
	  remote M core would receive the string.

endmenu
```
