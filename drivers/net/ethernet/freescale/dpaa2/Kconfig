## drivers/soc/adi/mach-sc59x/Kconfig
```kconfig
# SPDX-License-Identifier: (GPL-2.0-only OR BSD-2-Clause)-or-later

menu "sc59x 64-bit platform type"
	depends on ARCH_SC59X_64

config ARCH_SC59X_SLAVECORE_COUNT
	int "Slave core count in sc59x"
	range 0 1
	default 1
	help
	This sets the slave core count in sc59x processor.

choice
	prompt "SC59X Core Clock Divider"
	default SC59X_CCLK_DIV_2
	help
	This sets the frequency of the core. It can be 1, 2, 4 or 8
	Core Frequency = (PLL frequency) / (this setting)

config SC59X_CCLK_DIV_1
	bool "1"

config SC59X_CCLK_DIV_2
	bool "2"

config SC59X_CCLK_DIV_4
	bool "4"

config SC59X_CCLK_DIV_8
	bool "8"
endchoice

config SCLK_DIV
	int "System Clock Divider"
	range 1 15
	default 4
	help
	This sets the frequency of the system clock and provides the
	source from which SCLK0 and SCLK1 are derived.
	This can be between 1 and 15
	System Clock = (PLL frequency) / (this setting)

config SCLK0_DIV
	int "System Clock0 Divider"
	range 1 15
	default 4
	help
	This sets the frequency of the system clock0.
	This can be between 1 and 15
	System Clock0 = (System Clock) / (this setting)

config SCLK1_DIV
	int "System Clock1 Divider"
	range 1 15
	default 2
	help
	This sets the frequency of the system clock1.
	This can be between 1 and 15
	System Clock1 = (System Clock) / (this setting)

config ARCH_HEADER_IN_MACH
	bool
	default y
	help
	  Define the architecture specific head file path for
	  ADI genenric peripheral drivers.

config MACH_SC59X_DT
	bool "Support sc59x platforms from device tree"
	default y
	select USE_OF
	help
	  Include support for sc59x based platforms using the device tree for
	  discovery. Note: This is under development and not all peripherals
	  can be supported with this machine file

endmenu
```

## drivers/soc/imx/Kconfig
```kconfig
# SPDX-License-Identifier: GPL-2.0-only
menu "i.MX SoC drivers"

config SOC_IMX8M
	tristate "i.MX8M SoC family support"
	depends on ARCH_MXC || COMPILE_TEST
	default ARCH_MXC && ARM64
	select SOC_BUS
	select ARM_GIC_V3 if ARCH_MXC && ARCH_MULTI_V7
	help
	  If you say yes here you get support for the NXP i.MX8M family
	  support, it will provide the SoC info like SoC family,
	  ID and revision etc.

config IMX8M_BUSFREQ
	tristate "i.MX8M busfreq"
	depends on SOC_IMX8M
	default ARCH_MXC

config IMX8M_PM_DOMAINS
	tristate "i.MX8M PM domains"
	default ARCH_MXC
	depends on ARCH_MXC || (COMPILE_TEST && OF)
	depends on PM
	select PM_GENERIC_DOMAINS

config SOC_IMX9
	tristate "i.MX9 SoC family support"
	depends on ARCH_MXC || COMPILE_TEST
	default ARCH_MXC && ARM64
	select SOC_BUS
	help
	  If you say yes here, you get support for the NXP i.MX9 family

config SECVIO_SC
	tristate "NXP SC secvio support"
	depends on IMX_SCU
	default y
	help
	   If you say yes here you get support for the NXP SNVS security
	   violation module. It includes the possibility to read information
	   related to security violations and tampers. It also gives the
	   possibility to register user callbacks when a security violation
	   occurs.

config RPMSG_LIFE_CYCLE
	tristate "i.MX8ULP Rpmsg Life Cycle Support"
	depends on ARCH_MXC || COMPILE_TEST
	depends on RPMSG
	default ARCH_MXC && ARM64
	help
	  If you say yes here you get supoort for the rpmsg life cycle support on
	  i.MX8ULP for low power mode state coordination between A core & M core to
	  make sure A core can be put into Low power mode without risk by sending
	  notify to M core.

config IMX9_LPM_CTRL
	tristate "i.MX9 Low Power Control support"
	depends on ARCH_MXC || COMPILE_TEST
	depends on IMX_SEC_ENCLAVE && SOC_IMX9
	default ARCH_MXC && ARM64
	help
	  If you say yes here you get support for Over driver mode, Nominal driver mode,
	  Low driver mode (DDR HWFFC) and Low driver mode (DDR SWFFC) on i.MX9 based on
	  user case. When voltage mode is switched, core, bus and DDR frequencies are also
	  scaled together. The mode need to be switched manually by user.

config IMX8ULP_LPM_CTRL
	tristate "i.MX8ULP DDR Low Power Control support"
	depends on ARCH_MXC || COMPILE_TEST
	default ARCH_MXC && ARM64
	help
	  If you say yes here you get supoort for DDR frequency scaling support on
	  i.MX8ULP for scaling the DDR frequency based on user case. The DDR frequency
	  need to be switched manually by user.
endmenu
```

## drivers/staging/ethosu/Kconfig
```kconfig
#
# (C) COPYRIGHT 2020,2022 ARM Limited.
#
# This program is free software and is provided to you under the terms of the
# GNU General Public License version 2 as published by the Free Software
# Foundation, and any use by you of this program is subject to the terms
# of such GNU licence.
#
# This program is distributed in the hope that it will be useful,
# but WITHOUT ANY WARRANTY; without even the implied warranty of
# MERCHANTABILITY or FITNESS FOR A PARTICULAR PURPOSE. See the
# GNU General Public License for more details.
#
# You should have received a copy of the GNU General Public License
# along with this program; if not, you can access it online at
# http://www.gnu.org/licenses/gpl-2.0.html.
#
# SPDX-License-Identifier: GPL-2.0-only
#

config ETHOSU
    tristate "Arm Ethos-U NPU support"
    help
      Arm Ethos-U NPU driver.
```

## drivers/staging/fsl-dpaa2/Kconfig
```kconfig
# SPDX-License-Identifier: GPL-2.0
#
# Freescale DataPath Acceleration Architecture Gen2 (DPAA2) drivers
#

config FSL_DPAA2
	bool "Freescale DPAA2 devices"
	depends on FSL_MC_BUS
	help
	  Build drivers for Freescale DataPath Acceleration
	  Architecture (DPAA2) family of SoCs.

source "drivers/staging/fsl-dpaa2/evb/Kconfig"
```

## drivers/staging/fsl-dpaa2/evb/Kconfig
```kconfig
config FSL_DPAA2_EVB
	tristate "DPAA2 Edge Virtual Bridge"
	depends on FSL_MC_BUS && FSL_DPAA2
	select VLAN_8021Q
	default y
	help
	  Prototype driver for DPAA2 Edge Virtual Bridge.
```

## drivers/staging/fsl_ppfe/Kconfig
```kconfig
#
# Freescale Programmable Packet Forwarding Engine driver
#
config FSL_PPFE
	bool "Freescale PPFE Driver"
	select FSL_GUTS
	default n
	---help---
	Freescale LS1012A SoC has a Programmable Packet Forwarding Engine.
	It provides two high performance ethernet interfaces.
	This driver initializes, programs and controls the PPFE.
	Use this driver to enable network connectivity on LS1012A platforms.

if FSL_PPFE

config FSL_PPFE_UTIL_DISABLED
	bool "Disable PPFE UTIL Processor Engine"
	---help---
	UTIL PE has to be enabled only if required.

endif # FSL_PPFE
```

## drivers/staging/fsl_qbman/Kconfig
```kconfig
config FSL_SDK_DPA
	bool "Freescale Datapath Queue and Buffer management"
	depends on !FSL_DPAA
	select FSL_QMAN_FQ_LOOKUP if PPC64
	select FSL_QMAN_FQ_LOOKUP if ARM64


menu "Freescale Datapath QMan/BMan options"
	depends on FSL_SDK_DPA

config FSL_DPA_CHECKING
	bool "additional driver checking"
	default n
	help
	  Compiles in additional checks to sanity-check the drivers and any
	  use of it by other code. Not recommended for performance.

config FSL_DPA_CAN_WAIT
	bool
	default y

config FSL_DPA_CAN_WAIT_SYNC
	bool
	default y

config FSL_DPA_PIRQ_FAST
	bool
	default y

config FSL_DPA_PIRQ_SLOW
	bool
	default y

config FSL_DPA_PORTAL_SHARE
	bool
	default y

config FSL_SDK_BMAN
	bool "Freescale Buffer Manager (BMan) support"
	default y

if FSL_SDK_BMAN

config FSL_BMAN_CONFIG
	bool "BMan device management"
	default y
	help
	  If this linux image is running natively, you need this option. If this
	  linux image is running as a guest OS under the hypervisor, only one
	  guest OS ("the control plane") needs this option.

config FSL_BMAN_TEST
	tristate "BMan self-tests"
	default n
	help
	  This option compiles self-test code for BMan.

config FSL_BMAN_TEST_HIGH
	bool "BMan high-level self-test"
	depends on FSL_BMAN_TEST
	default y
	help
	  This requires the presence of cpu-affine portals, and performs
	  high-level API testing with them (whichever portal(s) are affine to
	  the cpu(s) the test executes on).

config FSL_BMAN_TEST_THRESH
	bool "BMan threshold test"
	depends on FSL_BMAN_TEST
	default y
	help
	  Multi-threaded (SMP) test of BMan pool depletion. A pool is seeded
	  before multiple threads (one per cpu) create pool objects to track
	  depletion state changes. The pool is then drained to empty by a
	  "drainer" thread, and the other threads that they observe exactly
	  the depletion state changes that are expected.

config FSL_BMAN_DEBUGFS
	tristate "BMan debugfs interface"
	depends on DEBUG_FS
	default y
	help
	  This option compiles debugfs code for BMan.

endif # FSL_SDK_BMAN

config FSL_SDK_QMAN
	bool "Freescale Queue Manager (QMan) support"
	default y

if FSL_SDK_QMAN

config FSL_QMAN_POLL_LIMIT
	int
	default 32

config FSL_QMAN_CONFIG
	bool "QMan device management"
	default y
	help
	  If this linux image is running natively, you need this option. If this
	  linux image is running as a guest OS under the hypervisor, only one
	  guest OS ("the control plane") needs this option.

config FSL_QMAN_TEST
	tristate "QMan self-tests"
	default n
	help
	  This option compiles self-test code for QMan.

config FSL_QMAN_TEST_STASH_POTATO
	bool "QMan 'hot potato' data-stashing self-test"
	depends on FSL_QMAN_TEST
	default y
	help
	  This performs a "hot potato" style test enqueuing/dequeuing a frame
	  across a series of FQs scheduled to different portals (and cpus), with
	  DQRR, data and context stashing always on.

config FSL_QMAN_TEST_HIGH
	bool "QMan high-level self-test"
	depends on FSL_QMAN_TEST
	default y
	help
	  This requires the presence of cpu-affine portals, and performs
	  high-level API testing with them (whichever portal(s) are affine to
	  the cpu(s) the test executes on).

config FSL_QMAN_DEBUGFS
	tristate "QMan debugfs interface"
	depends on DEBUG_FS
	default y
	help
	  This option compiles debugfs code for QMan.

# H/w settings that can be hard-coded for now.
config FSL_QMAN_FQD_SZ
	int "size of Frame Queue Descriptor region"
	default 10
	help
	  This is the size of the FQD region defined as: PAGE_SIZE * (2^value)
	  ex: 10 => PAGE_SIZE * (2^10)
	  Note: Default device-trees now require minimum Kconfig setting of 10.

config FSL_QMAN_PFDR_SZ
	int "size of the PFDR pool"
	default 13
	help
	  This is the size of the PFDR pool defined as: PAGE_SIZE * (2^value)
	  ex: 13 => PAGE_SIZE * (2^13)

# Corenet initiator settings. Stash request queues are 4-deep to match cores'
# ability to snart. Stash priority is 3, other priorities are 2.
config FSL_QMAN_CI_SCHED_CFG_SRCCIV
	int
	depends on FSL_QMAN_CONFIG
	default 4
config FSL_QMAN_CI_SCHED_CFG_SRQ_W
	int
	depends on FSL_QMAN_CONFIG
	default 3
config FSL_QMAN_CI_SCHED_CFG_RW_W
	int
	depends on FSL_QMAN_CONFIG
	default 2
config FSL_QMAN_CI_SCHED_CFG_BMAN_W
	int
	depends on FSL_QMAN_CONFIG
	default 2

# portal interrupt settings
config FSL_QMAN_PIRQ_DQRR_ITHRESH
	int
	default 12
config FSL_QMAN_PIRQ_MR_ITHRESH
	int
	default 4
config FSL_QMAN_PIRQ_IPERIOD
	int
	default 100

# 64 bit kernel support
config FSL_QMAN_FQ_LOOKUP
	bool
	default n

config QMAN_CEETM_UPDATE_PERIOD
	int "Token update period for shaping, in nanoseconds"
	default 1000
	help
	Traffic shaping works by performing token calculations (using
	credits) on shaper instances periodically. This update period
	sets the granularity for how often those token rate credit
	updates are performed, and thus determines the accuracy and
	range of traffic rates that can be configured by users. The
	reference manual recommends a 1 microsecond period as providing
	a good balance between granularity and range.

	Unless you know what you are doing, leave this value at its default.

config FSL_QMAN_INIT_TIMEOUT
	int "timeout for qman init stage, in seconds"
	default 10
	help
	The timeout setting to quit the initialization loop for non-control
	partition in case the control partition fails to boot-up.

endif # FSL_SDK_QMAN

config FSL_USDPAA
        bool "Freescale USDPAA process driver"
        depends on FSL_SDK_DPA
        default y
	help
        This driver provides user-space access to kernel-managed
        resource interfaces for USDPAA applications, on the assumption
        that each process will open this device once. Specifically, this
        device exposes functionality that would be awkward if exposed
        via the portal devices - ie. this device exposes functionality
        that is inherently process-wide rather than portal-specific.
        This device is necessary for obtaining access to DMA memory and
        for allocation of Qman and Bman resources. In short, if you wish
        to use USDPAA applications, you need this.

        If unsure, say Y.


endmenu
```

## drivers/staging/icc/Kconfig
```kconfig
# SPDX-License-Identifier: (GPL-2.0-only OR BSD-2-Clause)-or-later

#
# Intercore communication protocol and impelementation
#

menuconfig ICC
	bool "icc driver"
	default y
	depends on !SMP
	help
	  the icc driver is a device driver that control the DSP devices,
	  and bridges the program running on DSPs and linux user applications
if ICC
config CORE_CONTROL
	bool "icc core control"
	default y
	help
	   ICC core control, control the DSP devices at the side of ARM Core, which
	   provides some commands e.g. Start, Stop, and Set the vector value
config	ICC_PROTOCOL
	bool "icc protocol"
	default y
	help
	  ICC protocol, a shared memory based protocol for communication between
	  linux core and DSP core
config ICC_DEBUG
	bool "icc debug"
	default n
	help
	  ICC verbose debug messages
endif
```

## drivers/staging/media/imx/Kconfig
```kconfig
# SPDX-License-Identifier: GPL-2.0
config VIDEO_IMX_MEDIA
	tristate "i.MX5/6 V4L2 media drivers"
	depends on ARCH_MXC || COMPILE_TEST
	depends on HAS_DMA
	depends on VIDEO_DEV
	depends on IMX_IPUV3_CORE
	select MEDIA_CONTROLLER
	select V4L2_FWNODE
	select V4L2_MEM2MEM_DEV
	select VIDEOBUF2_DMA_CONTIG
	select VIDEO_V4L2_SUBDEV_API
	help
	  Say yes here to enable support for video4linux media controller
	  drivers for the i.MX5/6 SOC.

config VIDEO_IMX_CAPTURE
	tristate "i.MX V4L2 media core driver"
	depends on ARCH_MXC || COMPILE_TEST
	depends on MEDIA_CONTROLLER && VIDEO_DEV
	depends on VIDEO_V4L2_SUBDEV_API
	depends on HAS_DMA
	select VIDEOBUF2_DMA_CONTIG
	select V4L2_FWNODE
	help
	  Say yes here to enable support for video4linux media controller
	  driver for the i.MX5/6 SOC.

if VIDEO_IMX_CAPTURE
menu "i.MX8QXP/QM Camera ISI/MIPI Features support"

config IMX8_MIPI_CSI2_SAM
	tristate "IMX8 MIPI CSI2 SAMSUNG Controller"
	depends on VIDEO_DEV && VIDEO_V4L2_SUBDEV_API
	default y
	help
	  Enable support for video4linux MIPI CSI2 Samsung driver for
	  i.MX8MN platform.

config IMX8_ISI_HW
	tristate "IMX8 Image Sensor Interface hardware driver"
	depends on VIDEO_DEV && VIDEO_V4L2_SUBDEV_API
	default y
	help
	  ISI hardware driver is used to export functions to config
	  ISI registers and it is shared by isi capture and mem2mem
	  driver

config IMX8_ISI_CORE
	tristate "IMX8 Image Sensor Interface Core Driver"
	depends on IMX8_ISI_CAPTURE && IMX8_ISI_M2M
	default y

config IMX8_ISI_CAPTURE
	tristate "IMX8 Image Sensor Interface Capture Device Driver"
	depends on VIDEO_DEV && VIDEO_V4L2_SUBDEV_API
	depends on IMX8_ISI_HW
	select VIDEOBUF2_DMA_CONTIG
	default y

config IMX8_ISI_M2M
	tristate "IMX8 Image Sensor Interface Memory to Memory Device Driver"
	select V4L2_MEM2MEM_DEV
	depends on IMX8_ISI_HW
	default y

config GMSL_MAX9286
	tristate "GMSL MAX8286"
	depends on VIDEO_DEV && VIDEO_V4L2_SUBDEV_API
	default y
	help
	  Enable support for video4linux camera sensor driver for GMSL MAX9286

config IMX8_MEDIA_DEVICE
	tristate "IMX8 Media Device Driver"
	select V4L2_FWNODE
	default y
	help
	  This media device is a virtual device which used to manage
	  all modules in image subsystem of imx8qxp/qm platform.

source "drivers/staging/media/imx/hdmirx/Kconfig"

endmenu
endif  #VIDEO_IMX_CAPTURE
```

## drivers/staging/media/imx/hdmirx/Kconfig
```kconfig
config MHDP_HDMIRX
	tristate "Cadence MHDP HDMIRX Controller"

config MHDP_HDMIRX_CEC
	tristate "Cadence MHDP HDMIRX CEC"
	select DRM_CDNS_HDMI_CEC
```
