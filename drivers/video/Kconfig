## drivers/video/Kconfig
```kconfig
#
# Video configuration
#

menu "Graphics support"

if HAS_IOMEM

config HAVE_FB_ATMEL
	bool

source "drivers/char/agp/Kconfig"

source "drivers/gpu/vga/Kconfig"

source "drivers/gpu/host1x/Kconfig"
source "drivers/gpu/ipu-v3/Kconfig"

source "drivers/gpu/drm/Kconfig"

menu "Frame buffer Devices"
source "drivers/video/fbdev/Kconfig"
endmenu

source "drivers/video/backlight/Kconfig"

config VGASTATE
       tristate
       default n

config VIDEOMODE_HELPERS
	bool

config HDMI
	bool

endif # HAS_IOMEM

config FB_ALTERA_VIP
	tristate "Altera VIP Frame Reader framebuffer support"
	depends on FB
	select FB_CFB_FILLRECT
	select FB_CFB_COPYAREA
	select FB_CFB_IMAGEBLIT
	help
	  This driver supports the Altera Video and Image Processing(VIP)
	  Frame Reader

if VT
	source "drivers/video/console/Kconfig"
endif

if FB || SGI_NEWPORT_CONSOLE
	source "drivers/video/logo/Kconfig"

endif


endmenu
```

## drivers/video/fbdev/mxc/Kconfig
```kconfig
config FB_MXC
	tristate "MXC Framebuffer support"
	depends on FB
	select FB_CFB_FILLRECT
	select FB_CFB_COPYAREA
	select FB_CFB_IMAGEBLIT
	select FB_MODE_HELPERS
	select FB_IOMEM_FOPS
	default y
	help
	  This is a framebuffer device for the MXC LCD Controller.
	  See <http://www.linux-fbdev.org/> for information on framebuffer
	  devices.

	  If you plan to use the LCD display with your MXC system, say
	  Y here.

config FB_MXC_DISP_FRAMEWORK
	tristate "Display driver framework"
	help
	  This is a framework that helps with registration and data handling
	  between fb drivers and display drivers.

	  It is selected by drivers which use this framework as linkage code
	  between display controllers and panels.

config FB_MXC_OVERLAY
	depends on FB_MXC
	tristate "Overlay Framebuffer"
	default n
	help
	  Enhanced LCD controller of MXC has overlay function.

config FB_MXC_MIPI_DSI_NORTHWEST
	tristate "MXC MIPI_DSI_NORTHWEST"
	depends on FB_MXC_DISP_FRAMEWORK
	depends on FB_MXS
	select BACKLIGHT_CLASS_DEVICE

config FB_MXC_EDID
	depends on FB_MXC && I2C
	tristate "MXC EDID support"
	default y

config FB_MXC_ADV7535
	tristate "ADI ADV7535 support"
	depends on I2C
	depends on FB_MXC_MIPI_DSI_NORTHWEST
	help
	  Driver support for the ADV7535 DSI-to-HDMI module
```

## net/atm/Kconfig
```kconfig
# SPDX-License-Identifier: GPL-2.0-only
#
# Asynchronous Transfer Mode (ATM)
#

config ATM
	tristate "Asynchronous Transfer Mode (ATM)"
	help
	  ATM is a high-speed networking technology for Local Area Networks
	  and Wide Area Networks.  It uses a fixed packet size and is
	  connection oriented, allowing for the negotiation of minimum
	  bandwidth requirements.

	  In order to participate in an ATM network, your Linux box needs an
	  ATM networking card. If you have that, say Y here and to the driver
	  of your ATM card below.

	  Note that you need a set of user-space programs to actually make use
	  of ATM.  See the file <file:Documentation/networking/atm.rst> for
	  further details.

config ATM_BR2684
	tristate "RFC1483/2684 Bridged protocols"
	depends on ATM && INET
	help
	  ATM PVCs can carry ethernet PDUs according to RFC2684 (formerly 1483)
	  This device will act like an ethernet from the kernels point of view,
	  with the traffic being carried by ATM PVCs (currently 1 PVC/device).
	  This is sometimes used over DSL lines.  If in doubt, say N.

config ATM_BR2684_IPFILTER
	bool "Per-VC IP filter kludge"
	depends on ATM_BR2684
	help
	  This is an experimental mechanism for users who need to terminate a
	  large number of IP-only vcc's.  Do not enable this unless you are sure
	  you know what you are doing.
```

## net/tsn/Kconfig
```kconfig
config TSN
	tristate "802.1 Time-Sensitive Networking support using tsntool"
	depends on NET_SCH_TAPRIO || NET_SCH_TAPRIO=n
	depends on VLAN_8021Q && PTP_1588_CLOCK
	help
	  This enables support for the configuration of TSN (Time Sensitive
	  Networking) hardware features through the NXP tsntool genetlink
	  interface. TSN features include:
	    - IEEE 802.1Qav: Forwarding and Queuing Enhancements for Time
	      Sensitive Streams
	    - IEEE 802.1Qbv: Enhancements for Scheduled Traffic
	    - IEEE 802.1Qci: Per-Stream Filtering and Policing
	    - IEEE 802.1Qbu: Frame Preemption
	    - IEEE 802.1CB: Frame Replication and Elimination for Reliability

	  If unsure, say N.
```

## sound/soc/codecs/Kconfig.adi
```kconfig
# This file exists solely to be include in Kconfig.adi
# Unfortunately, this is the best approach to build all ADI codecs
# in a single change, since all that's needed is to imply the
# 'SND_SOC_ALL_ADI_CODECS' symbol and all should work
# It's not likely that this will be upstreamed soon, but the
# way it is now, the change is manage-able over time when merging
# upstream code in ADI linux tree

config SND_SOC_ALL_ADI_CODECS
	tristate "Build all Analog Devices ASoC CODEC drivers"
	imply SND_SOC_AD1836
	imply SND_SOC_AD193X_SPI
	imply SND_SOC_AD193X_I2C
	imply SND_SOC_AD1980
	imply SND_SOC_ADAU1372_I2C
	imply SND_SOC_ADAU1372_SPI
	imply SND_SOC_ADAU1373
	imply SND_SOC_ADAU1761_I2C
	imply SND_SOC_ADAU1761_SPI
	imply SND_SOC_ADAU1781_I2C
	imply SND_SOC_ADAU1781_SPI
	imply SND_SOC_ADAV801
	imply SND_SOC_ADAV803
	imply SND_SOC_ADAU1977_SPI
	imply SND_SOC_ADAU1977_I2C
	imply SND_SOC_ADAU1701
	imply SND_SOC_ADAU7002
	imply SND_SOC_ADAU7118_I2C
	imply SND_SOC_ADAU7118_HW
	imply SND_SOC_SSM2305
	imply SND_SOC_SSM2518
	imply SND_SOC_SSM2602_SPI
	imply SND_SOC_SSM2602_I2C
	imply SND_SOC_SSM4567
	imply SND_SOC_ADI
	imply SND_SOC_ADI_AXI_I2S
	imply SND_SOC_ADI_AXI_SPDIF
	imply SND_SOC_ADRV936X_BOX
	imply SND_USB
	imply SND_USB_AUDIO
	imply SND_SIMPLE_CARD
	imply SND_SOC_AD73311
```

## sound/soc/xlnx/Kconfig
```kconfig
config SND_SOC_XILINX
	tristate "SoC Audio for Xilinx based boards"
	depends on SND_SOC && (MICROBLAZE || ARCH_ZYNQ)
	select SND_SOC_GENERIC_DMAENGINE_PCM

config SND_SOC_AXI_SPDIF
	select REGMAP_MMIO
	tristate

config SND_SOC_ADI_AXI_I2S
	select REGMAP_MMIO
	tristate

config SND_SOC_ADV7511_HDMI
	tristate "ADV7511 HDMI transmitter sound support"
	depends on SND_SOC_XILINX
	select SND_SOC_AXI_SPDIF
```
